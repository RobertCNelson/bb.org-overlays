/*
 * Copyright (C) 2012 Texas Instruments Incorporated - http://www.ti.com/
 *
 * This program is free software; you can redistribute it and/or modify
 * it under the terms of the GNU General Public License version 2 as
 * published by the Free Software Foundation.
 */
/dts-v1/;
/plugin/;

/ {
	compatible = "ti,beaglebone", "ti,beaglebone-black", "ti,beaglebone-green";

	// identification
	part-number = "AM335X-PRU-UIO";
	version = "00A0";

	fragment@0 {
		target-path="/";
		__overlay__ {

			ocp {
				#address-cells = <1>;
				#size-cells = <1>;

				russ_soc_bus: pruss_soc_bus@4a326004 {
					status = "okay";
					compatible = "simple-pm-bus";
					ti,hwmods = "pruss";
					reg = <0x4a326004 0x4>;
					ranges = <0x0 0x4a300000 0x80000>;

					#address-cells = <1>;
					#size-cells = <1>;

					pruss: pruss@0 {
						status = "okay";
						compatible = "ti,pruss-v2";
						ti,pintc-offset = <0x20000>;
						reg = <0 0x80000>;
						interrupt-parent = <&intc>;
						interrupts = <20 21 22 23 24 25 26 27>;
						interrupt-names = "host2", "host3", "host4",
								  "host5", "host6", "host7",
								  "host8", "host9";
					};
				};
			};
		};
	};
};
