/dts-v1/;
/plugin/;

/ {
  compatible = "ti,beaglebone", "ti,beaglebone-black";

  /* Id */
  part-number = "BB-RS485";
  version = "00A0";

  /* Resources */
  exclusive-use = 
    "P9.11", /* uart4_rxd */
    "P9.13", /* uart4_txd */
    "P9.27", /* uart4_de/re */
    "gpio3_19",
    "uart4";


  fragment@0 {
    target = <&am33xx_pinmux>;
    __overlay__ {
      bb_rs485_pins: pinmux_bb_rs485_pins {
        pinctrl-single,pins = <
          0x070 0x26 /* gpmc_wait0 - RX_ENABLED | MODE6 (UART4 RX) */
          0x074 0x06 /* gpmc_wpn - MODE6 (UART4 TX) */
          0x1a4 0x07 /* PIN_OUTPUT_PULLDOWN | MUX_MODE7 (GPIO3_19) */
        >;
      };
    };
  };

  fragment@1 {
    target = <&uart4>;
    __overlay__ {
      status = "okay";
      pinctrl-names = "default";
      pinctrl-0 = <&bb_rs485_pins>;
      rs485-rts-delay = <0 0>;

      rts-gpio = <&gpio3 19 1>; /*  GPIO_ACTIVE_HIGH>; */
      rs485-rts-active-high;
      linux,rs485-enabled-at-boot-time;
    };
  };
};

