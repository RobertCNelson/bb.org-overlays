/*
 * Copyright (C) 2016 Robert Nelson <robertcnelson@gmail.com>
 *
 * Virtual cape for pruss_uio
 *
 * This program is free software; you can redistribute it and/or modify
 * it under the terms of the GNU General Public License version 2 as
 * published by the Free Software Foundation.
 */

/* 
 * Remember to blacklist, remoteproc_pruss...
 *
 * cat /etc/modprobe.d/pruss-blacklist.conf
 * blacklist pruss
 * blacklist pruss_intc
 * blacklist pru-rproc
 *
 */

/dts-v1/;
/plugin/;

/ {
	compatible = "ti,beaglebone", "ti,beaglebone-black", "ti,beaglebone-green";

	// identification
	part-number = "am33xx_pruss_uio";
	version = "00A0";

	fragment@0 {
		target = <&pruss>;
		__overlay__ {
			status = "okay";

			compatible = "ti,pruss-v2";
			ti,deassert-hard-reset = "pruss", "pruss";
			reg = <0x4a300000 0x080000>;
			ti,pintc-offset = <0x20000>;
			interrupt-parent = <&intc>;
			interrupts = <20 21 22 23 24 25 26 27>;
		};
	};
};
