/*
 * Copyright (C) 2019 Robert Nelson <robertcnelson@gmail.com>
 *
 * This program is free software; you can redistribute it and/or modify
 * it under the terms of the GNU General Public License version 2 as
 * published by the Free Software Foundation.
 */

/dts-v1/;
/plugin/;

/ {
	fragment@0 {
		target = <&i2c1>;
		__overlay__ {
			status = "okay";

			clock-frequency = <400000>;

			#address-cells = <1>;
			#size-cells = <0>;
		};
	};
};
