
/* P1_02 (ZCZ ball R5) lcd_hsync */
P1_02_default_pin: pinmux_P1_02_default_pin { pinctrl-single,pins = <
	AM33XX_IOPAD(0x08e4, PIN_OUTPUT_PULLDOWN | INPUT_EN | MUX_MODE7) >; };	/* Mode 7, Pull-Down, RxActive */
P1_02_gpio_pin: pinmux_P1_02_gpio_pin { pinctrl-single,pins = <
	AM33XX_IOPAD(0x08e4, PIN_OUTPUT | INPUT_EN | MUX_MODE7) >; };	/* Mode 7, RxActive */
P1_02_gpio_pu_pin: pinmux_P1_02_gpio_pu_pin { pinctrl-single,pins = <
	AM33XX_IOPAD(0x08e4, PIN_OUTPUT_PULLUP | INPUT_EN | MUX_MODE7) >; };	/* Mode 7, Pull-Up, RxActive */
P1_02_gpio_pd_pin: pinmux_P1_02_gpio_pd_pin { pinctrl-single,pins = <
	AM33XX_IOPAD(0x08e4, PIN_OUTPUT_PULLDOWN | INPUT_EN | MUX_MODE7) >; };	/* Mode 7, Pull-Down, RxActive */
P1_02_pruout_pin: pinmux_P1_02_pruout_pin { pinctrl-single,pins = <
	AM33XX_IOPAD(0x08e4, PIN_OUTPUT_PULLDOWN | INPUT_EN | MUX_MODE5) >; };	/* Mode 5, Pull-Down, RxActive */
P1_02_pruin_pin: pinmux_P1_02_pruin_pin { pinctrl-single,pins = <
	AM33XX_IOPAD(0x08e4, PIN_OUTPUT_PULLDOWN | INPUT_EN | MUX_MODE6) >; };	/* Mode 6, Pull-Down, RxActive */

/* P1_04 (ZCZ ball R6) lcd_ac_bias_en */
P1_04_default_pin: pinmux_P1_04_default_pin { pinctrl-single,pins = <
	AM33XX_IOPAD(0x08ec, PIN_OUTPUT_PULLDOWN | INPUT_EN | MUX_MODE7) >; };	/* Mode 7, Pull-Down, RxActive */
P1_04_gpio_pin: pinmux_P1_04_gpio_pin { pinctrl-single,pins = <
	AM33XX_IOPAD(0x08ec, PIN_OUTPUT | INPUT_EN | MUX_MODE7) >; };	/* Mode 7, RxActive */
P1_04_gpio_pu_pin: pinmux_P1_04_gpio_pu_pin { pinctrl-single,pins = <
	AM33XX_IOPAD(0x08ec, PIN_OUTPUT_PULLUP | INPUT_EN | MUX_MODE7) >; };	/* Mode 7, Pull-Up, RxActive */
P1_04_gpio_pd_pin: pinmux_P1_04_gpio_pd_pin { pinctrl-single,pins = <
	AM33XX_IOPAD(0x08ec, PIN_OUTPUT_PULLDOWN | INPUT_EN | MUX_MODE7) >; };	/* Mode 7, Pull-Down, RxActive */
P1_04_pruout_pin: pinmux_P1_04_pruout_pin { pinctrl-single,pins = <
	AM33XX_IOPAD(0x08ec, PIN_OUTPUT_PULLDOWN | INPUT_EN | MUX_MODE5) >; };	/* Mode 5, Pull-Down, RxActive */
P1_04_pruin_pin: pinmux_P1_04_pruin_pin { pinctrl-single,pins = <
	AM33XX_IOPAD(0x08ec, PIN_OUTPUT_PULLDOWN | INPUT_EN | MUX_MODE6) >; };	/* Mode 6, Pull-Down, RxActive */

/* P1_06 (ZCZ ball A16) spi0_cs0 */
P1_06_default_pin: pinmux_P1_06_default_pin { pinctrl-single,pins = <
	AM33XX_IOPAD(0x095c, PIN_OUTPUT_PULLDOWN | INPUT_EN | MUX_MODE7) >; };	/* Mode 7, Pull-Down, RxActive */
P1_06_gpio_pin: pinmux_P1_06_gpio_pin { pinctrl-single,pins = <
	AM33XX_IOPAD(0x095c, PIN_OUTPUT | INPUT_EN | MUX_MODE7) >; };	/* Mode 7, RxActive */
P1_06_gpio_pu_pin: pinmux_P1_06_gpio_pu_pin { pinctrl-single,pins = <
	AM33XX_IOPAD(0x095c, PIN_OUTPUT_PULLUP | INPUT_EN | MUX_MODE7) >; };	/* Mode 7, Pull-Up, RxActive */
P1_06_gpio_pd_pin: pinmux_P1_06_gpio_pd_pin { pinctrl-single,pins = <
	AM33XX_IOPAD(0x095c, PIN_OUTPUT_PULLDOWN | INPUT_EN | MUX_MODE7) >; };	/* Mode 7, Pull-Down, RxActive */
P1_06_spi_pin: pinmux_P1_06_spi_pin { pinctrl-single,pins = <
	AM33XX_IOPAD(0x095c, PIN_OUTPUT_PULLUP | INPUT_EN | MUX_MODE0) >; };	/* Mode 0, Pull-Up, RxActive */
P1_06_i2c_pin: pinmux_P1_06_i2c_pin { pinctrl-single,pins = <
	AM33XX_IOPAD(0x095c, PIN_OUTPUT_PULLUP | INPUT_EN | MUX_MODE2) >; };	/* Mode 2, Pull-Up, RxActive */
P1_06_pru_uart_pin: pinmux_P1_06_pru_uart_pin { pinctrl-single,pins = <
	AM33XX_IOPAD(0x095c, PIN_OUTPUT_PULLUP | INPUT_EN | MUX_MODE4) >; };	/* Mode 4, Pull-Up, RxActive */
P1_06_pwm_pin: pinmux_P1_06_pwm_pin { pinctrl-single,pins = <
	AM33XX_IOPAD(0x095c, PIN_OUTPUT_PULLDOWN | INPUT_EN | MUX_MODE3) >; };	/* Mode 3, Pull-Down, RxActive */

/* P1_08 (ZCZ ball A17) spi0_sclk */
P1_08_default_pin: pinmux_P1_08_default_pin { pinctrl-single,pins = <
	AM33XX_IOPAD(0x0950, PIN_OUTPUT_PULLDOWN | INPUT_EN | MUX_MODE7) >; };	/* Mode 7, Pull-Down, RxActive */
P1_08_gpio_pin: pinmux_P1_08_gpio_pin { pinctrl-single,pins = <
	AM33XX_IOPAD(0x0950, PIN_OUTPUT | INPUT_EN | MUX_MODE7) >; };	/* Mode 7, RxActive */
P1_08_gpio_pu_pin: pinmux_P1_08_gpio_pu_pin { pinctrl-single,pins = <
	AM33XX_IOPAD(0x0950, PIN_OUTPUT_PULLUP | INPUT_EN | MUX_MODE7) >; };	/* Mode 7, Pull-Up, RxActive */
P1_08_gpio_pd_pin: pinmux_P1_08_gpio_pd_pin { pinctrl-single,pins = <
	AM33XX_IOPAD(0x0950, PIN_OUTPUT_PULLDOWN | INPUT_EN | MUX_MODE7) >; };	/* Mode 7, Pull-Down, RxActive */
P1_08_spi_pin: pinmux_P1_08_spi_pin { pinctrl-single,pins = <
	AM33XX_IOPAD(0x0950, PIN_OUTPUT_PULLUP | INPUT_EN | MUX_MODE0) >; };	/* Mode 0, Pull-Up, RxActive */
P1_08_i2c_pin: pinmux_P1_08_i2c_pin { pinctrl-single,pins = <
	AM33XX_IOPAD(0x0950, PIN_OUTPUT_PULLUP | INPUT_EN | MUX_MODE2) >; };	/* Mode 2, Pull-Up, RxActive */
P1_08_uart_pin: pinmux_P1_08_uart_pin { pinctrl-single,pins = <
	AM33XX_IOPAD(0x0950, PIN_OUTPUT_PULLDOWN | INPUT_EN | MUX_MODE1) >; };	/* Mode 1, Pull-Down, RxActive */
P1_08_pru_uart_pin: pinmux_P1_08_pru_uart_pin { pinctrl-single,pins = <
	AM33XX_IOPAD(0x0950, PIN_OUTPUT_PULLUP | INPUT_EN | MUX_MODE4) >; };	/* Mode 4, Pull-Up, RxActive */
P1_08_pwm_pin: pinmux_P1_08_pwm_pin { pinctrl-single,pins = <
	AM33XX_IOPAD(0x0950, PIN_OUTPUT_PULLDOWN | INPUT_EN | MUX_MODE3) >; };	/* Mode 3, Pull-Down, RxActive */

/* P1_10 (ZCZ ball B17) spi0_d0 */
P1_10_default_pin: pinmux_P1_10_default_pin { pinctrl-single,pins = <
	AM33XX_IOPAD(0x0954, PIN_OUTPUT_PULLDOWN | INPUT_EN | MUX_MODE7) >; };	/* Mode 7, Pull-Down, RxActive */
P1_10_gpio_pin: pinmux_P1_10_gpio_pin { pinctrl-single,pins = <
	AM33XX_IOPAD(0x0954, PIN_OUTPUT | INPUT_EN | MUX_MODE7) >; };	/* Mode 7, RxActive */
P1_10_gpio_pu_pin: pinmux_P1_10_gpio_pu_pin { pinctrl-single,pins = <
	AM33XX_IOPAD(0x0954, PIN_OUTPUT_PULLUP | INPUT_EN | MUX_MODE7) >; };	/* Mode 7, Pull-Up, RxActive */
P1_10_gpio_pd_pin: pinmux_P1_10_gpio_pd_pin { pinctrl-single,pins = <
	AM33XX_IOPAD(0x0954, PIN_OUTPUT_PULLDOWN | INPUT_EN | MUX_MODE7) >; };	/* Mode 7, Pull-Down, RxActive */
P1_10_spi_pin: pinmux_P1_10_spi_pin { pinctrl-single,pins = <
	AM33XX_IOPAD(0x0954, PIN_OUTPUT_PULLUP | INPUT_EN | MUX_MODE0) >; };	/* Mode 0, Pull-Up, RxActive */
P1_10_i2c_pin: pinmux_P1_10_i2c_pin { pinctrl-single,pins = <
	AM33XX_IOPAD(0x0954, PIN_OUTPUT_PULLUP | INPUT_EN | MUX_MODE2) >; };	/* Mode 2, Pull-Up, RxActive */
P1_10_uart_pin: pinmux_P1_10_uart_pin { pinctrl-single,pins = <
	AM33XX_IOPAD(0x0954, PIN_OUTPUT_PULLDOWN | INPUT_EN | MUX_MODE1) >; };	/* Mode 1, Pull-Down, RxActive */
P1_10_pru_uart_pin: pinmux_P1_10_pru_uart_pin { pinctrl-single,pins = <
	AM33XX_IOPAD(0x0954, PIN_OUTPUT_PULLUP | INPUT_EN | MUX_MODE4) >; };	/* Mode 4, Pull-Up, RxActive */
P1_10_pwm_pin: pinmux_P1_10_pwm_pin { pinctrl-single,pins = <
	AM33XX_IOPAD(0x0954, PIN_OUTPUT_PULLDOWN | INPUT_EN | MUX_MODE3) >; };	/* Mode 3, Pull-Down, RxActive */

/* P1_12 (ZCZ ball B16) spi0_d1 */
P1_12_default_pin: pinmux_P1_12_default_pin { pinctrl-single,pins = <
	AM33XX_IOPAD(0x0958, PIN_OUTPUT_PULLDOWN | INPUT_EN | MUX_MODE7) >; };	/* Mode 7, Pull-Down, RxActive */
P1_12_gpio_pin: pinmux_P1_12_gpio_pin { pinctrl-single,pins = <
	AM33XX_IOPAD(0x0958, PIN_OUTPUT | INPUT_EN | MUX_MODE7) >; };	/* Mode 7, RxActive */
P1_12_gpio_pu_pin: pinmux_P1_12_gpio_pu_pin { pinctrl-single,pins = <
	AM33XX_IOPAD(0x0958, PIN_OUTPUT_PULLUP | INPUT_EN | MUX_MODE7) >; };	/* Mode 7, Pull-Up, RxActive */
P1_12_gpio_pd_pin: pinmux_P1_12_gpio_pd_pin { pinctrl-single,pins = <
	AM33XX_IOPAD(0x0958, PIN_OUTPUT_PULLDOWN | INPUT_EN | MUX_MODE7) >; };	/* Mode 7, Pull-Down, RxActive */
P1_12_spi_pin: pinmux_P1_12_spi_pin { pinctrl-single,pins = <
	AM33XX_IOPAD(0x0958, PIN_OUTPUT_PULLUP | INPUT_EN | MUX_MODE0) >; };	/* Mode 0, Pull-Up, RxActive */
P1_12_i2c_pin: pinmux_P1_12_i2c_pin { pinctrl-single,pins = <
	AM33XX_IOPAD(0x0958, PIN_OUTPUT_PULLUP | INPUT_EN | MUX_MODE2) >; };	/* Mode 2, Pull-Up, RxActive */
P1_12_pru_uart_pin: pinmux_P1_12_pru_uart_pin { pinctrl-single,pins = <
	AM33XX_IOPAD(0x0958, PIN_OUTPUT_PULLUP | INPUT_EN | MUX_MODE4) >; };	/* Mode 4, Pull-Up, RxActive */
P1_12_pwm_pin: pinmux_P1_12_pwm_pin { pinctrl-single,pins = <
	AM33XX_IOPAD(0x0958, PIN_OUTPUT_PULLDOWN | INPUT_EN | MUX_MODE3) >; };	/* Mode 3, Pull-Down, RxActive */

/* P1_20 (ZCZ ball D14) xdma_event_intr1 */
P1_20_default_pin: pinmux_P1_20_default_pin { pinctrl-single,pins = <
	AM33XX_IOPAD(0x09b4, PIN_OUTPUT_PULLDOWN | INPUT_EN | MUX_MODE7) >; };	/* Mode 7, Pull-Down, RxActive */
P1_20_gpio_pin: pinmux_P1_20_gpio_pin { pinctrl-single,pins = <
	AM33XX_IOPAD(0x09b4, PIN_OUTPUT | INPUT_EN | MUX_MODE7) >; };	/* Mode 7, RxActive */
P1_20_gpio_pu_pin: pinmux_P1_20_gpio_pu_pin { pinctrl-single,pins = <
	AM33XX_IOPAD(0x09b4, PIN_OUTPUT_PULLUP | INPUT_EN | MUX_MODE7) >; };	/* Mode 7, Pull-Up, RxActive */
P1_20_gpio_pd_pin: pinmux_P1_20_gpio_pd_pin { pinctrl-single,pins = <
	AM33XX_IOPAD(0x09b4, PIN_OUTPUT_PULLDOWN | INPUT_EN | MUX_MODE7) >; };	/* Mode 7, Pull-Down, RxActive */
P1_20_timer_pin: pinmux_P1_20_timer_pin { pinctrl-single,pins = <
	AM33XX_IOPAD(0x09b4, PIN_OUTPUT_PULLUP | INPUT_EN | MUX_MODE4) >; };	/* Mode 4, Pull-Up, RxActive */
P1_20_pruin_pin: pinmux_P1_20_pruin_pin { pinctrl-single,pins = <
	AM33XX_IOPAD(0x09b4, PIN_OUTPUT_PULLDOWN | INPUT_EN | MUX_MODE5) >; };	/* Mode 5, Pull-Down, RxActive */

/* P1_26 (ZCZ ball D18) uart1_ctsn */
P1_26_default_pin: pinmux_P1_26_default_pin { pinctrl-single,pins = <
	AM33XX_IOPAD(0x0978, PIN_OUTPUT_PULLDOWN | INPUT_EN | MUX_MODE7) >; };	/* Mode 7, Pull-Down, RxActive */
P1_26_gpio_pin: pinmux_P1_26_gpio_pin { pinctrl-single,pins = <
	AM33XX_IOPAD(0x0978, PIN_OUTPUT | INPUT_EN | MUX_MODE7) >; };	/* Mode 7, RxActive */
P1_26_gpio_pu_pin: pinmux_P1_26_gpio_pu_pin { pinctrl-single,pins = <
	AM33XX_IOPAD(0x0978, PIN_OUTPUT_PULLUP | INPUT_EN | MUX_MODE7) >; };	/* Mode 7, Pull-Up, RxActive */
P1_26_gpio_pd_pin: pinmux_P1_26_gpio_pd_pin { pinctrl-single,pins = <
	AM33XX_IOPAD(0x0978, PIN_OUTPUT_PULLDOWN | INPUT_EN | MUX_MODE7) >; };	/* Mode 7, Pull-Down, RxActive */
P1_26_spi_pin: pinmux_P1_26_spi_pin { pinctrl-single,pins = <
	AM33XX_IOPAD(0x0978, PIN_OUTPUT_PULLUP | INPUT_EN | MUX_MODE4) >; };	/* Mode 4, Pull-Up, RxActive */
P1_26_i2c_pin: pinmux_P1_26_i2c_pin { pinctrl-single,pins = <
	AM33XX_IOPAD(0x0978, PIN_OUTPUT_PULLUP | INPUT_EN | MUX_MODE3) >; };	/* Mode 3, Pull-Up, RxActive */
P1_26_pru_uart_pin: pinmux_P1_26_pru_uart_pin { pinctrl-single,pins = <
	AM33XX_IOPAD(0x0978, PIN_OUTPUT_PULLUP | INPUT_EN | MUX_MODE5) >; };	/* Mode 5, Pull-Up, RxActive */
P1_26_timer_pin: pinmux_P1_26_timer_pin { pinctrl-single,pins = <
	AM33XX_IOPAD(0x0978, PIN_OUTPUT_PULLUP | INPUT_EN | MUX_MODE1) >; };	/* Mode 1, Pull-Up, RxActive */

/* P1_28 (ZCZ ball D17) uart1_rtsn */
P1_28_default_pin: pinmux_P1_28_default_pin { pinctrl-single,pins = <
	AM33XX_IOPAD(0x097c, PIN_OUTPUT_PULLDOWN | INPUT_EN | MUX_MODE7) >; };	/* Mode 7, Pull-Down, RxActive */
P1_28_gpio_pin: pinmux_P1_28_gpio_pin { pinctrl-single,pins = <
	AM33XX_IOPAD(0x097c, PIN_OUTPUT | INPUT_EN | MUX_MODE7) >; };	/* Mode 7, RxActive */
P1_28_gpio_pu_pin: pinmux_P1_28_gpio_pu_pin { pinctrl-single,pins = <
	AM33XX_IOPAD(0x097c, PIN_OUTPUT_PULLUP | INPUT_EN | MUX_MODE7) >; };	/* Mode 7, Pull-Up, RxActive */
P1_28_gpio_pd_pin: pinmux_P1_28_gpio_pd_pin { pinctrl-single,pins = <
	AM33XX_IOPAD(0x097c, PIN_OUTPUT_PULLDOWN | INPUT_EN | MUX_MODE7) >; };	/* Mode 7, Pull-Down, RxActive */
P1_28_spi_pin: pinmux_P1_28_spi_pin { pinctrl-single,pins = <
	AM33XX_IOPAD(0x097c, PIN_OUTPUT_PULLUP | INPUT_EN | MUX_MODE4) >; };	/* Mode 4, Pull-Up, RxActive */
P1_28_i2c_pin: pinmux_P1_28_i2c_pin { pinctrl-single,pins = <
	AM33XX_IOPAD(0x097c, PIN_OUTPUT_PULLUP | INPUT_EN | MUX_MODE3) >; };	/* Mode 3, Pull-Up, RxActive */
P1_28_pru_uart_pin: pinmux_P1_28_pru_uart_pin { pinctrl-single,pins = <
	AM33XX_IOPAD(0x097c, PIN_OUTPUT_PULLUP | INPUT_EN | MUX_MODE5) >; };	/* Mode 5, Pull-Up, RxActive */
P1_28_timer_pin: pinmux_P1_28_timer_pin { pinctrl-single,pins = <
	AM33XX_IOPAD(0x097c, PIN_OUTPUT_PULLUP | INPUT_EN | MUX_MODE1) >; };	/* Mode 1, Pull-Up, RxActive */

/* P1_29 (ZCZ ball A14) mcasp0_ahclkx */
P1_29_default_pin: pinmux_P1_29_default_pin { pinctrl-single,pins = <
	AM33XX_IOPAD(0x09ac, PIN_OUTPUT_PULLDOWN | INPUT_EN | MUX_MODE7) >; };	/* Mode 7, Pull-Down, RxActive */
P1_29_gpio_pin: pinmux_P1_29_gpio_pin { pinctrl-single,pins = <
	AM33XX_IOPAD(0x09ac, PIN_OUTPUT | INPUT_EN | MUX_MODE7) >; };	/* Mode 7, RxActive */
P1_29_gpio_pu_pin: pinmux_P1_29_gpio_pu_pin { pinctrl-single,pins = <
	AM33XX_IOPAD(0x09ac, PIN_OUTPUT_PULLUP | INPUT_EN | MUX_MODE7) >; };	/* Mode 7, Pull-Up, RxActive */
P1_29_gpio_pd_pin: pinmux_P1_29_gpio_pd_pin { pinctrl-single,pins = <
	AM33XX_IOPAD(0x09ac, PIN_OUTPUT_PULLDOWN | INPUT_EN | MUX_MODE7) >; };	/* Mode 7, Pull-Down, RxActive */
P1_29_pruout_pin: pinmux_P1_29_pruout_pin { pinctrl-single,pins = <
	AM33XX_IOPAD(0x09ac, PIN_OUTPUT_PULLDOWN | INPUT_EN | MUX_MODE5) >; };	/* Mode 5, Pull-Down, RxActive */
P1_29_pruin_pin: pinmux_P1_29_pruin_pin { pinctrl-single,pins = <
	AM33XX_IOPAD(0x09ac, PIN_OUTPUT_PULLDOWN | INPUT_EN | MUX_MODE6) >; };	/* Mode 6, Pull-Down, RxActive */
P1_29_qep_pin: pinmux_P1_29_qep_pin { pinctrl-single,pins = <
	AM33XX_IOPAD(0x09ac, PIN_OUTPUT_PULLDOWN | INPUT_EN | MUX_MODE1) >; };	/* Mode 1, Pull-Down, RxActive */

/* P1_30 (ZCZ ball E16) uart0_txd */
P1_30_default_pin: pinmux_P1_30_default_pin { pinctrl-single,pins = <
	AM33XX_IOPAD(0x0974, PIN_OUTPUT_PULLDOWN | INPUT_EN | MUX_MODE7) >; };	/* Mode 7, Pull-Down, RxActive */
P1_30_gpio_pin: pinmux_P1_30_gpio_pin { pinctrl-single,pins = <
	AM33XX_IOPAD(0x0974, PIN_OUTPUT | INPUT_EN | MUX_MODE7) >; };	/* Mode 7, RxActive */
P1_30_gpio_pu_pin: pinmux_P1_30_gpio_pu_pin { pinctrl-single,pins = <
	AM33XX_IOPAD(0x0974, PIN_OUTPUT_PULLUP | INPUT_EN | MUX_MODE7) >; };	/* Mode 7, Pull-Up, RxActive */
P1_30_gpio_pd_pin: pinmux_P1_30_gpio_pd_pin { pinctrl-single,pins = <
	AM33XX_IOPAD(0x0974, PIN_OUTPUT_PULLDOWN | INPUT_EN | MUX_MODE7) >; };	/* Mode 7, Pull-Down, RxActive */
P1_30_spi_pin: pinmux_P1_30_spi_pin { pinctrl-single,pins = <
	AM33XX_IOPAD(0x0974, PIN_OUTPUT_PULLUP | INPUT_EN | MUX_MODE1) >; };	/* Mode 1, Pull-Up, RxActive */
P1_30_i2c_pin: pinmux_P1_30_i2c_pin { pinctrl-single,pins = <
	AM33XX_IOPAD(0x0974, PIN_OUTPUT_PULLUP | INPUT_EN | MUX_MODE3) >; };	/* Mode 3, Pull-Up, RxActive */
P1_30_pruout_pin: pinmux_P1_30_pruout_pin { pinctrl-single,pins = <
	AM33XX_IOPAD(0x0974, PIN_OUTPUT_PULLDOWN | INPUT_EN | MUX_MODE5) >; };	/* Mode 5, Pull-Down, RxActive */
P1_30_pruin_pin: pinmux_P1_30_pruin_pin { pinctrl-single,pins = <
	AM33XX_IOPAD(0x0974, PIN_OUTPUT_PULLDOWN | INPUT_EN | MUX_MODE6) >; };	/* Mode 6, Pull-Down, RxActive */

/* P1_31 (ZCZ ball B12) mcasp0_aclkr */
P1_31_default_pin: pinmux_P1_31_default_pin { pinctrl-single,pins = <
	AM33XX_IOPAD(0x09a0, PIN_OUTPUT_PULLDOWN | INPUT_EN | MUX_MODE7) >; };	/* Mode 7, Pull-Down, RxActive */
P1_31_gpio_pin: pinmux_P1_31_gpio_pin { pinctrl-single,pins = <
	AM33XX_IOPAD(0x09a0, PIN_OUTPUT | INPUT_EN | MUX_MODE7) >; };	/* Mode 7, RxActive */
P1_31_gpio_pu_pin: pinmux_P1_31_gpio_pu_pin { pinctrl-single,pins = <
	AM33XX_IOPAD(0x09a0, PIN_OUTPUT_PULLUP | INPUT_EN | MUX_MODE7) >; };	/* Mode 7, Pull-Up, RxActive */
P1_31_gpio_pd_pin: pinmux_P1_31_gpio_pd_pin { pinctrl-single,pins = <
	AM33XX_IOPAD(0x09a0, PIN_OUTPUT_PULLDOWN | INPUT_EN | MUX_MODE7) >; };	/* Mode 7, Pull-Down, RxActive */
P1_31_pruout_pin: pinmux_P1_31_pruout_pin { pinctrl-single,pins = <
	AM33XX_IOPAD(0x09a0, PIN_OUTPUT_PULLDOWN | INPUT_EN | MUX_MODE5) >; };	/* Mode 5, Pull-Down, RxActive */
P1_31_pruin_pin: pinmux_P1_31_pruin_pin { pinctrl-single,pins = <
	AM33XX_IOPAD(0x09a0, PIN_OUTPUT_PULLDOWN | INPUT_EN | MUX_MODE6) >; };	/* Mode 6, Pull-Down, RxActive */
P1_31_qep_pin: pinmux_P1_31_qep_pin { pinctrl-single,pins = <
	AM33XX_IOPAD(0x09a0, PIN_OUTPUT_PULLDOWN | INPUT_EN | MUX_MODE1) >; };	/* Mode 1, Pull-Down, RxActive */

/* P1_32 (ZCZ ball E15) uart0_rxd */
P1_32_default_pin: pinmux_P1_32_default_pin { pinctrl-single,pins = <
	AM33XX_IOPAD(0x0970, PIN_OUTPUT_PULLDOWN | INPUT_EN | MUX_MODE7) >; };	/* Mode 7, Pull-Down, RxActive */
P1_32_gpio_pin: pinmux_P1_32_gpio_pin { pinctrl-single,pins = <
	AM33XX_IOPAD(0x0970, PIN_OUTPUT | INPUT_EN | MUX_MODE7) >; };	/* Mode 7, RxActive */
P1_32_gpio_pu_pin: pinmux_P1_32_gpio_pu_pin { pinctrl-single,pins = <
	AM33XX_IOPAD(0x0970, PIN_OUTPUT_PULLUP | INPUT_EN | MUX_MODE7) >; };	/* Mode 7, Pull-Up, RxActive */
P1_32_gpio_pd_pin: pinmux_P1_32_gpio_pd_pin { pinctrl-single,pins = <
	AM33XX_IOPAD(0x0970, PIN_OUTPUT_PULLDOWN | INPUT_EN | MUX_MODE7) >; };	/* Mode 7, Pull-Down, RxActive */
P1_32_spi_pin: pinmux_P1_32_spi_pin { pinctrl-single,pins = <
	AM33XX_IOPAD(0x0970, PIN_OUTPUT_PULLUP | INPUT_EN | MUX_MODE1) >; };	/* Mode 1, Pull-Up, RxActive */
P1_32_i2c_pin: pinmux_P1_32_i2c_pin { pinctrl-single,pins = <
	AM33XX_IOPAD(0x0970, PIN_OUTPUT_PULLUP | INPUT_EN | MUX_MODE3) >; };	/* Mode 3, Pull-Up, RxActive */
P1_32_pruout_pin: pinmux_P1_32_pruout_pin { pinctrl-single,pins = <
	AM33XX_IOPAD(0x0970, PIN_OUTPUT_PULLDOWN | INPUT_EN | MUX_MODE5) >; };	/* Mode 5, Pull-Down, RxActive */
P1_32_pruin_pin: pinmux_P1_32_pruin_pin { pinctrl-single,pins = <
	AM33XX_IOPAD(0x0970, PIN_OUTPUT_PULLDOWN | INPUT_EN | MUX_MODE6) >; };	/* Mode 6, Pull-Down, RxActive */

/* P1_33 (ZCZ ball B13) mcasp0_fsx */
P1_33_default_pin: pinmux_P1_33_default_pin { pinctrl-single,pins = <
	AM33XX_IOPAD(0x0994, PIN_OUTPUT_PULLDOWN | INPUT_EN | MUX_MODE7) >; };	/* Mode 7, Pull-Down, RxActive */
P1_33_gpio_pin: pinmux_P1_33_gpio_pin { pinctrl-single,pins = <
	AM33XX_IOPAD(0x0994, PIN_OUTPUT | INPUT_EN | MUX_MODE7) >; };	/* Mode 7, RxActive */
P1_33_gpio_pu_pin: pinmux_P1_33_gpio_pu_pin { pinctrl-single,pins = <
	AM33XX_IOPAD(0x0994, PIN_OUTPUT_PULLUP | INPUT_EN | MUX_MODE7) >; };	/* Mode 7, Pull-Up, RxActive */
P1_33_gpio_pd_pin: pinmux_P1_33_gpio_pd_pin { pinctrl-single,pins = <
	AM33XX_IOPAD(0x0994, PIN_OUTPUT_PULLDOWN | INPUT_EN | MUX_MODE7) >; };	/* Mode 7, Pull-Down, RxActive */
P1_33_spi_pin: pinmux_P1_33_spi_pin { pinctrl-single,pins = <
	AM33XX_IOPAD(0x0994, PIN_OUTPUT_PULLUP | INPUT_EN | MUX_MODE3) >; };	/* Mode 3, Pull-Up, RxActive */
P1_33_pruout_pin: pinmux_P1_33_pruout_pin { pinctrl-single,pins = <
	AM33XX_IOPAD(0x0994, PIN_OUTPUT_PULLDOWN | INPUT_EN | MUX_MODE5) >; };	/* Mode 5, Pull-Down, RxActive */
P1_33_pruin_pin: pinmux_P1_33_pruin_pin { pinctrl-single,pins = <
	AM33XX_IOPAD(0x0994, PIN_OUTPUT_PULLDOWN | INPUT_EN | MUX_MODE6) >; };	/* Mode 6, Pull-Down, RxActive */
P1_33_pwm_pin: pinmux_P1_33_pwm_pin { pinctrl-single,pins = <
	AM33XX_IOPAD(0x0994, PIN_OUTPUT_PULLDOWN | INPUT_EN | MUX_MODE1) >; };	/* Mode 1, Pull-Down, RxActive */

/* P1_34 (ZCZ ball T11) gpmc_ad10 */
P1_34_default_pin: pinmux_P1_34_default_pin { pinctrl-single,pins = <
	AM33XX_IOPAD(0x0828, PIN_OUTPUT_PULLDOWN | INPUT_EN | MUX_MODE7) >; };	/* Mode 7, Pull-Down, RxActive */
P1_34_gpio_pin: pinmux_P1_34_gpio_pin { pinctrl-single,pins = <
	AM33XX_IOPAD(0x0828, PIN_OUTPUT | INPUT_EN | MUX_MODE7) >; };	/* Mode 7, RxActive */
P1_34_gpio_pu_pin: pinmux_P1_34_gpio_pu_pin { pinctrl-single,pins = <
	AM33XX_IOPAD(0x0828, PIN_OUTPUT_PULLUP | INPUT_EN | MUX_MODE7) >; };	/* Mode 7, Pull-Up, RxActive */
P1_34_gpio_pd_pin: pinmux_P1_34_gpio_pd_pin { pinctrl-single,pins = <
	AM33XX_IOPAD(0x0828, PIN_OUTPUT_PULLDOWN | INPUT_EN | MUX_MODE7) >; };	/* Mode 7, Pull-Down, RxActive */
P1_34_pwm_pin: pinmux_P1_34_pwm_pin { pinctrl-single,pins = <
	AM33XX_IOPAD(0x0828, PIN_OUTPUT_PULLDOWN | INPUT_EN | MUX_MODE4) >; };	/* Mode 4, Pull-Down, RxActive */

/* P1_35 (ZCZ ball V5) lcd_pclk */
P1_35_default_pin: pinmux_P1_35_default_pin { pinctrl-single,pins = <
	AM33XX_IOPAD(0x08e8, PIN_OUTPUT_PULLDOWN | INPUT_EN | MUX_MODE7) >; };	/* Mode 7, Pull-Down, RxActive */
P1_35_gpio_pin: pinmux_P1_35_gpio_pin { pinctrl-single,pins = <
	AM33XX_IOPAD(0x08e8, PIN_OUTPUT | INPUT_EN | MUX_MODE7) >; };	/* Mode 7, RxActive */
P1_35_gpio_pu_pin: pinmux_P1_35_gpio_pu_pin { pinctrl-single,pins = <
	AM33XX_IOPAD(0x08e8, PIN_OUTPUT_PULLUP | INPUT_EN | MUX_MODE7) >; };	/* Mode 7, Pull-Up, RxActive */
P1_35_gpio_pd_pin: pinmux_P1_35_gpio_pd_pin { pinctrl-single,pins = <
	AM33XX_IOPAD(0x08e8, PIN_OUTPUT_PULLDOWN | INPUT_EN | MUX_MODE7) >; };	/* Mode 7, Pull-Down, RxActive */
P1_35_pruout_pin: pinmux_P1_35_pruout_pin { pinctrl-single,pins = <
	AM33XX_IOPAD(0x08e8, PIN_OUTPUT_PULLDOWN | INPUT_EN | MUX_MODE5) >; };	/* Mode 5, Pull-Down, RxActive */
P1_35_pruin_pin: pinmux_P1_35_pruin_pin { pinctrl-single,pins = <
	AM33XX_IOPAD(0x08e8, PIN_OUTPUT_PULLDOWN | INPUT_EN | MUX_MODE6) >; };	/* Mode 6, Pull-Down, RxActive */

/* P1_36 (ZCZ ball A13) mcasp0_aclkx */
P1_36_default_pin: pinmux_P1_36_default_pin { pinctrl-single,pins = <
	AM33XX_IOPAD(0x0990, PIN_OUTPUT_PULLDOWN | INPUT_EN | MUX_MODE7) >; };	/* Mode 7, Pull-Down, RxActive */
P1_36_gpio_pin: pinmux_P1_36_gpio_pin { pinctrl-single,pins = <
	AM33XX_IOPAD(0x0990, PIN_OUTPUT | INPUT_EN | MUX_MODE7) >; };	/* Mode 7, RxActive */
P1_36_gpio_pu_pin: pinmux_P1_36_gpio_pu_pin { pinctrl-single,pins = <
	AM33XX_IOPAD(0x0990, PIN_OUTPUT_PULLUP | INPUT_EN | MUX_MODE7) >; };	/* Mode 7, Pull-Up, RxActive */
P1_36_gpio_pd_pin: pinmux_P1_36_gpio_pd_pin { pinctrl-single,pins = <
	AM33XX_IOPAD(0x0990, PIN_OUTPUT_PULLDOWN | INPUT_EN | MUX_MODE7) >; };	/* Mode 7, Pull-Down, RxActive */
P1_36_spi_pin: pinmux_P1_36_spi_pin { pinctrl-single,pins = <
	AM33XX_IOPAD(0x0990, PIN_OUTPUT_PULLUP | INPUT_EN | MUX_MODE3) >; };	/* Mode 3, Pull-Up, RxActive */
P1_36_pruout_pin: pinmux_P1_36_pruout_pin { pinctrl-single,pins = <
	AM33XX_IOPAD(0x0990, PIN_OUTPUT_PULLDOWN | INPUT_EN | MUX_MODE5) >; };	/* Mode 5, Pull-Down, RxActive */
P1_36_pruin_pin: pinmux_P1_36_pruin_pin { pinctrl-single,pins = <
	AM33XX_IOPAD(0x0990, PIN_OUTPUT_PULLDOWN | INPUT_EN | MUX_MODE6) >; };	/* Mode 6, Pull-Down, RxActive */
P1_36_pwm_pin: pinmux_P1_36_pwm_pin { pinctrl-single,pins = <
	AM33XX_IOPAD(0x0990, PIN_OUTPUT_PULLDOWN | INPUT_EN | MUX_MODE1) >; };	/* Mode 1, Pull-Down, RxActive */


/* P2_01 (ZCZ ball U14) gpmc_a2 */
P2_01_default_pin: pinmux_P2_01_default_pin { pinctrl-single,pins = <
	AM33XX_IOPAD(0x0848, PIN_OUTPUT_PULLDOWN | INPUT_EN | MUX_MODE7) >; };	/* Mode 7, Pull-Down, RxActive */
P2_01_gpio_pin: pinmux_P2_01_gpio_pin { pinctrl-single,pins = <
	AM33XX_IOPAD(0x0848, PIN_OUTPUT | INPUT_EN | MUX_MODE7) >; };	/* Mode 7, RxActive */
P2_01_gpio_pu_pin: pinmux_P2_01_gpio_pu_pin { pinctrl-single,pins = <
	AM33XX_IOPAD(0x0848, PIN_OUTPUT_PULLUP | INPUT_EN | MUX_MODE7) >; };	/* Mode 7, Pull-Up, RxActive */
P2_01_gpio_pd_pin: pinmux_P2_01_gpio_pd_pin { pinctrl-single,pins = <
	AM33XX_IOPAD(0x0848, PIN_OUTPUT_PULLDOWN | INPUT_EN | MUX_MODE7) >; };	/* Mode 7, Pull-Down, RxActive */
P2_01_pwm_pin: pinmux_P2_01_pwm_pin { pinctrl-single,pins = <
	AM33XX_IOPAD(0x0848, PIN_OUTPUT_PULLDOWN | INPUT_EN | MUX_MODE6) >; };	/* Mode 6, Pull-Down, RxActive */

/* P2_02 (ZCZ ball V17) gpmc_a11 */
P2_02_default_pin: pinmux_P2_02_default_pin { pinctrl-single,pins = <
	AM33XX_IOPAD(0x086c, PIN_OUTPUT_PULLDOWN | INPUT_EN | MUX_MODE7) >; };	/* Mode 7, Pull-Down, RxActive */
P2_02_gpio_pin: pinmux_P2_02_gpio_pin { pinctrl-single,pins = <
	AM33XX_IOPAD(0x086c, PIN_OUTPUT | INPUT_EN | MUX_MODE7) >; };	/* Mode 7, RxActive */
P2_02_gpio_pu_pin: pinmux_P2_02_gpio_pu_pin { pinctrl-single,pins = <
	AM33XX_IOPAD(0x086c, PIN_OUTPUT_PULLUP | INPUT_EN | MUX_MODE7) >; };	/* Mode 7, Pull-Up, RxActive */
P2_02_gpio_pd_pin: pinmux_P2_02_gpio_pd_pin { pinctrl-single,pins = <
	AM33XX_IOPAD(0x086c, PIN_OUTPUT_PULLDOWN | INPUT_EN | MUX_MODE7) >; };	/* Mode 7, Pull-Down, RxActive */

/* P2_03 (ZCZ ball T10) gpmc_ad9 */
P2_03_default_pin: pinmux_P2_03_default_pin { pinctrl-single,pins = <
	AM33XX_IOPAD(0x0824, PIN_OUTPUT_PULLDOWN | INPUT_EN | MUX_MODE7) >; };	/* Mode 7, Pull-Down, RxActive */
P2_03_gpio_pin: pinmux_P2_03_gpio_pin { pinctrl-single,pins = <
	AM33XX_IOPAD(0x0824, PIN_OUTPUT | INPUT_EN | MUX_MODE7) >; };	/* Mode 7, RxActive */
P2_03_gpio_pu_pin: pinmux_P2_03_gpio_pu_pin { pinctrl-single,pins = <
	AM33XX_IOPAD(0x0824, PIN_OUTPUT_PULLUP | INPUT_EN | MUX_MODE7) >; };	/* Mode 7, Pull-Up, RxActive */
P2_03_gpio_pd_pin: pinmux_P2_03_gpio_pd_pin { pinctrl-single,pins = <
	AM33XX_IOPAD(0x0824, PIN_OUTPUT_PULLDOWN | INPUT_EN | MUX_MODE7) >; };	/* Mode 7, Pull-Down, RxActive */
P2_03_pwm_pin: pinmux_P2_03_pwm_pin { pinctrl-single,pins = <
	AM33XX_IOPAD(0x0824, PIN_OUTPUT_PULLDOWN | INPUT_EN | MUX_MODE4) >; };	/* Mode 4, Pull-Down, RxActive */

/* P2_04 (ZCZ ball T16) gpmc_a10 */
P2_04_default_pin: pinmux_P2_04_default_pin { pinctrl-single,pins = <
	AM33XX_IOPAD(0x0868, PIN_OUTPUT_PULLDOWN | INPUT_EN | MUX_MODE7) >; };	/* Mode 7, Pull-Down, RxActive */
P2_04_gpio_pin: pinmux_P2_04_gpio_pin { pinctrl-single,pins = <
	AM33XX_IOPAD(0x0868, PIN_OUTPUT | INPUT_EN | MUX_MODE7) >; };	/* Mode 7, RxActive */
P2_04_gpio_pu_pin: pinmux_P2_04_gpio_pu_pin { pinctrl-single,pins = <
	AM33XX_IOPAD(0x0868, PIN_OUTPUT_PULLUP | INPUT_EN | MUX_MODE7) >; };	/* Mode 7, Pull-Up, RxActive */
P2_04_gpio_pd_pin: pinmux_P2_04_gpio_pd_pin { pinctrl-single,pins = <
	AM33XX_IOPAD(0x0868, PIN_OUTPUT_PULLDOWN | INPUT_EN | MUX_MODE7) >; };	/* Mode 7, Pull-Down, RxActive */

/* P2_05 (ZCZ ball T17) gpmc_wait0 */
P2_05_default_pin: pinmux_P2_05_default_pin { pinctrl-single,pins = <
	AM33XX_IOPAD(0x0870, PIN_OUTPUT_PULLDOWN | INPUT_EN | MUX_MODE7) >; };	/* Mode 7, Pull-Down, RxActive */
P2_05_gpio_pin: pinmux_P2_05_gpio_pin { pinctrl-single,pins = <
	AM33XX_IOPAD(0x0870, PIN_OUTPUT | INPUT_EN | MUX_MODE7) >; };	/* Mode 7, RxActive */
P2_05_gpio_pu_pin: pinmux_P2_05_gpio_pu_pin { pinctrl-single,pins = <
	AM33XX_IOPAD(0x0870, PIN_OUTPUT_PULLUP | INPUT_EN | MUX_MODE7) >; };	/* Mode 7, Pull-Up, RxActive */
P2_05_gpio_pd_pin: pinmux_P2_05_gpio_pd_pin { pinctrl-single,pins = <
	AM33XX_IOPAD(0x0870, PIN_OUTPUT_PULLDOWN | INPUT_EN | MUX_MODE7) >; };	/* Mode 7, Pull-Down, RxActive */
P2_05_uart_pin: pinmux_P2_05_uart_pin { pinctrl-single,pins = <
	AM33XX_IOPAD(0x0870, PIN_OUTPUT_PULLDOWN | INPUT_EN | MUX_MODE6) >; };	/* Mode 6, Pull-Down, RxActive */

/* P2_06 (ZCZ ball U16) gpmc_a9 */
P2_06_default_pin: pinmux_P2_06_default_pin { pinctrl-single,pins = <
	AM33XX_IOPAD(0x0864, PIN_OUTPUT_PULLDOWN | INPUT_EN | MUX_MODE7) >; };	/* Mode 7, Pull-Down, RxActive */
P2_06_gpio_pin: pinmux_P2_06_gpio_pin { pinctrl-single,pins = <
	AM33XX_IOPAD(0x0864, PIN_OUTPUT | INPUT_EN | MUX_MODE7) >; };	/* Mode 7, RxActive */
P2_06_gpio_pu_pin: pinmux_P2_06_gpio_pu_pin { pinctrl-single,pins = <
	AM33XX_IOPAD(0x0864, PIN_OUTPUT_PULLUP | INPUT_EN | MUX_MODE7) >; };	/* Mode 7, Pull-Up, RxActive */
P2_06_gpio_pd_pin: pinmux_P2_06_gpio_pd_pin { pinctrl-single,pins = <
	AM33XX_IOPAD(0x0864, PIN_OUTPUT_PULLDOWN | INPUT_EN | MUX_MODE7) >; };	/* Mode 7, Pull-Down, RxActive */

/* P2_07 (ZCZ ball U17) gpmc_wpn */
P2_07_default_pin: pinmux_P2_07_default_pin { pinctrl-single,pins = <
	AM33XX_IOPAD(0x0874, PIN_OUTPUT_PULLDOWN | INPUT_EN | MUX_MODE7) >; };	/* Mode 7, Pull-Down, RxActive */
P2_07_gpio_pin: pinmux_P2_07_gpio_pin { pinctrl-single,pins = <
	AM33XX_IOPAD(0x0874, PIN_OUTPUT | INPUT_EN | MUX_MODE7) >; };	/* Mode 7, RxActive */
P2_07_gpio_pu_pin: pinmux_P2_07_gpio_pu_pin { pinctrl-single,pins = <
	AM33XX_IOPAD(0x0874, PIN_OUTPUT_PULLUP | INPUT_EN | MUX_MODE7) >; };	/* Mode 7, Pull-Up, RxActive */
P2_07_gpio_pd_pin: pinmux_P2_07_gpio_pd_pin { pinctrl-single,pins = <
	AM33XX_IOPAD(0x0874, PIN_OUTPUT_PULLDOWN | INPUT_EN | MUX_MODE7) >; };	/* Mode 7, Pull-Down, RxActive */
P2_07_uart_pin: pinmux_P2_07_uart_pin { pinctrl-single,pins = <
	AM33XX_IOPAD(0x0874, PIN_OUTPUT_PULLDOWN | INPUT_EN | MUX_MODE6) >; };	/* Mode 6, Pull-Down, RxActive */

/* P2_08 (ZCZ ball U18) gpmc_be1n */
P2_08_default_pin: pinmux_P2_08_default_pin { pinctrl-single,pins = <
	AM33XX_IOPAD(0x0878, PIN_OUTPUT_PULLDOWN | INPUT_EN | MUX_MODE7) >; };	/* Mode 7, Pull-Down, RxActive */
P2_08_gpio_pin: pinmux_P2_08_gpio_pin { pinctrl-single,pins = <
	AM33XX_IOPAD(0x0878, PIN_OUTPUT | INPUT_EN | MUX_MODE7) >; };	/* Mode 7, RxActive */
P2_08_gpio_pu_pin: pinmux_P2_08_gpio_pu_pin { pinctrl-single,pins = <
	AM33XX_IOPAD(0x0878, PIN_OUTPUT_PULLUP | INPUT_EN | MUX_MODE7) >; };	/* Mode 7, Pull-Up, RxActive */
P2_08_gpio_pd_pin: pinmux_P2_08_gpio_pd_pin { pinctrl-single,pins = <
	AM33XX_IOPAD(0x0878, PIN_OUTPUT_PULLDOWN | INPUT_EN | MUX_MODE7) >; };	/* Mode 7, Pull-Down, RxActive */

/* P2_09 (ZCZ ball D15) uart1_txd */
P2_09_default_pin: pinmux_P2_09_default_pin { pinctrl-single,pins = <
	AM33XX_IOPAD(0x0984, PIN_OUTPUT_PULLDOWN | INPUT_EN | MUX_MODE7) >; };	/* Mode 7, Pull-Down, RxActive */
P2_09_gpio_pin: pinmux_P2_09_gpio_pin { pinctrl-single,pins = <
	AM33XX_IOPAD(0x0984, PIN_OUTPUT | INPUT_EN | MUX_MODE7) >; };	/* Mode 7, RxActive */
P2_09_gpio_pu_pin: pinmux_P2_09_gpio_pu_pin { pinctrl-single,pins = <
	AM33XX_IOPAD(0x0984, PIN_OUTPUT_PULLUP | INPUT_EN | MUX_MODE7) >; };	/* Mode 7, Pull-Up, RxActive */
P2_09_gpio_pd_pin: pinmux_P2_09_gpio_pd_pin { pinctrl-single,pins = <
	AM33XX_IOPAD(0x0984, PIN_OUTPUT_PULLDOWN | INPUT_EN | MUX_MODE7) >; };	/* Mode 7, Pull-Down, RxActive */
P2_09_i2c_pin: pinmux_P2_09_i2c_pin { pinctrl-single,pins = <
	AM33XX_IOPAD(0x0984, PIN_OUTPUT_PULLUP | INPUT_EN | MUX_MODE3) >; };	/* Mode 3, Pull-Up, RxActive */
P2_09_uart_pin: pinmux_P2_09_uart_pin { pinctrl-single,pins = <
	AM33XX_IOPAD(0x0984, PIN_OUTPUT_PULLDOWN | INPUT_EN | MUX_MODE0) >; };	/* Mode 0, Pull-Down, RxActive */
P2_09_can_pin: pinmux_P2_09_can_pin { pinctrl-single,pins = <
	AM33XX_IOPAD(0x0984, PIN_OUTPUT_PULLUP | INPUT_EN | MUX_MODE2) >; };	/* Mode 2, Pull-Up, RxActive */
P2_09_pru_uart_pin: pinmux_P2_09_pru_uart_pin { pinctrl-single,pins = <
	AM33XX_IOPAD(0x0984, PIN_OUTPUT_PULLUP | INPUT_EN | MUX_MODE5) >; };	/* Mode 5, Pull-Up, RxActive */
P2_09_pruin_pin: pinmux_P2_09_pruin_pin { pinctrl-single,pins = <
	AM33XX_IOPAD(0x0984, PIN_OUTPUT_PULLDOWN | INPUT_EN | MUX_MODE6) >; };	/* Mode 6, Pull-Down, RxActive */

/* P2_10 (ZCZ ball R14) gpmc_a4 */
P2_10_default_pin: pinmux_P2_10_default_pin { pinctrl-single,pins = <
	AM33XX_IOPAD(0x0850, PIN_OUTPUT_PULLDOWN | INPUT_EN | MUX_MODE7) >; };	/* Mode 7, Pull-Down, RxActive */
P2_10_gpio_pin: pinmux_P2_10_gpio_pin { pinctrl-single,pins = <
	AM33XX_IOPAD(0x0850, PIN_OUTPUT | INPUT_EN | MUX_MODE7) >; };	/* Mode 7, RxActive */
P2_10_gpio_pu_pin: pinmux_P2_10_gpio_pu_pin { pinctrl-single,pins = <
	AM33XX_IOPAD(0x0850, PIN_OUTPUT_PULLUP | INPUT_EN | MUX_MODE7) >; };	/* Mode 7, Pull-Up, RxActive */
P2_10_gpio_pd_pin: pinmux_P2_10_gpio_pd_pin { pinctrl-single,pins = <
	AM33XX_IOPAD(0x0850, PIN_OUTPUT_PULLDOWN | INPUT_EN | MUX_MODE7) >; };	/* Mode 7, Pull-Down, RxActive */
P2_10_qep_pin: pinmux_P2_10_qep_pin { pinctrl-single,pins = <
	AM33XX_IOPAD(0x0850, PIN_OUTPUT_PULLDOWN | INPUT_EN | MUX_MODE6) >; };	/* Mode 6, Pull-Down, RxActive */

/* P2_11 (ZCZ ball D16) uart1_rxd */
P2_11_default_pin: pinmux_P2_11_default_pin { pinctrl-single,pins = <
	AM33XX_IOPAD(0x0980, PIN_OUTPUT_PULLDOWN | INPUT_EN | MUX_MODE7) >; };	/* Mode 7, Pull-Down, RxActive */
P2_11_gpio_pin: pinmux_P2_11_gpio_pin { pinctrl-single,pins = <
	AM33XX_IOPAD(0x0980, PIN_OUTPUT | INPUT_EN | MUX_MODE7) >; };	/* Mode 7, RxActive */
P2_11_gpio_pu_pin: pinmux_P2_11_gpio_pu_pin { pinctrl-single,pins = <
	AM33XX_IOPAD(0x0980, PIN_OUTPUT_PULLUP | INPUT_EN | MUX_MODE7) >; };	/* Mode 7, Pull-Up, RxActive */
P2_11_gpio_pd_pin: pinmux_P2_11_gpio_pd_pin { pinctrl-single,pins = <
	AM33XX_IOPAD(0x0980, PIN_OUTPUT_PULLDOWN | INPUT_EN | MUX_MODE7) >; };	/* Mode 7, Pull-Down, RxActive */
P2_11_i2c_pin: pinmux_P2_11_i2c_pin { pinctrl-single,pins = <
	AM33XX_IOPAD(0x0980, PIN_OUTPUT_PULLUP | INPUT_EN | MUX_MODE3) >; };	/* Mode 3, Pull-Up, RxActive */
P2_11_uart_pin: pinmux_P2_11_uart_pin { pinctrl-single,pins = <
	AM33XX_IOPAD(0x0980, PIN_OUTPUT_PULLDOWN | INPUT_EN | MUX_MODE0) >; };	/* Mode 0, Pull-Down, RxActive */
P2_11_can_pin: pinmux_P2_11_can_pin { pinctrl-single,pins = <
	AM33XX_IOPAD(0x0980, PIN_OUTPUT_PULLUP | INPUT_EN | MUX_MODE2) >; };	/* Mode 2, Pull-Up, RxActive */
P2_11_pru_uart_pin: pinmux_P2_11_pru_uart_pin { pinctrl-single,pins = <
	AM33XX_IOPAD(0x0980, PIN_OUTPUT_PULLUP | INPUT_EN | MUX_MODE5) >; };	/* Mode 5, Pull-Up, RxActive */
P2_11_pruin_pin: pinmux_P2_11_pruin_pin { pinctrl-single,pins = <
	AM33XX_IOPAD(0x0980, PIN_OUTPUT_PULLDOWN | INPUT_EN | MUX_MODE6) >; };	/* Mode 6, Pull-Down, RxActive */

/* P2_17 (ZCZ ball V12) gpmc_clk */
P2_17_default_pin: pinmux_P2_17_default_pin { pinctrl-single,pins = <
	AM33XX_IOPAD(0x088c, PIN_OUTPUT_PULLDOWN | INPUT_EN | MUX_MODE7) >; };	/* Mode 7, Pull-Down, RxActive */
P2_17_gpio_pin: pinmux_P2_17_gpio_pin { pinctrl-single,pins = <
	AM33XX_IOPAD(0x088c, PIN_OUTPUT | INPUT_EN | MUX_MODE7) >; };	/* Mode 7, RxActive */
P2_17_gpio_pu_pin: pinmux_P2_17_gpio_pu_pin { pinctrl-single,pins = <
	AM33XX_IOPAD(0x088c, PIN_OUTPUT_PULLUP | INPUT_EN | MUX_MODE7) >; };	/* Mode 7, Pull-Up, RxActive */
P2_17_gpio_pd_pin: pinmux_P2_17_gpio_pd_pin { pinctrl-single,pins = <
	AM33XX_IOPAD(0x088c, PIN_OUTPUT_PULLDOWN | INPUT_EN | MUX_MODE7) >; };	/* Mode 7, Pull-Down, RxActive */

/* P2_18 (ZCZ ball U13) gpmc_ad15 */
P2_18_default_pin: pinmux_P2_18_default_pin { pinctrl-single,pins = <
	AM33XX_IOPAD(0x083c, PIN_OUTPUT_PULLDOWN | INPUT_EN | MUX_MODE7) >; };	/* Mode 7, Pull-Down, RxActive */
P2_18_gpio_pin: pinmux_P2_18_gpio_pin { pinctrl-single,pins = <
	AM33XX_IOPAD(0x083c, PIN_OUTPUT | INPUT_EN | MUX_MODE7) >; };	/* Mode 7, RxActive */
P2_18_gpio_pu_pin: pinmux_P2_18_gpio_pu_pin { pinctrl-single,pins = <
	AM33XX_IOPAD(0x083c, PIN_OUTPUT_PULLUP | INPUT_EN | MUX_MODE7) >; };	/* Mode 7, Pull-Up, RxActive */
P2_18_gpio_pd_pin: pinmux_P2_18_gpio_pd_pin { pinctrl-single,pins = <
	AM33XX_IOPAD(0x083c, PIN_OUTPUT_PULLDOWN | INPUT_EN | MUX_MODE7) >; };	/* Mode 7, Pull-Down, RxActive */
P2_18_pruin_pin: pinmux_P2_18_pruin_pin { pinctrl-single,pins = <
	AM33XX_IOPAD(0x083c, PIN_OUTPUT_PULLDOWN | INPUT_EN | MUX_MODE6) >; };	/* Mode 6, Pull-Down, RxActive */
P2_18_pru_ecap_pin: pinmux_P2_18_pru_ecap_pin { pinctrl-single,pins = <
	AM33XX_IOPAD(0x083c, PIN_OUTPUT_PULLDOWN | INPUT_EN | MUX_MODE5) >; };	/* Mode 5, Pull-Down, RxActive */
P2_18_qep_pin: pinmux_P2_18_qep_pin { pinctrl-single,pins = <
	AM33XX_IOPAD(0x083c, PIN_OUTPUT_PULLDOWN | INPUT_EN | MUX_MODE4) >; };	/* Mode 4, Pull-Down, RxActive */

/* P2_19 (ZCZ ball U12) gpmc_ad11 */
P2_19_default_pin: pinmux_P2_19_default_pin { pinctrl-single,pins = <
	AM33XX_IOPAD(0x082c, PIN_OUTPUT_PULLDOWN | INPUT_EN | MUX_MODE7) >; };	/* Mode 7, Pull-Down, RxActive */
P2_19_gpio_pin: pinmux_P2_19_gpio_pin { pinctrl-single,pins = <
	AM33XX_IOPAD(0x082c, PIN_OUTPUT | INPUT_EN | MUX_MODE7) >; };	/* Mode 7, RxActive */
P2_19_gpio_pu_pin: pinmux_P2_19_gpio_pu_pin { pinctrl-single,pins = <
	AM33XX_IOPAD(0x082c, PIN_OUTPUT_PULLUP | INPUT_EN | MUX_MODE7) >; };	/* Mode 7, Pull-Up, RxActive */
P2_19_gpio_pd_pin: pinmux_P2_19_gpio_pd_pin { pinctrl-single,pins = <
	AM33XX_IOPAD(0x082c, PIN_OUTPUT_PULLDOWN | INPUT_EN | MUX_MODE7) >; };	/* Mode 7, Pull-Down, RxActive */
P2_19_pwm_pin: pinmux_P2_19_pwm_pin { pinctrl-single,pins = <
	AM33XX_IOPAD(0x082c, PIN_OUTPUT_PULLDOWN | INPUT_EN | MUX_MODE4) >; };	/* Mode 4, Pull-Down, RxActive */

/* P2_20 (ZCZ ball T13) gpmc_csn3 */
P2_20_default_pin: pinmux_P2_20_default_pin { pinctrl-single,pins = <
	AM33XX_IOPAD(0x0888, PIN_OUTPUT_PULLDOWN | INPUT_EN | MUX_MODE7) >; };	/* Mode 7, Pull-Down, RxActive */
P2_20_gpio_pin: pinmux_P2_20_gpio_pin { pinctrl-single,pins = <
	AM33XX_IOPAD(0x0888, PIN_OUTPUT | INPUT_EN | MUX_MODE7) >; };	/* Mode 7, RxActive */
P2_20_gpio_pu_pin: pinmux_P2_20_gpio_pu_pin { pinctrl-single,pins = <
	AM33XX_IOPAD(0x0888, PIN_OUTPUT_PULLUP | INPUT_EN | MUX_MODE7) >; };	/* Mode 7, Pull-Up, RxActive */
P2_20_gpio_pd_pin: pinmux_P2_20_gpio_pd_pin { pinctrl-single,pins = <
	AM33XX_IOPAD(0x0888, PIN_OUTPUT_PULLDOWN | INPUT_EN | MUX_MODE7) >; };	/* Mode 7, Pull-Down, RxActive */

/* P2_22 (ZCZ ball V13) gpmc_ad14 */
P2_22_default_pin: pinmux_P2_22_default_pin { pinctrl-single,pins = <
	AM33XX_IOPAD(0x0838, PIN_OUTPUT_PULLDOWN | INPUT_EN | MUX_MODE7) >; };	/* Mode 7, Pull-Down, RxActive */
P2_22_gpio_pin: pinmux_P2_22_gpio_pin { pinctrl-single,pins = <
	AM33XX_IOPAD(0x0838, PIN_OUTPUT | INPUT_EN | MUX_MODE7) >; };	/* Mode 7, RxActive */
P2_22_gpio_pu_pin: pinmux_P2_22_gpio_pu_pin { pinctrl-single,pins = <
	AM33XX_IOPAD(0x0838, PIN_OUTPUT_PULLUP | INPUT_EN | MUX_MODE7) >; };	/* Mode 7, Pull-Up, RxActive */
P2_22_gpio_pd_pin: pinmux_P2_22_gpio_pd_pin { pinctrl-single,pins = <
	AM33XX_IOPAD(0x0838, PIN_OUTPUT_PULLDOWN | INPUT_EN | MUX_MODE7) >; };	/* Mode 7, Pull-Down, RxActive */
P2_22_pruin_pin: pinmux_P2_22_pruin_pin { pinctrl-single,pins = <
	AM33XX_IOPAD(0x0838, PIN_OUTPUT_PULLDOWN | INPUT_EN | MUX_MODE6) >; };	/* Mode 6, Pull-Down, RxActive */
P2_22_qep_pin: pinmux_P2_22_qep_pin { pinctrl-single,pins = <
	AM33XX_IOPAD(0x0838, PIN_OUTPUT_PULLDOWN | INPUT_EN | MUX_MODE4) >; };	/* Mode 4, Pull-Down, RxActive */

/* P2_24 (ZCZ ball R13) gpmc_a0 */
P2_24_default_pin: pinmux_P2_24_default_pin { pinctrl-single,pins = <
	AM33XX_IOPAD(0x0840, PIN_OUTPUT_PULLDOWN | INPUT_EN | MUX_MODE7) >; };	/* Mode 7, Pull-Down, RxActive */
P2_24_gpio_pin: pinmux_P2_24_gpio_pin { pinctrl-single,pins = <
	AM33XX_IOPAD(0x0840, PIN_OUTPUT | INPUT_EN | MUX_MODE7) >; };	/* Mode 7, RxActive */
P2_24_gpio_pu_pin: pinmux_P2_24_gpio_pu_pin { pinctrl-single,pins = <
	AM33XX_IOPAD(0x0840, PIN_OUTPUT_PULLUP | INPUT_EN | MUX_MODE7) >; };	/* Mode 7, Pull-Up, RxActive */
P2_24_gpio_pd_pin: pinmux_P2_24_gpio_pd_pin { pinctrl-single,pins = <
	AM33XX_IOPAD(0x0840, PIN_OUTPUT_PULLDOWN | INPUT_EN | MUX_MODE7) >; };	/* Mode 7, Pull-Down, RxActive */
P2_24_pwm_pin: pinmux_P2_24_pwm_pin { pinctrl-single,pins = <
	AM33XX_IOPAD(0x0840, PIN_OUTPUT_PULLDOWN | INPUT_EN | MUX_MODE6) >; };	/* Mode 6, Pull-Down, RxActive */

/* P2_25 (ZCZ ball E17) uart0_rtsn */
P2_25_default_pin: pinmux_P2_25_default_pin { pinctrl-single,pins = <
	AM33XX_IOPAD(0x096c, PIN_OUTPUT_PULLDOWN | INPUT_EN | MUX_MODE7) >; };	/* Mode 7, Pull-Down, RxActive */
P2_25_gpio_pin: pinmux_P2_25_gpio_pin { pinctrl-single,pins = <
	AM33XX_IOPAD(0x096c, PIN_OUTPUT | INPUT_EN | MUX_MODE7) >; };	/* Mode 7, RxActive */
P2_25_gpio_pu_pin: pinmux_P2_25_gpio_pu_pin { pinctrl-single,pins = <
	AM33XX_IOPAD(0x096c, PIN_OUTPUT_PULLUP | INPUT_EN | MUX_MODE7) >; };	/* Mode 7, Pull-Up, RxActive */
P2_25_gpio_pd_pin: pinmux_P2_25_gpio_pd_pin { pinctrl-single,pins = <
	AM33XX_IOPAD(0x096c, PIN_OUTPUT_PULLDOWN | INPUT_EN | MUX_MODE7) >; };	/* Mode 7, Pull-Down, RxActive */
P2_25_spi_pin: pinmux_P2_25_spi_pin { pinctrl-single,pins = <
	AM33XX_IOPAD(0x096c, PIN_OUTPUT_PULLUP | INPUT_EN | MUX_MODE5) >; };	/* Mode 5, Pull-Up, RxActive */
P2_25_i2c_pin: pinmux_P2_25_i2c_pin { pinctrl-single,pins = <
	AM33XX_IOPAD(0x096c, PIN_OUTPUT_PULLUP | INPUT_EN | MUX_MODE3) >; };	/* Mode 3, Pull-Up, RxActive */
P2_25_uart_pin: pinmux_P2_25_uart_pin { pinctrl-single,pins = <
	AM33XX_IOPAD(0x096c, PIN_OUTPUT_PULLDOWN | INPUT_EN | MUX_MODE1) >; };	/* Mode 1, Pull-Down, RxActive */
P2_25_can_pin: pinmux_P2_25_can_pin { pinctrl-single,pins = <
	AM33XX_IOPAD(0x096c, PIN_OUTPUT_PULLUP | INPUT_EN | MUX_MODE2) >; };	/* Mode 2, Pull-Up, RxActive */

/* P2_27 (ZCZ ball E18) uart0_ctsn */
P2_27_default_pin: pinmux_P2_27_default_pin { pinctrl-single,pins = <
	AM33XX_IOPAD(0x0968, PIN_OUTPUT_PULLDOWN | INPUT_EN | MUX_MODE7) >; };	/* Mode 7, Pull-Down, RxActive */
P2_27_gpio_pin: pinmux_P2_27_gpio_pin { pinctrl-single,pins = <
	AM33XX_IOPAD(0x0968, PIN_OUTPUT | INPUT_EN | MUX_MODE7) >; };	/* Mode 7, RxActive */
P2_27_gpio_pu_pin: pinmux_P2_27_gpio_pu_pin { pinctrl-single,pins = <
	AM33XX_IOPAD(0x0968, PIN_OUTPUT_PULLUP | INPUT_EN | MUX_MODE7) >; };	/* Mode 7, Pull-Up, RxActive */
P2_27_gpio_pd_pin: pinmux_P2_27_gpio_pd_pin { pinctrl-single,pins = <
	AM33XX_IOPAD(0x0968, PIN_OUTPUT_PULLDOWN | INPUT_EN | MUX_MODE7) >; };	/* Mode 7, Pull-Down, RxActive */
P2_27_spi_pin: pinmux_P2_27_spi_pin { pinctrl-single,pins = <
	AM33XX_IOPAD(0x0968, PIN_OUTPUT_PULLUP | INPUT_EN | MUX_MODE4) >; };	/* Mode 4, Pull-Up, RxActive */
P2_27_i2c_pin: pinmux_P2_27_i2c_pin { pinctrl-single,pins = <
	AM33XX_IOPAD(0x0968, PIN_OUTPUT_PULLUP | INPUT_EN | MUX_MODE3) >; };	/* Mode 3, Pull-Up, RxActive */
P2_27_uart_pin: pinmux_P2_27_uart_pin { pinctrl-single,pins = <
	AM33XX_IOPAD(0x0968, PIN_OUTPUT_PULLDOWN | INPUT_EN | MUX_MODE1) >; };	/* Mode 1, Pull-Down, RxActive */
P2_27_can_pin: pinmux_P2_27_can_pin { pinctrl-single,pins = <
	AM33XX_IOPAD(0x0968, PIN_OUTPUT_PULLUP | INPUT_EN | MUX_MODE2) >; };	/* Mode 2, Pull-Up, RxActive */
P2_27_timer_pin: pinmux_P2_27_timer_pin { pinctrl-single,pins = <
	AM33XX_IOPAD(0x0968, PIN_OUTPUT_PULLUP | INPUT_EN | MUX_MODE5) >; };	/* Mode 5, Pull-Up, RxActive */

/* P2_28 (ZCZ ball D13) mcasp0_axr1 */
P2_28_default_pin: pinmux_P2_28_default_pin { pinctrl-single,pins = <
	AM33XX_IOPAD(0x09a8, PIN_OUTPUT_PULLDOWN | INPUT_EN | MUX_MODE7) >; };	/* Mode 7, Pull-Down, RxActive */
P2_28_gpio_pin: pinmux_P2_28_gpio_pin { pinctrl-single,pins = <
	AM33XX_IOPAD(0x09a8, PIN_OUTPUT | INPUT_EN | MUX_MODE7) >; };	/* Mode 7, RxActive */
P2_28_gpio_pu_pin: pinmux_P2_28_gpio_pu_pin { pinctrl-single,pins = <
	AM33XX_IOPAD(0x09a8, PIN_OUTPUT_PULLUP | INPUT_EN | MUX_MODE7) >; };	/* Mode 7, Pull-Up, RxActive */
P2_28_gpio_pd_pin: pinmux_P2_28_gpio_pd_pin { pinctrl-single,pins = <
	AM33XX_IOPAD(0x09a8, PIN_OUTPUT_PULLDOWN | INPUT_EN | MUX_MODE7) >; };	/* Mode 7, Pull-Down, RxActive */
P2_28_pruout_pin: pinmux_P2_28_pruout_pin { pinctrl-single,pins = <
	AM33XX_IOPAD(0x09a8, PIN_OUTPUT_PULLDOWN | INPUT_EN | MUX_MODE5) >; };	/* Mode 5, Pull-Down, RxActive */
P2_28_pruin_pin: pinmux_P2_28_pruin_pin { pinctrl-single,pins = <
	AM33XX_IOPAD(0x09a8, PIN_OUTPUT_PULLDOWN | INPUT_EN | MUX_MODE6) >; };	/* Mode 6, Pull-Down, RxActive */
P2_28_qep_pin: pinmux_P2_28_qep_pin { pinctrl-single,pins = <
	AM33XX_IOPAD(0x09a8, PIN_OUTPUT_PULLDOWN | INPUT_EN | MUX_MODE1) >; };	/* Mode 1, Pull-Down, RxActive */

/* P2_29 (ZCZ ball C18) eCAP0_in_PWM0_out */
P2_29_default_pin: pinmux_P2_29_default_pin { pinctrl-single,pins = <
	AM33XX_IOPAD(0x0964, PIN_OUTPUT_PULLDOWN | INPUT_EN | MUX_MODE7) >; };	/* Mode 7, Pull-Down, RxActive */
P2_29_gpio_pin: pinmux_P2_29_gpio_pin { pinctrl-single,pins = <
	AM33XX_IOPAD(0x0964, PIN_OUTPUT | INPUT_EN | MUX_MODE7) >; };	/* Mode 7, RxActive */
P2_29_gpio_pu_pin: pinmux_P2_29_gpio_pu_pin { pinctrl-single,pins = <
	AM33XX_IOPAD(0x0964, PIN_OUTPUT_PULLUP | INPUT_EN | MUX_MODE7) >; };	/* Mode 7, Pull-Up, RxActive */
P2_29_gpio_pd_pin: pinmux_P2_29_gpio_pd_pin { pinctrl-single,pins = <
	AM33XX_IOPAD(0x0964, PIN_OUTPUT_PULLDOWN | INPUT_EN | MUX_MODE7) >; };	/* Mode 7, Pull-Down, RxActive */
P2_29_spi_pin: pinmux_P2_29_spi_pin { pinctrl-single,pins = <
	AM33XX_IOPAD(0x0964, PIN_OUTPUT_PULLUP | INPUT_EN | MUX_MODE4) >; };	/* Mode 4, Pull-Up, RxActive */
P2_29_uart_pin: pinmux_P2_29_uart_pin { pinctrl-single,pins = <
	AM33XX_IOPAD(0x0964, PIN_OUTPUT_PULLDOWN | INPUT_EN | MUX_MODE1) >; };	/* Mode 1, Pull-Down, RxActive */
P2_29_pwm_pin: pinmux_P2_29_pwm_pin { pinctrl-single,pins = <
	AM33XX_IOPAD(0x0964, PIN_OUTPUT_PULLDOWN | INPUT_EN | MUX_MODE0) >; };	/* Mode 0, Pull-Down, RxActive */
P2_29_pru_ecap_pin: pinmux_P2_29_pru_ecap_pin { pinctrl-single,pins = <
	AM33XX_IOPAD(0x0964, PIN_OUTPUT_PULLDOWN | INPUT_EN | MUX_MODE3) >; };	/* Mode 3, Pull-Down, RxActive */

/* P2_30 (ZCZ ball C12) mcasp0_ahclkr */
P2_30_default_pin: pinmux_P2_30_default_pin { pinctrl-single,pins = <
	AM33XX_IOPAD(0x099c, PIN_OUTPUT_PULLDOWN | INPUT_EN | MUX_MODE7) >; };	/* Mode 7, Pull-Down, RxActive */
P2_30_gpio_pin: pinmux_P2_30_gpio_pin { pinctrl-single,pins = <
	AM33XX_IOPAD(0x099c, PIN_OUTPUT | INPUT_EN | MUX_MODE7) >; };	/* Mode 7, RxActive */
P2_30_gpio_pu_pin: pinmux_P2_30_gpio_pu_pin { pinctrl-single,pins = <
	AM33XX_IOPAD(0x099c, PIN_OUTPUT_PULLUP | INPUT_EN | MUX_MODE7) >; };	/* Mode 7, Pull-Up, RxActive */
P2_30_gpio_pd_pin: pinmux_P2_30_gpio_pd_pin { pinctrl-single,pins = <
	AM33XX_IOPAD(0x099c, PIN_OUTPUT_PULLDOWN | INPUT_EN | MUX_MODE7) >; };	/* Mode 7, Pull-Down, RxActive */
P2_30_spi_pin: pinmux_P2_30_spi_pin { pinctrl-single,pins = <
	AM33XX_IOPAD(0x099c, PIN_OUTPUT_PULLUP | INPUT_EN | MUX_MODE3) >; };	/* Mode 3, Pull-Up, RxActive */
P2_30_pruout_pin: pinmux_P2_30_pruout_pin { pinctrl-single,pins = <
	AM33XX_IOPAD(0x099c, PIN_OUTPUT_PULLDOWN | INPUT_EN | MUX_MODE5) >; };	/* Mode 5, Pull-Down, RxActive */
P2_30_pruin_pin: pinmux_P2_30_pruin_pin { pinctrl-single,pins = <
	AM33XX_IOPAD(0x099c, PIN_OUTPUT_PULLDOWN | INPUT_EN | MUX_MODE6) >; };	/* Mode 6, Pull-Down, RxActive */
P2_30_pwm_pin: pinmux_P2_30_pwm_pin { pinctrl-single,pins = <
	AM33XX_IOPAD(0x099c, PIN_OUTPUT_PULLDOWN | INPUT_EN | MUX_MODE1) >; };	/* Mode 1, Pull-Down, RxActive */

/* P2_31 (ZCZ ball A15) xdma_event_intr0 */
P2_31_default_pin: pinmux_P2_31_default_pin { pinctrl-single,pins = <
	AM33XX_IOPAD(0x09b0, PIN_OUTPUT_PULLDOWN | INPUT_EN | MUX_MODE7) >; };	/* Mode 7, Pull-Down, RxActive */
P2_31_gpio_pin: pinmux_P2_31_gpio_pin { pinctrl-single,pins = <
	AM33XX_IOPAD(0x09b0, PIN_OUTPUT | INPUT_EN | MUX_MODE7) >; };	/* Mode 7, RxActive */
P2_31_gpio_pu_pin: pinmux_P2_31_gpio_pu_pin { pinctrl-single,pins = <
	AM33XX_IOPAD(0x09b0, PIN_OUTPUT_PULLUP | INPUT_EN | MUX_MODE7) >; };	/* Mode 7, Pull-Up, RxActive */
P2_31_gpio_pd_pin: pinmux_P2_31_gpio_pd_pin { pinctrl-single,pins = <
	AM33XX_IOPAD(0x09b0, PIN_OUTPUT_PULLDOWN | INPUT_EN | MUX_MODE7) >; };	/* Mode 7, Pull-Down, RxActive */
P2_31_spi_pin: pinmux_P2_31_spi_pin { pinctrl-single,pins = <
	AM33XX_IOPAD(0x09b0, PIN_OUTPUT_PULLUP | INPUT_EN | MUX_MODE4) >; };	/* Mode 4, Pull-Up, RxActive */
P2_31_timer_pin: pinmux_P2_31_timer_pin { pinctrl-single,pins = <
	AM33XX_IOPAD(0x09b0, PIN_OUTPUT_PULLUP | INPUT_EN | MUX_MODE2) >; };	/* Mode 2, Pull-Up, RxActive */
P2_31_pruin_pin: pinmux_P2_31_pruin_pin { pinctrl-single,pins = <
	AM33XX_IOPAD(0x09b0, PIN_OUTPUT_PULLDOWN | INPUT_EN | MUX_MODE5) >; };	/* Mode 5, Pull-Down, RxActive */

/* P2_32 (ZCZ ball D12) mcasp0_axr0 */
P2_32_default_pin: pinmux_P2_32_default_pin { pinctrl-single,pins = <
	AM33XX_IOPAD(0x0998, PIN_OUTPUT_PULLDOWN | INPUT_EN | MUX_MODE7) >; };	/* Mode 7, Pull-Down, RxActive */
P2_32_gpio_pin: pinmux_P2_32_gpio_pin { pinctrl-single,pins = <
	AM33XX_IOPAD(0x0998, PIN_OUTPUT | INPUT_EN | MUX_MODE7) >; };	/* Mode 7, RxActive */
P2_32_gpio_pu_pin: pinmux_P2_32_gpio_pu_pin { pinctrl-single,pins = <
	AM33XX_IOPAD(0x0998, PIN_OUTPUT_PULLUP | INPUT_EN | MUX_MODE7) >; };	/* Mode 7, Pull-Up, RxActive */
P2_32_gpio_pd_pin: pinmux_P2_32_gpio_pd_pin { pinctrl-single,pins = <
	AM33XX_IOPAD(0x0998, PIN_OUTPUT_PULLDOWN | INPUT_EN | MUX_MODE7) >; };	/* Mode 7, Pull-Down, RxActive */
P2_32_spi_pin: pinmux_P2_32_spi_pin { pinctrl-single,pins = <
	AM33XX_IOPAD(0x0998, PIN_OUTPUT_PULLUP | INPUT_EN | MUX_MODE3) >; };	/* Mode 3, Pull-Up, RxActive */
P2_32_pruout_pin: pinmux_P2_32_pruout_pin { pinctrl-single,pins = <
	AM33XX_IOPAD(0x0998, PIN_OUTPUT_PULLDOWN | INPUT_EN | MUX_MODE5) >; };	/* Mode 5, Pull-Down, RxActive */
P2_32_pruin_pin: pinmux_P2_32_pruin_pin { pinctrl-single,pins = <
	AM33XX_IOPAD(0x0998, PIN_OUTPUT_PULLDOWN | INPUT_EN | MUX_MODE6) >; };	/* Mode 6, Pull-Down, RxActive */
P2_32_pwm_pin: pinmux_P2_32_pwm_pin { pinctrl-single,pins = <
	AM33XX_IOPAD(0x0998, PIN_OUTPUT_PULLDOWN | INPUT_EN | MUX_MODE1) >; };	/* Mode 1, Pull-Down, RxActive */

/* P2_33 (ZCZ ball R12) gpmc_ad13 */
P2_33_default_pin: pinmux_P2_33_default_pin { pinctrl-single,pins = <
	AM33XX_IOPAD(0x0834, PIN_OUTPUT_PULLDOWN | INPUT_EN | MUX_MODE7) >; };	/* Mode 7, Pull-Down, RxActive */
P2_33_gpio_pin: pinmux_P2_33_gpio_pin { pinctrl-single,pins = <
	AM33XX_IOPAD(0x0834, PIN_OUTPUT | INPUT_EN | MUX_MODE7) >; };	/* Mode 7, RxActive */
P2_33_gpio_pu_pin: pinmux_P2_33_gpio_pu_pin { pinctrl-single,pins = <
	AM33XX_IOPAD(0x0834, PIN_OUTPUT_PULLUP | INPUT_EN | MUX_MODE7) >; };	/* Mode 7, Pull-Up, RxActive */
P2_33_gpio_pd_pin: pinmux_P2_33_gpio_pd_pin { pinctrl-single,pins = <
	AM33XX_IOPAD(0x0834, PIN_OUTPUT_PULLDOWN | INPUT_EN | MUX_MODE7) >; };	/* Mode 7, Pull-Down, RxActive */
P2_33_pruout_pin: pinmux_P2_33_pruout_pin { pinctrl-single,pins = <
	AM33XX_IOPAD(0x0834, PIN_OUTPUT_PULLDOWN | INPUT_EN | MUX_MODE6) >; };	/* Mode 6, Pull-Down, RxActive */
P2_33_qep_pin: pinmux_P2_33_qep_pin { pinctrl-single,pins = <
	AM33XX_IOPAD(0x0834, PIN_OUTPUT_PULLDOWN | INPUT_EN | MUX_MODE4) >; };	/* Mode 4, Pull-Down, RxActive */

/* P2_34 (ZCZ ball C13) mcasp0_fsr */
P2_34_default_pin: pinmux_P2_34_default_pin { pinctrl-single,pins = <
	AM33XX_IOPAD(0x09a4, PIN_OUTPUT_PULLDOWN | INPUT_EN | MUX_MODE7) >; };	/* Mode 7, Pull-Down, RxActive */
P2_34_gpio_pin: pinmux_P2_34_gpio_pin { pinctrl-single,pins = <
	AM33XX_IOPAD(0x09a4, PIN_OUTPUT | INPUT_EN | MUX_MODE7) >; };	/* Mode 7, RxActive */
P2_34_gpio_pu_pin: pinmux_P2_34_gpio_pu_pin { pinctrl-single,pins = <
	AM33XX_IOPAD(0x09a4, PIN_OUTPUT_PULLUP | INPUT_EN | MUX_MODE7) >; };	/* Mode 7, Pull-Up, RxActive */
P2_34_gpio_pd_pin: pinmux_P2_34_gpio_pd_pin { pinctrl-single,pins = <
	AM33XX_IOPAD(0x09a4, PIN_OUTPUT_PULLDOWN | INPUT_EN | MUX_MODE7) >; };	/* Mode 7, Pull-Down, RxActive */
P2_34_pruout_pin: pinmux_P2_34_pruout_pin { pinctrl-single,pins = <
	AM33XX_IOPAD(0x09a4, PIN_OUTPUT_PULLDOWN | INPUT_EN | MUX_MODE5) >; };	/* Mode 5, Pull-Down, RxActive */
P2_34_pruin_pin: pinmux_P2_34_pruin_pin { pinctrl-single,pins = <
	AM33XX_IOPAD(0x09a4, PIN_OUTPUT_PULLDOWN | INPUT_EN | MUX_MODE6) >; };	/* Mode 6, Pull-Down, RxActive */
P2_34_qep_pin: pinmux_P2_34_qep_pin { pinctrl-single,pins = <
	AM33XX_IOPAD(0x09a4, PIN_OUTPUT_PULLDOWN | INPUT_EN | MUX_MODE1) >; };	/* Mode 1, Pull-Down, RxActive */

/* P2_35 (ZCZ ball U5) lcd_vsync */
P2_35_default_pin: pinmux_P2_35_default_pin { pinctrl-single,pins = <
	AM33XX_IOPAD(0x08e0, PIN_OUTPUT_PULLDOWN | INPUT_EN | MUX_MODE7) >; };	/* Mode 7, Pull-Down, RxActive */
P2_35_gpio_pin: pinmux_P2_35_gpio_pin { pinctrl-single,pins = <
	AM33XX_IOPAD(0x08e0, PIN_OUTPUT | INPUT_EN | MUX_MODE7) >; };	/* Mode 7, RxActive */
P2_35_gpio_pu_pin: pinmux_P2_35_gpio_pu_pin { pinctrl-single,pins = <
	AM33XX_IOPAD(0x08e0, PIN_OUTPUT_PULLUP | INPUT_EN | MUX_MODE7) >; };	/* Mode 7, Pull-Up, RxActive */
P2_35_gpio_pd_pin: pinmux_P2_35_gpio_pd_pin { pinctrl-single,pins = <
	AM33XX_IOPAD(0x08e0, PIN_OUTPUT_PULLDOWN | INPUT_EN | MUX_MODE7) >; };	/* Mode 7, Pull-Down, RxActive */
P2_35_pruout_pin: pinmux_P2_35_pruout_pin { pinctrl-single,pins = <
	AM33XX_IOPAD(0x08e0, PIN_OUTPUT_PULLDOWN | INPUT_EN | MUX_MODE5) >; };	/* Mode 5, Pull-Down, RxActive */
P2_35_pruin_pin: pinmux_P2_35_pruin_pin { pinctrl-single,pins = <
	AM33XX_IOPAD(0x08e0, PIN_OUTPUT_PULLDOWN | INPUT_EN | MUX_MODE6) >; };	/* Mode 6, Pull-Down, RxActive */


P1_02_pinmux {
	compatible = "bone-pinmux-helper";
	status = "okay";
	pinctrl-names = "default", "gpio", "gpio_pu", "gpio_pd", "pruout", "pruin";
	pinctrl-0 = <&P1_02_default_pin>;
	pinctrl-1 = <&P1_02_gpio_pin>;
	pinctrl-2 = <&P1_02_gpio_pu_pin>;
	pinctrl-3 = <&P1_02_gpio_pd_pin>;
	pinctrl-4 = <&P1_02_pruout_pin>;
	pinctrl-5 = <&P1_02_pruin_pin>;
};

P1_04_pinmux {
	compatible = "bone-pinmux-helper";
	status = "okay";
	pinctrl-names = "default", "gpio", "gpio_pu", "gpio_pd", "pruout", "pruin";
	pinctrl-0 = <&P1_04_default_pin>;
	pinctrl-1 = <&P1_04_gpio_pin>;
	pinctrl-2 = <&P1_04_gpio_pu_pin>;
	pinctrl-3 = <&P1_04_gpio_pd_pin>;
	pinctrl-4 = <&P1_04_pruout_pin>;
	pinctrl-5 = <&P1_04_pruin_pin>;
};

P1_06_pinmux {
	compatible = "bone-pinmux-helper";
	status = "okay";
	pinctrl-names = "default", "gpio", "gpio_pu", "gpio_pd", "spi", "i2c", "pwm", "pru_uart";
	pinctrl-0 = <&P1_06_default_pin>;
	pinctrl-1 = <&P1_06_gpio_pin>;
	pinctrl-2 = <&P1_06_gpio_pu_pin>;
	pinctrl-3 = <&P1_06_gpio_pd_pin>;
	pinctrl-4 = <&P1_06_spi_pin>;
	pinctrl-5 = <&P1_06_i2c_pin>;
	pinctrl-6 = <&P1_06_pwm_pin>;
	pinctrl-7 = <&P1_06_pru_uart_pin>;
};

P1_08_pinmux {
	compatible = "bone-pinmux-helper";
	status = "okay";
	pinctrl-names = "default", "gpio", "gpio_pu", "gpio_pd", "spi", "uart", "i2c", "pwm", "pru_uart";
	pinctrl-0 = <&P1_08_default_pin>;
	pinctrl-1 = <&P1_08_gpio_pin>;
	pinctrl-2 = <&P1_08_gpio_pu_pin>;
	pinctrl-3 = <&P1_08_gpio_pd_pin>;
	pinctrl-4 = <&P1_08_spi_pin>;
	pinctrl-5 = <&P1_08_uart_pin>;
	pinctrl-6 = <&P1_08_i2c_pin>;
	pinctrl-7 = <&P1_08_pwm_pin>;
	pinctrl-8 = <&P1_08_pru_uart_pin>;
};

P1_10_pinmux {
	compatible = "bone-pinmux-helper";
	status = "okay";
	pinctrl-names = "default", "gpio", "gpio_pu", "gpio_pd", "spi", "uart", "i2c", "pwm", "pru_uart";
	pinctrl-0 = <&P1_10_default_pin>;
	pinctrl-1 = <&P1_10_gpio_pin>;
	pinctrl-2 = <&P1_10_gpio_pu_pin>;
	pinctrl-3 = <&P1_10_gpio_pd_pin>;
	pinctrl-4 = <&P1_10_spi_pin>;
	pinctrl-5 = <&P1_10_uart_pin>;
	pinctrl-6 = <&P1_10_i2c_pin>;
	pinctrl-7 = <&P1_10_pwm_pin>;
	pinctrl-8 = <&P1_10_pru_uart_pin>;
};

P1_12_pinmux {
	compatible = "bone-pinmux-helper";
	status = "okay";
	pinctrl-names = "default", "gpio", "gpio_pu", "gpio_pd", "spi", "i2c", "pwm", "pru_uart";
	pinctrl-0 = <&P1_12_default_pin>;
	pinctrl-1 = <&P1_12_gpio_pin>;
	pinctrl-2 = <&P1_12_gpio_pu_pin>;
	pinctrl-3 = <&P1_12_gpio_pd_pin>;
	pinctrl-4 = <&P1_12_spi_pin>;
	pinctrl-5 = <&P1_12_i2c_pin>;
	pinctrl-6 = <&P1_12_pwm_pin>;
	pinctrl-7 = <&P1_12_pru_uart_pin>;
};

P1_20_pinmux {
	compatible = "bone-pinmux-helper";
	status = "okay";
	pinctrl-names = "default", "gpio", "gpio_pu", "gpio_pd", "timer", "pruin";
	pinctrl-0 = <&P1_20_default_pin>;
	pinctrl-1 = <&P1_20_gpio_pin>;
	pinctrl-2 = <&P1_20_gpio_pu_pin>;
	pinctrl-3 = <&P1_20_gpio_pd_pin>;
	pinctrl-4 = <&P1_20_timer_pin>;
	pinctrl-5 = <&P1_20_pruin_pin>;
};

P1_26_pinmux {
	compatible = "bone-pinmux-helper";
	status = "okay";
	pinctrl-names = "default", "gpio", "gpio_pu", "gpio_pd", "spi", "i2c", "pru_uart", "timer";
	pinctrl-0 = <&P1_26_default_pin>;
	pinctrl-1 = <&P1_26_gpio_pin>;
	pinctrl-2 = <&P1_26_gpio_pu_pin>;
	pinctrl-3 = <&P1_26_gpio_pd_pin>;
	pinctrl-4 = <&P1_26_spi_pin>;
	pinctrl-5 = <&P1_26_i2c_pin>;
	pinctrl-6 = <&P1_26_pru_uart_pin>;
	pinctrl-7 = <&P1_26_timer_pin>;
};

P1_28_pinmux {
	compatible = "bone-pinmux-helper";
	status = "okay";
	pinctrl-names = "default", "gpio", "gpio_pu", "gpio_pd", "spi", "i2c", "pru_uart", "timer";
	pinctrl-0 = <&P1_28_default_pin>;
	pinctrl-1 = <&P1_28_gpio_pin>;
	pinctrl-2 = <&P1_28_gpio_pu_pin>;
	pinctrl-3 = <&P1_28_gpio_pd_pin>;
	pinctrl-4 = <&P1_28_spi_pin>;
	pinctrl-5 = <&P1_28_i2c_pin>;
	pinctrl-6 = <&P1_28_pru_uart_pin>;
	pinctrl-7 = <&P1_28_timer_pin>;
};

P1_29_pinmux {
	compatible = "bone-pinmux-helper";
	status = "okay";
	pinctrl-names = "default", "gpio", "gpio_pu", "gpio_pd", "qep", "pruout", "pruin";
	pinctrl-0 = <&P1_29_default_pin>;
	pinctrl-1 = <&P1_29_gpio_pin>;
	pinctrl-2 = <&P1_29_gpio_pu_pin>;
	pinctrl-3 = <&P1_29_gpio_pd_pin>;
	pinctrl-4 = <&P1_29_qep_pin>;
	pinctrl-5 = <&P1_29_pruout_pin>;
	pinctrl-6 = <&P1_29_pruin_pin>;
};

P1_30_pinmux {
	compatible = "bone-pinmux-helper";
	status = "okay";
	pinctrl-names = "default", "gpio", "gpio_pu", "gpio_pd", "spi", "i2c", "pruout", "pruin";
	pinctrl-0 = <&P1_30_default_pin>;
	pinctrl-1 = <&P1_30_gpio_pin>;
	pinctrl-2 = <&P1_30_gpio_pu_pin>;
	pinctrl-3 = <&P1_30_gpio_pd_pin>;
	pinctrl-4 = <&P1_30_spi_pin>;
	pinctrl-5 = <&P1_30_i2c_pin>;
	pinctrl-6 = <&P1_30_pruout_pin>;
	pinctrl-7 = <&P1_30_pruin_pin>;
};

P1_31_pinmux {
	compatible = "bone-pinmux-helper";
	status = "okay";
	pinctrl-names = "default", "gpio", "gpio_pu", "gpio_pd", "qep", "pruout", "pruin";
	pinctrl-0 = <&P1_31_default_pin>;
	pinctrl-1 = <&P1_31_gpio_pin>;
	pinctrl-2 = <&P1_31_gpio_pu_pin>;
	pinctrl-3 = <&P1_31_gpio_pd_pin>;
	pinctrl-4 = <&P1_31_qep_pin>;
	pinctrl-5 = <&P1_31_pruout_pin>;
	pinctrl-6 = <&P1_31_pruin_pin>;
};

P1_32_pinmux {
	compatible = "bone-pinmux-helper";
	status = "okay";
	pinctrl-names = "default", "gpio", "gpio_pu", "gpio_pd", "spi", "i2c", "pruout", "pruin";
	pinctrl-0 = <&P1_32_default_pin>;
	pinctrl-1 = <&P1_32_gpio_pin>;
	pinctrl-2 = <&P1_32_gpio_pu_pin>;
	pinctrl-3 = <&P1_32_gpio_pd_pin>;
	pinctrl-4 = <&P1_32_spi_pin>;
	pinctrl-5 = <&P1_32_i2c_pin>;
	pinctrl-6 = <&P1_32_pruout_pin>;
	pinctrl-7 = <&P1_32_pruin_pin>;
};

P1_33_pinmux {
	compatible = "bone-pinmux-helper";
	status = "okay";
	pinctrl-names = "default", "gpio", "gpio_pu", "gpio_pd", "spi", "pwm", "pruout", "pruin";
	pinctrl-0 = <&P1_33_default_pin>;
	pinctrl-1 = <&P1_33_gpio_pin>;
	pinctrl-2 = <&P1_33_gpio_pu_pin>;
	pinctrl-3 = <&P1_33_gpio_pd_pin>;
	pinctrl-4 = <&P1_33_spi_pin>;
	pinctrl-5 = <&P1_33_pwm_pin>;
	pinctrl-6 = <&P1_33_pruout_pin>;
	pinctrl-7 = <&P1_33_pruin_pin>;
};

P1_34_pinmux {
	compatible = "bone-pinmux-helper";
	status = "okay";
	pinctrl-names = "default", "gpio", "gpio_pu", "gpio_pd", "pwm";
	pinctrl-0 = <&P1_34_default_pin>;
	pinctrl-1 = <&P1_34_gpio_pin>;
	pinctrl-2 = <&P1_34_gpio_pu_pin>;
	pinctrl-3 = <&P1_34_gpio_pd_pin>;
	pinctrl-4 = <&P1_34_pwm_pin>;
};

P1_35_pinmux {
	compatible = "bone-pinmux-helper";
	status = "okay";
	pinctrl-names = "default", "gpio", "gpio_pu", "gpio_pd", "pruout", "pruin";
	pinctrl-0 = <&P1_35_default_pin>;
	pinctrl-1 = <&P1_35_gpio_pin>;
	pinctrl-2 = <&P1_35_gpio_pu_pin>;
	pinctrl-3 = <&P1_35_gpio_pd_pin>;
	pinctrl-4 = <&P1_35_pruout_pin>;
	pinctrl-5 = <&P1_35_pruin_pin>;
};

P1_36_pinmux {
	compatible = "bone-pinmux-helper";
	status = "okay";
	pinctrl-names = "default", "gpio", "gpio_pu", "gpio_pd", "spi", "pwm", "pruout", "pruin";
	pinctrl-0 = <&P1_36_default_pin>;
	pinctrl-1 = <&P1_36_gpio_pin>;
	pinctrl-2 = <&P1_36_gpio_pu_pin>;
	pinctrl-3 = <&P1_36_gpio_pd_pin>;
	pinctrl-4 = <&P1_36_spi_pin>;
	pinctrl-5 = <&P1_36_pwm_pin>;
	pinctrl-6 = <&P1_36_pruout_pin>;
	pinctrl-7 = <&P1_36_pruin_pin>;
};

P2_01_pinmux {
	compatible = "bone-pinmux-helper";
	status = "okay";
	pinctrl-names = "default", "gpio", "gpio_pu", "gpio_pd", "pwm";
	pinctrl-0 = <&P2_01_default_pin>;
	pinctrl-1 = <&P2_01_gpio_pin>;
	pinctrl-2 = <&P2_01_gpio_pu_pin>;
	pinctrl-3 = <&P2_01_gpio_pd_pin>;
	pinctrl-4 = <&P2_01_pwm_pin>;
};

P2_02_pinmux {
	compatible = "bone-pinmux-helper";
	status = "okay";
	pinctrl-names = "default", "gpio", "gpio_pu", "gpio_pd";
	pinctrl-0 = <&P2_02_default_pin>;
	pinctrl-1 = <&P2_02_gpio_pin>;
	pinctrl-2 = <&P2_02_gpio_pu_pin>;
	pinctrl-3 = <&P2_02_gpio_pd_pin>;
};

P2_03_pinmux {
	compatible = "bone-pinmux-helper";
	status = "okay";
	pinctrl-names = "default", "gpio", "gpio_pu", "gpio_pd", "pwm";
	pinctrl-0 = <&P2_03_default_pin>;
	pinctrl-1 = <&P2_03_gpio_pin>;
	pinctrl-2 = <&P2_03_gpio_pu_pin>;
	pinctrl-3 = <&P2_03_gpio_pd_pin>;
	pinctrl-4 = <&P2_03_pwm_pin>;
};

P2_04_pinmux {
	compatible = "bone-pinmux-helper";
	status = "okay";
	pinctrl-names = "default", "gpio", "gpio_pu", "gpio_pd";
	pinctrl-0 = <&P2_04_default_pin>;
	pinctrl-1 = <&P2_04_gpio_pin>;
	pinctrl-2 = <&P2_04_gpio_pu_pin>;
	pinctrl-3 = <&P2_04_gpio_pd_pin>;
};

P2_05_pinmux {
	compatible = "bone-pinmux-helper";
	status = "okay";
	pinctrl-names = "default", "gpio", "gpio_pu", "gpio_pd", "uart";
	pinctrl-0 = <&P2_05_default_pin>;
	pinctrl-1 = <&P2_05_gpio_pin>;
	pinctrl-2 = <&P2_05_gpio_pu_pin>;
	pinctrl-3 = <&P2_05_gpio_pd_pin>;
	pinctrl-4 = <&P2_05_uart_pin>;
};

P2_06_pinmux {
	compatible = "bone-pinmux-helper";
	status = "okay";
	pinctrl-names = "default", "gpio", "gpio_pu", "gpio_pd";
	pinctrl-0 = <&P2_06_default_pin>;
	pinctrl-1 = <&P2_06_gpio_pin>;
	pinctrl-2 = <&P2_06_gpio_pu_pin>;
	pinctrl-3 = <&P2_06_gpio_pd_pin>;
};

P2_07_pinmux {
	compatible = "bone-pinmux-helper";
	status = "okay";
	pinctrl-names = "default", "gpio", "gpio_pu", "gpio_pd", "uart";
	pinctrl-0 = <&P2_07_default_pin>;
	pinctrl-1 = <&P2_07_gpio_pin>;
	pinctrl-2 = <&P2_07_gpio_pu_pin>;
	pinctrl-3 = <&P2_07_gpio_pd_pin>;
	pinctrl-4 = <&P2_07_uart_pin>;
};

P2_08_pinmux {
	compatible = "bone-pinmux-helper";
	status = "okay";
	pinctrl-names = "default", "gpio", "gpio_pu", "gpio_pd";
	pinctrl-0 = <&P2_08_default_pin>;
	pinctrl-1 = <&P2_08_gpio_pin>;
	pinctrl-2 = <&P2_08_gpio_pu_pin>;
	pinctrl-3 = <&P2_08_gpio_pd_pin>;
};

P2_09_pinmux {
	compatible = "bone-pinmux-helper";
	status = "okay";
	pinctrl-names = "default", "gpio", "gpio_pu", "gpio_pd", "uart", "can", "i2c", "pru_uart", "pruin";
	pinctrl-0 = <&P2_09_default_pin>;
	pinctrl-1 = <&P2_09_gpio_pin>;
	pinctrl-2 = <&P2_09_gpio_pu_pin>;
	pinctrl-3 = <&P2_09_gpio_pd_pin>;
	pinctrl-4 = <&P2_09_uart_pin>;
	pinctrl-5 = <&P2_09_can_pin>;
	pinctrl-6 = <&P2_09_i2c_pin>;
	pinctrl-7 = <&P2_09_pru_uart_pin>;
	pinctrl-8 = <&P2_09_pruin_pin>;
};

P2_10_pinmux {
	compatible = "bone-pinmux-helper";
	status = "okay";
	pinctrl-names = "default", "gpio", "gpio_pu", "gpio_pd", "qep";
	pinctrl-0 = <&P2_10_default_pin>;
	pinctrl-1 = <&P2_10_gpio_pin>;
	pinctrl-2 = <&P2_10_gpio_pu_pin>;
	pinctrl-3 = <&P2_10_gpio_pd_pin>;
	pinctrl-4 = <&P2_10_qep_pin>;
};

P2_11_pinmux {
	compatible = "bone-pinmux-helper";
	status = "okay";
	pinctrl-names = "default", "gpio", "gpio_pu", "gpio_pd", "uart", "can", "i2c", "pru_uart", "pruin";
	pinctrl-0 = <&P2_11_default_pin>;
	pinctrl-1 = <&P2_11_gpio_pin>;
	pinctrl-2 = <&P2_11_gpio_pu_pin>;
	pinctrl-3 = <&P2_11_gpio_pd_pin>;
	pinctrl-4 = <&P2_11_uart_pin>;
	pinctrl-5 = <&P2_11_can_pin>;
	pinctrl-6 = <&P2_11_i2c_pin>;
	pinctrl-7 = <&P2_11_pru_uart_pin>;
	pinctrl-8 = <&P2_11_pruin_pin>;
};

P2_17_pinmux {
	compatible = "bone-pinmux-helper";
	status = "okay";
	pinctrl-names = "default", "gpio", "gpio_pu", "gpio_pd";
	pinctrl-0 = <&P2_17_default_pin>;
	pinctrl-1 = <&P2_17_gpio_pin>;
	pinctrl-2 = <&P2_17_gpio_pu_pin>;
	pinctrl-3 = <&P2_17_gpio_pd_pin>;
};

P2_18_pinmux {
	compatible = "bone-pinmux-helper";
	status = "okay";
	pinctrl-names = "default", "gpio", "gpio_pu", "gpio_pd", "qep", "pruin";
	pinctrl-0 = <&P2_18_default_pin>;
	pinctrl-1 = <&P2_18_gpio_pin>;
	pinctrl-2 = <&P2_18_gpio_pu_pin>;
	pinctrl-3 = <&P2_18_gpio_pd_pin>;
	pinctrl-4 = <&P2_18_qep_pin>;
	pinctrl-5 = <&P2_18_pruin_pin>;
};

P2_19_pinmux {
	compatible = "bone-pinmux-helper";
	status = "okay";
	pinctrl-names = "default", "gpio", "gpio_pu", "gpio_pd", "pwm";
	pinctrl-0 = <&P2_19_default_pin>;
	pinctrl-1 = <&P2_19_gpio_pin>;
	pinctrl-2 = <&P2_19_gpio_pu_pin>;
	pinctrl-3 = <&P2_19_gpio_pd_pin>;
	pinctrl-4 = <&P2_19_pwm_pin>;
};

P2_20_pinmux {
	compatible = "bone-pinmux-helper";
	status = "okay";
	pinctrl-names = "default", "gpio", "gpio_pu", "gpio_pd";
	pinctrl-0 = <&P2_20_default_pin>;
	pinctrl-1 = <&P2_20_gpio_pin>;
	pinctrl-2 = <&P2_20_gpio_pu_pin>;
	pinctrl-3 = <&P2_20_gpio_pd_pin>;
};

P2_22_pinmux {
	compatible = "bone-pinmux-helper";
	status = "okay";
	pinctrl-names = "default", "gpio", "gpio_pu", "gpio_pd", "qep", "pruin";
	pinctrl-0 = <&P2_22_default_pin>;
	pinctrl-1 = <&P2_22_gpio_pin>;
	pinctrl-2 = <&P2_22_gpio_pu_pin>;
	pinctrl-3 = <&P2_22_gpio_pd_pin>;
	pinctrl-4 = <&P2_22_qep_pin>;
	pinctrl-5 = <&P2_22_pruin_pin>;
};

P2_24_pinmux {
	compatible = "bone-pinmux-helper";
	status = "okay";
	pinctrl-names = "default", "gpio", "gpio_pu", "gpio_pd", "pwm";
	pinctrl-0 = <&P2_24_default_pin>;
	pinctrl-1 = <&P2_24_gpio_pin>;
	pinctrl-2 = <&P2_24_gpio_pu_pin>;
	pinctrl-3 = <&P2_24_gpio_pd_pin>;
	pinctrl-4 = <&P2_24_pwm_pin>;
};

P2_25_pinmux {
	compatible = "bone-pinmux-helper";
	status = "okay";
	pinctrl-names = "default", "gpio", "gpio_pu", "gpio_pd", "spi", "uart", "can", "i2c";
	pinctrl-0 = <&P2_25_default_pin>;
	pinctrl-1 = <&P2_25_gpio_pin>;
	pinctrl-2 = <&P2_25_gpio_pu_pin>;
	pinctrl-3 = <&P2_25_gpio_pd_pin>;
	pinctrl-4 = <&P2_25_spi_pin>;
	pinctrl-5 = <&P2_25_uart_pin>;
	pinctrl-6 = <&P2_25_can_pin>;
	pinctrl-7 = <&P2_25_i2c_pin>;
};

P2_27_pinmux {
	compatible = "bone-pinmux-helper";
	status = "okay";
	pinctrl-names = "default", "gpio", "gpio_pu", "gpio_pd", "spi", "uart", "can", "i2c", "timer";
	pinctrl-0 = <&P2_27_default_pin>;
	pinctrl-1 = <&P2_27_gpio_pin>;
	pinctrl-2 = <&P2_27_gpio_pu_pin>;
	pinctrl-3 = <&P2_27_gpio_pd_pin>;
	pinctrl-4 = <&P2_27_spi_pin>;
	pinctrl-5 = <&P2_27_uart_pin>;
	pinctrl-6 = <&P2_27_can_pin>;
	pinctrl-7 = <&P2_27_i2c_pin>;
	pinctrl-8 = <&P2_27_timer_pin>;
};

P2_28_pinmux {
	compatible = "bone-pinmux-helper";
	status = "okay";
	pinctrl-names = "default", "gpio", "gpio_pu", "gpio_pd", "qep", "pruout", "pruin";
	pinctrl-0 = <&P2_28_default_pin>;
	pinctrl-1 = <&P2_28_gpio_pin>;
	pinctrl-2 = <&P2_28_gpio_pu_pin>;
	pinctrl-3 = <&P2_28_gpio_pd_pin>;
	pinctrl-4 = <&P2_28_qep_pin>;
	pinctrl-5 = <&P2_28_pruout_pin>;
	pinctrl-6 = <&P2_28_pruin_pin>;
};

P2_29_pinmux {
	compatible = "bone-pinmux-helper";
	status = "okay";
	pinctrl-names = "default", "gpio", "gpio_pu", "gpio_pd", "spi", "uart", "pwm";
	pinctrl-0 = <&P2_29_default_pin>;
	pinctrl-1 = <&P2_29_gpio_pin>;
	pinctrl-2 = <&P2_29_gpio_pu_pin>;
	pinctrl-3 = <&P2_29_gpio_pd_pin>;
	pinctrl-4 = <&P2_29_spi_pin>;
	pinctrl-5 = <&P2_29_uart_pin>;
	pinctrl-6 = <&P2_29_pwm_pin>;
};

P2_30_pinmux {
	compatible = "bone-pinmux-helper";
	status = "okay";
	pinctrl-names = "default", "gpio", "gpio_pu", "gpio_pd", "spi", "pwm", "pruout", "pruin";
	pinctrl-0 = <&P2_30_default_pin>;
	pinctrl-1 = <&P2_30_gpio_pin>;
	pinctrl-2 = <&P2_30_gpio_pu_pin>;
	pinctrl-3 = <&P2_30_gpio_pd_pin>;
	pinctrl-4 = <&P2_30_spi_pin>;
	pinctrl-5 = <&P2_30_pwm_pin>;
	pinctrl-6 = <&P2_30_pruout_pin>;
	pinctrl-7 = <&P2_30_pruin_pin>;
};

P2_31_pinmux {
	compatible = "bone-pinmux-helper";
	status = "okay";
	pinctrl-names = "default", "gpio", "gpio_pu", "gpio_pd", "spi", "timer", "pruin";
	pinctrl-0 = <&P2_31_default_pin>;
	pinctrl-1 = <&P2_31_gpio_pin>;
	pinctrl-2 = <&P2_31_gpio_pu_pin>;
	pinctrl-3 = <&P2_31_gpio_pd_pin>;
	pinctrl-4 = <&P2_31_spi_pin>;
	pinctrl-5 = <&P2_31_timer_pin>;
	pinctrl-6 = <&P2_31_pruin_pin>;
};

P2_32_pinmux {
	compatible = "bone-pinmux-helper";
	status = "okay";
	pinctrl-names = "default", "gpio", "gpio_pu", "gpio_pd", "spi", "pwm", "pruout", "pruin";
	pinctrl-0 = <&P2_32_default_pin>;
	pinctrl-1 = <&P2_32_gpio_pin>;
	pinctrl-2 = <&P2_32_gpio_pu_pin>;
	pinctrl-3 = <&P2_32_gpio_pd_pin>;
	pinctrl-4 = <&P2_32_spi_pin>;
	pinctrl-5 = <&P2_32_pwm_pin>;
	pinctrl-6 = <&P2_32_pruout_pin>;
	pinctrl-7 = <&P2_32_pruin_pin>;
};

P2_33_pinmux {
	compatible = "bone-pinmux-helper";
	status = "okay";
	pinctrl-names = "default", "gpio", "gpio_pu", "gpio_pd", "qep", "pruout";
	pinctrl-0 = <&P2_33_default_pin>;
	pinctrl-1 = <&P2_33_gpio_pin>;
	pinctrl-2 = <&P2_33_gpio_pu_pin>;
	pinctrl-3 = <&P2_33_gpio_pd_pin>;
	pinctrl-4 = <&P2_33_qep_pin>;
	pinctrl-5 = <&P2_33_pruout_pin>;
};

P2_34_pinmux {
	compatible = "bone-pinmux-helper";
	status = "okay";
	pinctrl-names = "default", "gpio", "gpio_pu", "gpio_pd", "qep", "pruout", "pruin";
	pinctrl-0 = <&P2_34_default_pin>;
	pinctrl-1 = <&P2_34_gpio_pin>;
	pinctrl-2 = <&P2_34_gpio_pu_pin>;
	pinctrl-3 = <&P2_34_gpio_pd_pin>;
	pinctrl-4 = <&P2_34_qep_pin>;
	pinctrl-5 = <&P2_34_pruout_pin>;
	pinctrl-6 = <&P2_34_pruin_pin>;
};

P2_35_pinmux {
	compatible = "bone-pinmux-helper";
	status = "okay";
	pinctrl-names = "default", "gpio", "gpio_pu", "gpio_pd", "pruout", "pruin";
	pinctrl-0 = <&P2_35_default_pin>;
	pinctrl-1 = <&P2_35_gpio_pin>;
	pinctrl-2 = <&P2_35_gpio_pu_pin>;
	pinctrl-3 = <&P2_35_gpio_pd_pin>;
	pinctrl-4 = <&P2_35_pruout_pin>;
	pinctrl-5 = <&P2_35_pruin_pin>;
};


	P1_02 {
		gpio-name = "P1_02";
		gpio = <&gpio2 23 0>;
		input;
		dir-changeable;
	};

	P1_04 {
		gpio-name = "P1_04";
		gpio = <&gpio2 25 0>;
		input;
		dir-changeable;
	};

	P1_06 {
		gpio-name = "P1_06";
		gpio = <&gpio0 5 0>;
		input;
		dir-changeable;
	};

	P1_08 {
		gpio-name = "P1_08";
		gpio = <&gpio0 2 0>;
		input;
		dir-changeable;
	};

	P1_10 {
		gpio-name = "P1_10";
		gpio = <&gpio0 3 0>;
		input;
		dir-changeable;
	};

	P1_12 {
		gpio-name = "P1_12";
		gpio = <&gpio0 4 0>;
		input;
		dir-changeable;
	};

	P1_20 {
		gpio-name = "P1_20";
		gpio = <&gpio0 20 0>;
		input;
		dir-changeable;
	};

	P1_26 {
		gpio-name = "P1_26";
		gpio = <&gpio0 12 0>;
		input;
		dir-changeable;
	};

	P1_28 {
		gpio-name = "P1_28";
		gpio = <&gpio0 13 0>;
		input;
		dir-changeable;
	};

	P1_29 {
		gpio-name = "P1_29";
		gpio = <&gpio3 21 0>;
		input;
		dir-changeable;
	};

	P1_30 {
		gpio-name = "P1_30";
		gpio = <&gpio1 11 0>;
		input;
		dir-changeable;
	};

	P1_31 {
		gpio-name = "P1_31";
		gpio = <&gpio3 18 0>;
		input;
		dir-changeable;
	};

	P1_32 {
		gpio-name = "P1_32";
		gpio = <&gpio1 10 0>;
		input;
		dir-changeable;
	};

	P1_33 {
		gpio-name = "P1_33";
		gpio = <&gpio3 15 0>;
		input;
		dir-changeable;
	};

	P1_34 {
		gpio-name = "P1_34";
		gpio = <&gpio0 26 0>;
		input;
		dir-changeable;
	};

	P1_35 {
		gpio-name = "P1_35";
		gpio = <&gpio2 24 0>;
		input;
		dir-changeable;
	};

	P1_36 {
		gpio-name = "P1_36";
		gpio = <&gpio3 14 0>;
		input;
		dir-changeable;
	};

	P2_01 {
		gpio-name = "P2_01";
		gpio = <&gpio1 18 0>;
		input;
		dir-changeable;
	};

	P2_02 {
		gpio-name = "P2_02";
		gpio = <&gpio1 27 0>;
		input;
		dir-changeable;
	};

	P2_03 {
		gpio-name = "P2_03";
		gpio = <&gpio0 23 0>;
		input;
		dir-changeable;
	};

	P2_04 {
		gpio-name = "P2_04";
		gpio = <&gpio1 26 0>;
		input;
		dir-changeable;
	};

	P2_05 {
		gpio-name = "P2_05";
		gpio = <&gpio0 30 0>;
		input;
		dir-changeable;
	};

	P2_06 {
		gpio-name = "P2_06";
		gpio = <&gpio1 25 0>;
		input;
		dir-changeable;
	};

	P2_07 {
		gpio-name = "P2_07";
		gpio = <&gpio0 31 0>;
		input;
		dir-changeable;
	};

	P2_08 {
		gpio-name = "P2_08";
		gpio = <&gpio1 28 0>;
		input;
		dir-changeable;
	};

	P2_09 {
		gpio-name = "P2_09";
		gpio = <&gpio0 15 0>;
		input;
		dir-changeable;
	};

	P2_10 {
		gpio-name = "P2_10";
		gpio = <&gpio1 20 0>;
		input;
		dir-changeable;
	};

	P2_11 {
		gpio-name = "P2_11";
		gpio = <&gpio0 14 0>;
		input;
		dir-changeable;
	};

	P2_17 {
		gpio-name = "P2_17";
		gpio = <&gpio2 1 0>;
		input;
		dir-changeable;
	};

	P2_18 {
		gpio-name = "P2_18";
		gpio = <&gpio1 15 0>;
		input;
		dir-changeable;
	};

	P2_19 {
		gpio-name = "P2_19";
		gpio = <&gpio0 27 0>;
		input;
		dir-changeable;
	};

	P2_20 {
		gpio-name = "P2_20";
		gpio = <&gpio2 0 0>;
		input;
		dir-changeable;
	};

	P2_22 {
		gpio-name = "P2_22";
		gpio = <&gpio1 14 0>;
		input;
		dir-changeable;
	};

	P2_24 {
		gpio-name = "P2_24";
		gpio = <&gpio1 16 0>;
		input;
		dir-changeable;
	};

	P2_25 {
		gpio-name = "P2_25";
		gpio = <&gpio1 9 0>;
		input;
		dir-changeable;
	};

	P2_27 {
		gpio-name = "P2_27";
		gpio = <&gpio1 8 0>;
		input;
		dir-changeable;
	};

	P2_28 {
		gpio-name = "P2_28";
		gpio = <&gpio3 20 0>;
		input;
		dir-changeable;
	};

	P2_29 {
		gpio-name = "P2_29";
		gpio = <&gpio0 7 0>;
		input;
		dir-changeable;
	};

	P2_30 {
		gpio-name = "P2_30";
		gpio = <&gpio3 17 0>;
		input;
		dir-changeable;
	};

	P2_31 {
		gpio-name = "P2_31";
		gpio = <&gpio0 19 0>;
		input;
		dir-changeable;
	};

	P2_32 {
		gpio-name = "P2_32";
		gpio = <&gpio3 16 0>;
		input;
		dir-changeable;
	};

	P2_33 {
		gpio-name = "P2_33";
		gpio = <&gpio1 13 0>;
		input;
		dir-changeable;
	};

	P2_34 {
		gpio-name = "P2_34";
		gpio = <&gpio3 19 0>;
		input;
		dir-changeable;
	};

	P2_35 {
		gpio-name = "P2_35";
		gpio = <&gpio2 22 0>;
		input;
		dir-changeable;
	};

