
/* P8_03 (ZCZ ball R9) gpmc_ad6 */
P8_03_default_pin: pinmux_P8_03_default_pin { pinctrl-single,pins = <
	AM33XX_IOPAD(0x0818, PIN_OUTPUT_PULLDOWN | INPUT_EN | MUX_MODE7) >; };	/* Mode 7, Pull-Down, RxActive */
P8_03_gpio_pin: pinmux_P8_03_gpio_pin { pinctrl-single,pins = <
	AM33XX_IOPAD(0x0818, PIN_OUTPUT | INPUT_EN | MUX_MODE7) >; };	/* Mode 7, RxActive */
P8_03_gpio_pu_pin: pinmux_P8_03_gpio_pu_pin { pinctrl-single,pins = <
	AM33XX_IOPAD(0x0818, PIN_OUTPUT_PULLUP | INPUT_EN | MUX_MODE7) >; };	/* Mode 7, Pull-Up, RxActive */
P8_03_gpio_pd_pin: pinmux_P8_03_gpio_pd_pin { pinctrl-single,pins = <
	AM33XX_IOPAD(0x0818, PIN_OUTPUT_PULLDOWN | INPUT_EN | MUX_MODE7) >; };	/* Mode 7, Pull-Down, RxActive */

/* P8_04 (ZCZ ball T9) gpmc_ad7 */
P8_04_default_pin: pinmux_P8_04_default_pin { pinctrl-single,pins = <
	AM33XX_IOPAD(0x081c, PIN_OUTPUT_PULLDOWN | INPUT_EN | MUX_MODE7) >; };	/* Mode 7, Pull-Down, RxActive */
P8_04_gpio_pin: pinmux_P8_04_gpio_pin { pinctrl-single,pins = <
	AM33XX_IOPAD(0x081c, PIN_OUTPUT | INPUT_EN | MUX_MODE7) >; };	/* Mode 7, RxActive */
P8_04_gpio_pu_pin: pinmux_P8_04_gpio_pu_pin { pinctrl-single,pins = <
	AM33XX_IOPAD(0x081c, PIN_OUTPUT_PULLUP | INPUT_EN | MUX_MODE7) >; };	/* Mode 7, Pull-Up, RxActive */
P8_04_gpio_pd_pin: pinmux_P8_04_gpio_pd_pin { pinctrl-single,pins = <
	AM33XX_IOPAD(0x081c, PIN_OUTPUT_PULLDOWN | INPUT_EN | MUX_MODE7) >; };	/* Mode 7, Pull-Down, RxActive */

/* P8_05 (ZCZ ball R8) gpmc_ad2 */
P8_05_default_pin: pinmux_P8_05_default_pin { pinctrl-single,pins = <
	AM33XX_IOPAD(0x0808, PIN_OUTPUT_PULLDOWN | INPUT_EN | MUX_MODE7) >; };	/* Mode 7, Pull-Down, RxActive */
P8_05_gpio_pin: pinmux_P8_05_gpio_pin { pinctrl-single,pins = <
	AM33XX_IOPAD(0x0808, PIN_OUTPUT | INPUT_EN | MUX_MODE7) >; };	/* Mode 7, RxActive */
P8_05_gpio_pu_pin: pinmux_P8_05_gpio_pu_pin { pinctrl-single,pins = <
	AM33XX_IOPAD(0x0808, PIN_OUTPUT_PULLUP | INPUT_EN | MUX_MODE7) >; };	/* Mode 7, Pull-Up, RxActive */
P8_05_gpio_pd_pin: pinmux_P8_05_gpio_pd_pin { pinctrl-single,pins = <
	AM33XX_IOPAD(0x0808, PIN_OUTPUT_PULLDOWN | INPUT_EN | MUX_MODE7) >; };	/* Mode 7, Pull-Down, RxActive */

/* P8_06 (ZCZ ball T8) gpmc_ad3 */
P8_06_default_pin: pinmux_P8_06_default_pin { pinctrl-single,pins = <
	AM33XX_IOPAD(0x080c, PIN_OUTPUT_PULLDOWN | INPUT_EN | MUX_MODE7) >; };	/* Mode 7, Pull-Down, RxActive */
P8_06_gpio_pin: pinmux_P8_06_gpio_pin { pinctrl-single,pins = <
	AM33XX_IOPAD(0x080c, PIN_OUTPUT | INPUT_EN | MUX_MODE7) >; };	/* Mode 7, RxActive */
P8_06_gpio_pu_pin: pinmux_P8_06_gpio_pu_pin { pinctrl-single,pins = <
	AM33XX_IOPAD(0x080c, PIN_OUTPUT_PULLUP | INPUT_EN | MUX_MODE7) >; };	/* Mode 7, Pull-Up, RxActive */
P8_06_gpio_pd_pin: pinmux_P8_06_gpio_pd_pin { pinctrl-single,pins = <
	AM33XX_IOPAD(0x080c, PIN_OUTPUT_PULLDOWN | INPUT_EN | MUX_MODE7) >; };	/* Mode 7, Pull-Down, RxActive */

/* P8_07 (ZCZ ball R7) gpmc_advn_ale */
P8_07_default_pin: pinmux_P8_07_default_pin { pinctrl-single,pins = <
	AM33XX_IOPAD(0x0890, PIN_OUTPUT_PULLDOWN | INPUT_EN | MUX_MODE7) >; };	/* Mode 7, Pull-Down, RxActive */
P8_07_gpio_pin: pinmux_P8_07_gpio_pin { pinctrl-single,pins = <
	AM33XX_IOPAD(0x0890, PIN_OUTPUT | INPUT_EN | MUX_MODE7) >; };	/* Mode 7, RxActive */
P8_07_gpio_pu_pin: pinmux_P8_07_gpio_pu_pin { pinctrl-single,pins = <
	AM33XX_IOPAD(0x0890, PIN_OUTPUT_PULLUP | INPUT_EN | MUX_MODE7) >; };	/* Mode 7, Pull-Up, RxActive */
P8_07_gpio_pd_pin: pinmux_P8_07_gpio_pd_pin { pinctrl-single,pins = <
	AM33XX_IOPAD(0x0890, PIN_OUTPUT_PULLDOWN | INPUT_EN | MUX_MODE7) >; };	/* Mode 7, Pull-Down, RxActive */
P8_07_timer_pin: pinmux_P8_07_timer_pin { pinctrl-single,pins = <
	AM33XX_IOPAD(0x0890, PIN_OUTPUT_PULLUP | INPUT_EN | MUX_MODE2) >; };	/* Mode 2, Pull-Up, RxActive */

/* P8_08 (ZCZ ball T7) gpmc_oen_ren */
P8_08_default_pin: pinmux_P8_08_default_pin { pinctrl-single,pins = <
	AM33XX_IOPAD(0x0894, PIN_OUTPUT_PULLDOWN | INPUT_EN | MUX_MODE7) >; };	/* Mode 7, Pull-Down, RxActive */
P8_08_gpio_pin: pinmux_P8_08_gpio_pin { pinctrl-single,pins = <
	AM33XX_IOPAD(0x0894, PIN_OUTPUT | INPUT_EN | MUX_MODE7) >; };	/* Mode 7, RxActive */
P8_08_gpio_pu_pin: pinmux_P8_08_gpio_pu_pin { pinctrl-single,pins = <
	AM33XX_IOPAD(0x0894, PIN_OUTPUT_PULLUP | INPUT_EN | MUX_MODE7) >; };	/* Mode 7, Pull-Up, RxActive */
P8_08_gpio_pd_pin: pinmux_P8_08_gpio_pd_pin { pinctrl-single,pins = <
	AM33XX_IOPAD(0x0894, PIN_OUTPUT_PULLDOWN | INPUT_EN | MUX_MODE7) >; };	/* Mode 7, Pull-Down, RxActive */
P8_08_timer_pin: pinmux_P8_08_timer_pin { pinctrl-single,pins = <
	AM33XX_IOPAD(0x0894, PIN_OUTPUT_PULLUP | INPUT_EN | MUX_MODE2) >; };	/* Mode 2, Pull-Up, RxActive */

/* P8_09 (ZCZ ball T6) gpmc_be0n_cle */
P8_09_default_pin: pinmux_P8_09_default_pin { pinctrl-single,pins = <
	AM33XX_IOPAD(0x089c, PIN_OUTPUT_PULLDOWN | INPUT_EN | MUX_MODE7) >; };	/* Mode 7, Pull-Down, RxActive */
P8_09_gpio_pin: pinmux_P8_09_gpio_pin { pinctrl-single,pins = <
	AM33XX_IOPAD(0x089c, PIN_OUTPUT | INPUT_EN | MUX_MODE7) >; };	/* Mode 7, RxActive */
P8_09_gpio_pu_pin: pinmux_P8_09_gpio_pu_pin { pinctrl-single,pins = <
	AM33XX_IOPAD(0x089c, PIN_OUTPUT_PULLUP | INPUT_EN | MUX_MODE7) >; };	/* Mode 7, Pull-Up, RxActive */
P8_09_gpio_pd_pin: pinmux_P8_09_gpio_pd_pin { pinctrl-single,pins = <
	AM33XX_IOPAD(0x089c, PIN_OUTPUT_PULLDOWN | INPUT_EN | MUX_MODE7) >; };	/* Mode 7, Pull-Down, RxActive */
P8_09_timer_pin: pinmux_P8_09_timer_pin { pinctrl-single,pins = <
	AM33XX_IOPAD(0x089c, PIN_OUTPUT_PULLUP | INPUT_EN | MUX_MODE2) >; };	/* Mode 2, Pull-Up, RxActive */

/* P8_10 (ZCZ ball U6) gpmc_wen */
P8_10_default_pin: pinmux_P8_10_default_pin { pinctrl-single,pins = <
	AM33XX_IOPAD(0x0898, PIN_OUTPUT_PULLDOWN | INPUT_EN | MUX_MODE7) >; };	/* Mode 7, Pull-Down, RxActive */
P8_10_gpio_pin: pinmux_P8_10_gpio_pin { pinctrl-single,pins = <
	AM33XX_IOPAD(0x0898, PIN_OUTPUT | INPUT_EN | MUX_MODE7) >; };	/* Mode 7, RxActive */
P8_10_gpio_pu_pin: pinmux_P8_10_gpio_pu_pin { pinctrl-single,pins = <
	AM33XX_IOPAD(0x0898, PIN_OUTPUT_PULLUP | INPUT_EN | MUX_MODE7) >; };	/* Mode 7, Pull-Up, RxActive */
P8_10_gpio_pd_pin: pinmux_P8_10_gpio_pd_pin { pinctrl-single,pins = <
	AM33XX_IOPAD(0x0898, PIN_OUTPUT_PULLDOWN | INPUT_EN | MUX_MODE7) >; };	/* Mode 7, Pull-Down, RxActive */
P8_10_timer_pin: pinmux_P8_10_timer_pin { pinctrl-single,pins = <
	AM33XX_IOPAD(0x0898, PIN_OUTPUT_PULLUP | INPUT_EN | MUX_MODE2) >; };	/* Mode 2, Pull-Up, RxActive */

/* P8_11 (ZCZ ball R12) gpmc_ad13 */
P8_11_default_pin: pinmux_P8_11_default_pin { pinctrl-single,pins = <
	AM33XX_IOPAD(0x0834, PIN_OUTPUT_PULLDOWN | INPUT_EN | MUX_MODE7) >; };	/* Mode 7, Pull-Down, RxActive */
P8_11_gpio_pin: pinmux_P8_11_gpio_pin { pinctrl-single,pins = <
	AM33XX_IOPAD(0x0834, PIN_OUTPUT | INPUT_EN | MUX_MODE7) >; };	/* Mode 7, RxActive */
P8_11_gpio_pu_pin: pinmux_P8_11_gpio_pu_pin { pinctrl-single,pins = <
	AM33XX_IOPAD(0x0834, PIN_OUTPUT_PULLUP | INPUT_EN | MUX_MODE7) >; };	/* Mode 7, Pull-Up, RxActive */
P8_11_gpio_pd_pin: pinmux_P8_11_gpio_pd_pin { pinctrl-single,pins = <
	AM33XX_IOPAD(0x0834, PIN_OUTPUT_PULLDOWN | INPUT_EN | MUX_MODE7) >; };	/* Mode 7, Pull-Down, RxActive */
P8_11_pruout_pin: pinmux_P8_11_pruout_pin { pinctrl-single,pins = <
	AM33XX_IOPAD(0x0834, PIN_OUTPUT_PULLDOWN | INPUT_EN | MUX_MODE6) >; };	/* Mode 6, Pull-Down, RxActive */
P8_11_qep_pin: pinmux_P8_11_qep_pin { pinctrl-single,pins = <
	AM33XX_IOPAD(0x0834, PIN_OUTPUT_PULLDOWN | INPUT_EN | MUX_MODE4) >; };	/* Mode 4, Pull-Down, RxActive */

/* P8_12 (ZCZ ball T12) gpmc_ad12 */
P8_12_default_pin: pinmux_P8_12_default_pin { pinctrl-single,pins = <
	AM33XX_IOPAD(0x0830, PIN_OUTPUT_PULLDOWN | INPUT_EN | MUX_MODE7) >; };	/* Mode 7, Pull-Down, RxActive */
P8_12_gpio_pin: pinmux_P8_12_gpio_pin { pinctrl-single,pins = <
	AM33XX_IOPAD(0x0830, PIN_OUTPUT | INPUT_EN | MUX_MODE7) >; };	/* Mode 7, RxActive */
P8_12_gpio_pu_pin: pinmux_P8_12_gpio_pu_pin { pinctrl-single,pins = <
	AM33XX_IOPAD(0x0830, PIN_OUTPUT_PULLUP | INPUT_EN | MUX_MODE7) >; };	/* Mode 7, Pull-Up, RxActive */
P8_12_gpio_pd_pin: pinmux_P8_12_gpio_pd_pin { pinctrl-single,pins = <
	AM33XX_IOPAD(0x0830, PIN_OUTPUT_PULLDOWN | INPUT_EN | MUX_MODE7) >; };	/* Mode 7, Pull-Down, RxActive */
P8_12_pruout_pin: pinmux_P8_12_pruout_pin { pinctrl-single,pins = <
	AM33XX_IOPAD(0x0830, PIN_OUTPUT_PULLDOWN | INPUT_EN | MUX_MODE6) >; };	/* Mode 6, Pull-Down, RxActive */
P8_12_qep_pin: pinmux_P8_12_qep_pin { pinctrl-single,pins = <
	AM33XX_IOPAD(0x0830, PIN_OUTPUT_PULLDOWN | INPUT_EN | MUX_MODE4) >; };	/* Mode 4, Pull-Down, RxActive */

/* P8_13 (ZCZ ball T10) gpmc_ad9 */
P8_13_default_pin: pinmux_P8_13_default_pin { pinctrl-single,pins = <
	AM33XX_IOPAD(0x0824, PIN_OUTPUT_PULLDOWN | INPUT_EN | MUX_MODE7) >; };	/* Mode 7, Pull-Down, RxActive */
P8_13_gpio_pin: pinmux_P8_13_gpio_pin { pinctrl-single,pins = <
	AM33XX_IOPAD(0x0824, PIN_OUTPUT | INPUT_EN | MUX_MODE7) >; };	/* Mode 7, RxActive */
P8_13_gpio_pu_pin: pinmux_P8_13_gpio_pu_pin { pinctrl-single,pins = <
	AM33XX_IOPAD(0x0824, PIN_OUTPUT_PULLUP | INPUT_EN | MUX_MODE7) >; };	/* Mode 7, Pull-Up, RxActive */
P8_13_gpio_pd_pin: pinmux_P8_13_gpio_pd_pin { pinctrl-single,pins = <
	AM33XX_IOPAD(0x0824, PIN_OUTPUT_PULLDOWN | INPUT_EN | MUX_MODE7) >; };	/* Mode 7, Pull-Down, RxActive */
P8_13_pwm_pin: pinmux_P8_13_pwm_pin { pinctrl-single,pins = <
	AM33XX_IOPAD(0x0824, PIN_OUTPUT_PULLDOWN | INPUT_EN | MUX_MODE4) >; };	/* Mode 4, Pull-Down, RxActive */

/* P8_14 (ZCZ ball T11) gpmc_ad10 */
P8_14_default_pin: pinmux_P8_14_default_pin { pinctrl-single,pins = <
	AM33XX_IOPAD(0x0828, PIN_OUTPUT_PULLDOWN | INPUT_EN | MUX_MODE7) >; };	/* Mode 7, Pull-Down, RxActive */
P8_14_gpio_pin: pinmux_P8_14_gpio_pin { pinctrl-single,pins = <
	AM33XX_IOPAD(0x0828, PIN_OUTPUT | INPUT_EN | MUX_MODE7) >; };	/* Mode 7, RxActive */
P8_14_gpio_pu_pin: pinmux_P8_14_gpio_pu_pin { pinctrl-single,pins = <
	AM33XX_IOPAD(0x0828, PIN_OUTPUT_PULLUP | INPUT_EN | MUX_MODE7) >; };	/* Mode 7, Pull-Up, RxActive */
P8_14_gpio_pd_pin: pinmux_P8_14_gpio_pd_pin { pinctrl-single,pins = <
	AM33XX_IOPAD(0x0828, PIN_OUTPUT_PULLDOWN | INPUT_EN | MUX_MODE7) >; };	/* Mode 7, Pull-Down, RxActive */
P8_14_pwm_pin: pinmux_P8_14_pwm_pin { pinctrl-single,pins = <
	AM33XX_IOPAD(0x0828, PIN_OUTPUT_PULLDOWN | INPUT_EN | MUX_MODE4) >; };	/* Mode 4, Pull-Down, RxActive */

/* P8_15 (ZCZ ball U13) gpmc_ad15 */
P8_15_default_pin: pinmux_P8_15_default_pin { pinctrl-single,pins = <
	AM33XX_IOPAD(0x083c, PIN_OUTPUT_PULLDOWN | INPUT_EN | MUX_MODE7) >; };	/* Mode 7, Pull-Down, RxActive */
P8_15_gpio_pin: pinmux_P8_15_gpio_pin { pinctrl-single,pins = <
	AM33XX_IOPAD(0x083c, PIN_OUTPUT | INPUT_EN | MUX_MODE7) >; };	/* Mode 7, RxActive */
P8_15_gpio_pu_pin: pinmux_P8_15_gpio_pu_pin { pinctrl-single,pins = <
	AM33XX_IOPAD(0x083c, PIN_OUTPUT_PULLUP | INPUT_EN | MUX_MODE7) >; };	/* Mode 7, Pull-Up, RxActive */
P8_15_gpio_pd_pin: pinmux_P8_15_gpio_pd_pin { pinctrl-single,pins = <
	AM33XX_IOPAD(0x083c, PIN_OUTPUT_PULLDOWN | INPUT_EN | MUX_MODE7) >; };	/* Mode 7, Pull-Down, RxActive */
P8_15_pruin_pin: pinmux_P8_15_pruin_pin { pinctrl-single,pins = <
	AM33XX_IOPAD(0x083c, PIN_OUTPUT_PULLDOWN | INPUT_EN | MUX_MODE6) >; };	/* Mode 6, Pull-Down, RxActive */
P8_15_pru_ecap_pin: pinmux_P8_15_pru_ecap_pin { pinctrl-single,pins = <
	AM33XX_IOPAD(0x083c, PIN_OUTPUT_PULLDOWN | INPUT_EN | MUX_MODE5) >; };	/* Mode 5, Pull-Down, RxActive */
P8_15_qep_pin: pinmux_P8_15_qep_pin { pinctrl-single,pins = <
	AM33XX_IOPAD(0x083c, PIN_OUTPUT_PULLDOWN | INPUT_EN | MUX_MODE4) >; };	/* Mode 4, Pull-Down, RxActive */

/* P8_16 (ZCZ ball V13) gpmc_ad14 */
P8_16_default_pin: pinmux_P8_16_default_pin { pinctrl-single,pins = <
	AM33XX_IOPAD(0x0838, PIN_OUTPUT_PULLDOWN | INPUT_EN | MUX_MODE7) >; };	/* Mode 7, Pull-Down, RxActive */
P8_16_gpio_pin: pinmux_P8_16_gpio_pin { pinctrl-single,pins = <
	AM33XX_IOPAD(0x0838, PIN_OUTPUT | INPUT_EN | MUX_MODE7) >; };	/* Mode 7, RxActive */
P8_16_gpio_pu_pin: pinmux_P8_16_gpio_pu_pin { pinctrl-single,pins = <
	AM33XX_IOPAD(0x0838, PIN_OUTPUT_PULLUP | INPUT_EN | MUX_MODE7) >; };	/* Mode 7, Pull-Up, RxActive */
P8_16_gpio_pd_pin: pinmux_P8_16_gpio_pd_pin { pinctrl-single,pins = <
	AM33XX_IOPAD(0x0838, PIN_OUTPUT_PULLDOWN | INPUT_EN | MUX_MODE7) >; };	/* Mode 7, Pull-Down, RxActive */
P8_16_pruin_pin: pinmux_P8_16_pruin_pin { pinctrl-single,pins = <
	AM33XX_IOPAD(0x0838, PIN_OUTPUT_PULLDOWN | INPUT_EN | MUX_MODE6) >; };	/* Mode 6, Pull-Down, RxActive */
P8_16_qep_pin: pinmux_P8_16_qep_pin { pinctrl-single,pins = <
	AM33XX_IOPAD(0x0838, PIN_OUTPUT_PULLDOWN | INPUT_EN | MUX_MODE4) >; };	/* Mode 4, Pull-Down, RxActive */

/* P8_17 (ZCZ ball U12) gpmc_ad11 */
P8_17_default_pin: pinmux_P8_17_default_pin { pinctrl-single,pins = <
	AM33XX_IOPAD(0x082c, PIN_OUTPUT_PULLDOWN | INPUT_EN | MUX_MODE7) >; };	/* Mode 7, Pull-Down, RxActive */
P8_17_gpio_pin: pinmux_P8_17_gpio_pin { pinctrl-single,pins = <
	AM33XX_IOPAD(0x082c, PIN_OUTPUT | INPUT_EN | MUX_MODE7) >; };	/* Mode 7, RxActive */
P8_17_gpio_pu_pin: pinmux_P8_17_gpio_pu_pin { pinctrl-single,pins = <
	AM33XX_IOPAD(0x082c, PIN_OUTPUT_PULLUP | INPUT_EN | MUX_MODE7) >; };	/* Mode 7, Pull-Up, RxActive */
P8_17_gpio_pd_pin: pinmux_P8_17_gpio_pd_pin { pinctrl-single,pins = <
	AM33XX_IOPAD(0x082c, PIN_OUTPUT_PULLDOWN | INPUT_EN | MUX_MODE7) >; };	/* Mode 7, Pull-Down, RxActive */
P8_17_pwm_pin: pinmux_P8_17_pwm_pin { pinctrl-single,pins = <
	AM33XX_IOPAD(0x082c, PIN_OUTPUT_PULLDOWN | INPUT_EN | MUX_MODE4) >; };	/* Mode 4, Pull-Down, RxActive */

/* P8_18 (ZCZ ball V12) gpmc_clk */
P8_18_default_pin: pinmux_P8_18_default_pin { pinctrl-single,pins = <
	AM33XX_IOPAD(0x088c, PIN_OUTPUT_PULLDOWN | INPUT_EN | MUX_MODE7) >; };	/* Mode 7, Pull-Down, RxActive */
P8_18_gpio_pin: pinmux_P8_18_gpio_pin { pinctrl-single,pins = <
	AM33XX_IOPAD(0x088c, PIN_OUTPUT | INPUT_EN | MUX_MODE7) >; };	/* Mode 7, RxActive */
P8_18_gpio_pu_pin: pinmux_P8_18_gpio_pu_pin { pinctrl-single,pins = <
	AM33XX_IOPAD(0x088c, PIN_OUTPUT_PULLUP | INPUT_EN | MUX_MODE7) >; };	/* Mode 7, Pull-Up, RxActive */
P8_18_gpio_pd_pin: pinmux_P8_18_gpio_pd_pin { pinctrl-single,pins = <
	AM33XX_IOPAD(0x088c, PIN_OUTPUT_PULLDOWN | INPUT_EN | MUX_MODE7) >; };	/* Mode 7, Pull-Down, RxActive */

/* P8_19 (ZCZ ball U10) gpmc_ad8 */
P8_19_default_pin: pinmux_P8_19_default_pin { pinctrl-single,pins = <
	AM33XX_IOPAD(0x0820, PIN_OUTPUT_PULLDOWN | INPUT_EN | MUX_MODE7) >; };	/* Mode 7, Pull-Down, RxActive */
P8_19_gpio_pin: pinmux_P8_19_gpio_pin { pinctrl-single,pins = <
	AM33XX_IOPAD(0x0820, PIN_OUTPUT | INPUT_EN | MUX_MODE7) >; };	/* Mode 7, RxActive */
P8_19_gpio_pu_pin: pinmux_P8_19_gpio_pu_pin { pinctrl-single,pins = <
	AM33XX_IOPAD(0x0820, PIN_OUTPUT_PULLUP | INPUT_EN | MUX_MODE7) >; };	/* Mode 7, Pull-Up, RxActive */
P8_19_gpio_pd_pin: pinmux_P8_19_gpio_pd_pin { pinctrl-single,pins = <
	AM33XX_IOPAD(0x0820, PIN_OUTPUT_PULLDOWN | INPUT_EN | MUX_MODE7) >; };	/* Mode 7, Pull-Down, RxActive */
P8_19_pwm_pin: pinmux_P8_19_pwm_pin { pinctrl-single,pins = <
	AM33XX_IOPAD(0x0820, PIN_OUTPUT_PULLDOWN | INPUT_EN | MUX_MODE4) >; };	/* Mode 4, Pull-Down, RxActive */

/* P8_20 (ZCZ ball V9) gpmc_csn2 */
P8_20_default_pin: pinmux_P8_20_default_pin { pinctrl-single,pins = <
	AM33XX_IOPAD(0x0884, PIN_OUTPUT_PULLDOWN | INPUT_EN | MUX_MODE7) >; };	/* Mode 7, Pull-Down, RxActive */
P8_20_gpio_pin: pinmux_P8_20_gpio_pin { pinctrl-single,pins = <
	AM33XX_IOPAD(0x0884, PIN_OUTPUT | INPUT_EN | MUX_MODE7) >; };	/* Mode 7, RxActive */
P8_20_gpio_pu_pin: pinmux_P8_20_gpio_pu_pin { pinctrl-single,pins = <
	AM33XX_IOPAD(0x0884, PIN_OUTPUT_PULLUP | INPUT_EN | MUX_MODE7) >; };	/* Mode 7, Pull-Up, RxActive */
P8_20_gpio_pd_pin: pinmux_P8_20_gpio_pd_pin { pinctrl-single,pins = <
	AM33XX_IOPAD(0x0884, PIN_OUTPUT_PULLDOWN | INPUT_EN | MUX_MODE7) >; };	/* Mode 7, Pull-Down, RxActive */
P8_20_pruout_pin: pinmux_P8_20_pruout_pin { pinctrl-single,pins = <
	AM33XX_IOPAD(0x0884, PIN_OUTPUT_PULLDOWN | INPUT_EN | MUX_MODE5) >; };	/* Mode 5, Pull-Down, RxActive */
P8_20_pruin_pin: pinmux_P8_20_pruin_pin { pinctrl-single,pins = <
	AM33XX_IOPAD(0x0884, PIN_OUTPUT_PULLDOWN | INPUT_EN | MUX_MODE6) >; };	/* Mode 6, Pull-Down, RxActive */

/* P8_21 (ZCZ ball U9) gpmc_csn1 */
P8_21_default_pin: pinmux_P8_21_default_pin { pinctrl-single,pins = <
	AM33XX_IOPAD(0x0880, PIN_OUTPUT_PULLDOWN | INPUT_EN | MUX_MODE7) >; };	/* Mode 7, Pull-Down, RxActive */
P8_21_gpio_pin: pinmux_P8_21_gpio_pin { pinctrl-single,pins = <
	AM33XX_IOPAD(0x0880, PIN_OUTPUT | INPUT_EN | MUX_MODE7) >; };	/* Mode 7, RxActive */
P8_21_gpio_pu_pin: pinmux_P8_21_gpio_pu_pin { pinctrl-single,pins = <
	AM33XX_IOPAD(0x0880, PIN_OUTPUT_PULLUP | INPUT_EN | MUX_MODE7) >; };	/* Mode 7, Pull-Up, RxActive */
P8_21_gpio_pd_pin: pinmux_P8_21_gpio_pd_pin { pinctrl-single,pins = <
	AM33XX_IOPAD(0x0880, PIN_OUTPUT_PULLDOWN | INPUT_EN | MUX_MODE7) >; };	/* Mode 7, Pull-Down, RxActive */
P8_21_pruout_pin: pinmux_P8_21_pruout_pin { pinctrl-single,pins = <
	AM33XX_IOPAD(0x0880, PIN_OUTPUT_PULLDOWN | INPUT_EN | MUX_MODE5) >; };	/* Mode 5, Pull-Down, RxActive */
P8_21_pruin_pin: pinmux_P8_21_pruin_pin { pinctrl-single,pins = <
	AM33XX_IOPAD(0x0880, PIN_OUTPUT_PULLDOWN | INPUT_EN | MUX_MODE6) >; };	/* Mode 6, Pull-Down, RxActive */

/* P8_22 (ZCZ ball V8) gpmc_ad5 */
P8_22_default_pin: pinmux_P8_22_default_pin { pinctrl-single,pins = <
	AM33XX_IOPAD(0x0814, PIN_OUTPUT_PULLDOWN | INPUT_EN | MUX_MODE7) >; };	/* Mode 7, Pull-Down, RxActive */
P8_22_gpio_pin: pinmux_P8_22_gpio_pin { pinctrl-single,pins = <
	AM33XX_IOPAD(0x0814, PIN_OUTPUT | INPUT_EN | MUX_MODE7) >; };	/* Mode 7, RxActive */
P8_22_gpio_pu_pin: pinmux_P8_22_gpio_pu_pin { pinctrl-single,pins = <
	AM33XX_IOPAD(0x0814, PIN_OUTPUT_PULLUP | INPUT_EN | MUX_MODE7) >; };	/* Mode 7, Pull-Up, RxActive */
P8_22_gpio_pd_pin: pinmux_P8_22_gpio_pd_pin { pinctrl-single,pins = <
	AM33XX_IOPAD(0x0814, PIN_OUTPUT_PULLDOWN | INPUT_EN | MUX_MODE7) >; };	/* Mode 7, Pull-Down, RxActive */

/* P8_23 (ZCZ ball U8) gpmc_ad4 */
P8_23_default_pin: pinmux_P8_23_default_pin { pinctrl-single,pins = <
	AM33XX_IOPAD(0x0810, PIN_OUTPUT_PULLDOWN | INPUT_EN | MUX_MODE7) >; };	/* Mode 7, Pull-Down, RxActive */
P8_23_gpio_pin: pinmux_P8_23_gpio_pin { pinctrl-single,pins = <
	AM33XX_IOPAD(0x0810, PIN_OUTPUT | INPUT_EN | MUX_MODE7) >; };	/* Mode 7, RxActive */
P8_23_gpio_pu_pin: pinmux_P8_23_gpio_pu_pin { pinctrl-single,pins = <
	AM33XX_IOPAD(0x0810, PIN_OUTPUT_PULLUP | INPUT_EN | MUX_MODE7) >; };	/* Mode 7, Pull-Up, RxActive */
P8_23_gpio_pd_pin: pinmux_P8_23_gpio_pd_pin { pinctrl-single,pins = <
	AM33XX_IOPAD(0x0810, PIN_OUTPUT_PULLDOWN | INPUT_EN | MUX_MODE7) >; };	/* Mode 7, Pull-Down, RxActive */

/* P8_24 (ZCZ ball V7) gpmc_ad1 */
P8_24_default_pin: pinmux_P8_24_default_pin { pinctrl-single,pins = <
	AM33XX_IOPAD(0x0804, PIN_OUTPUT_PULLDOWN | INPUT_EN | MUX_MODE7) >; };	/* Mode 7, Pull-Down, RxActive */
P8_24_gpio_pin: pinmux_P8_24_gpio_pin { pinctrl-single,pins = <
	AM33XX_IOPAD(0x0804, PIN_OUTPUT | INPUT_EN | MUX_MODE7) >; };	/* Mode 7, RxActive */
P8_24_gpio_pu_pin: pinmux_P8_24_gpio_pu_pin { pinctrl-single,pins = <
	AM33XX_IOPAD(0x0804, PIN_OUTPUT_PULLUP | INPUT_EN | MUX_MODE7) >; };	/* Mode 7, Pull-Up, RxActive */
P8_24_gpio_pd_pin: pinmux_P8_24_gpio_pd_pin { pinctrl-single,pins = <
	AM33XX_IOPAD(0x0804, PIN_OUTPUT_PULLDOWN | INPUT_EN | MUX_MODE7) >; };	/* Mode 7, Pull-Down, RxActive */

/* P8_25 (ZCZ ball U7) gpmc_ad0 */
P8_25_default_pin: pinmux_P8_25_default_pin { pinctrl-single,pins = <
	AM33XX_IOPAD(0x0800, PIN_OUTPUT_PULLDOWN | INPUT_EN | MUX_MODE7) >; };	/* Mode 7, Pull-Down, RxActive */
P8_25_gpio_pin: pinmux_P8_25_gpio_pin { pinctrl-single,pins = <
	AM33XX_IOPAD(0x0800, PIN_OUTPUT | INPUT_EN | MUX_MODE7) >; };	/* Mode 7, RxActive */
P8_25_gpio_pu_pin: pinmux_P8_25_gpio_pu_pin { pinctrl-single,pins = <
	AM33XX_IOPAD(0x0800, PIN_OUTPUT_PULLUP | INPUT_EN | MUX_MODE7) >; };	/* Mode 7, Pull-Up, RxActive */
P8_25_gpio_pd_pin: pinmux_P8_25_gpio_pd_pin { pinctrl-single,pins = <
	AM33XX_IOPAD(0x0800, PIN_OUTPUT_PULLDOWN | INPUT_EN | MUX_MODE7) >; };	/* Mode 7, Pull-Down, RxActive */

/* P8_26 (ZCZ ball V6) gpmc_csn0 */
P8_26_default_pin: pinmux_P8_26_default_pin { pinctrl-single,pins = <
	AM33XX_IOPAD(0x087c, PIN_OUTPUT_PULLDOWN | INPUT_EN | MUX_MODE7) >; };	/* Mode 7, Pull-Down, RxActive */
P8_26_gpio_pin: pinmux_P8_26_gpio_pin { pinctrl-single,pins = <
	AM33XX_IOPAD(0x087c, PIN_OUTPUT | INPUT_EN | MUX_MODE7) >; };	/* Mode 7, RxActive */
P8_26_gpio_pu_pin: pinmux_P8_26_gpio_pu_pin { pinctrl-single,pins = <
	AM33XX_IOPAD(0x087c, PIN_OUTPUT_PULLUP | INPUT_EN | MUX_MODE7) >; };	/* Mode 7, Pull-Up, RxActive */
P8_26_gpio_pd_pin: pinmux_P8_26_gpio_pd_pin { pinctrl-single,pins = <
	AM33XX_IOPAD(0x087c, PIN_OUTPUT_PULLDOWN | INPUT_EN | MUX_MODE7) >; };	/* Mode 7, Pull-Down, RxActive */

/* P8_27 (ZCZ ball U5) lcd_vsync */
P8_27_default_pin: pinmux_P8_27_default_pin { pinctrl-single,pins = <
	AM33XX_IOPAD(0x08e0, PIN_OUTPUT_PULLDOWN | INPUT_EN | MUX_MODE7) >; };	/* Mode 7, Pull-Down, RxActive */
P8_27_gpio_pin: pinmux_P8_27_gpio_pin { pinctrl-single,pins = <
	AM33XX_IOPAD(0x08e0, PIN_OUTPUT | INPUT_EN | MUX_MODE7) >; };	/* Mode 7, RxActive */
P8_27_gpio_pu_pin: pinmux_P8_27_gpio_pu_pin { pinctrl-single,pins = <
	AM33XX_IOPAD(0x08e0, PIN_OUTPUT_PULLUP | INPUT_EN | MUX_MODE7) >; };	/* Mode 7, Pull-Up, RxActive */
P8_27_gpio_pd_pin: pinmux_P8_27_gpio_pd_pin { pinctrl-single,pins = <
	AM33XX_IOPAD(0x08e0, PIN_OUTPUT_PULLDOWN | INPUT_EN | MUX_MODE7) >; };	/* Mode 7, Pull-Down, RxActive */
P8_27_pruout_pin: pinmux_P8_27_pruout_pin { pinctrl-single,pins = <
	AM33XX_IOPAD(0x08e0, PIN_OUTPUT_PULLDOWN | INPUT_EN | MUX_MODE5) >; };	/* Mode 5, Pull-Down, RxActive */
P8_27_pruin_pin: pinmux_P8_27_pruin_pin { pinctrl-single,pins = <
	AM33XX_IOPAD(0x08e0, PIN_OUTPUT_PULLDOWN | INPUT_EN | MUX_MODE6) >; };	/* Mode 6, Pull-Down, RxActive */

/* P8_28 (ZCZ ball V5) lcd_pclk */
P8_28_default_pin: pinmux_P8_28_default_pin { pinctrl-single,pins = <
	AM33XX_IOPAD(0x08e8, PIN_OUTPUT_PULLDOWN | INPUT_EN | MUX_MODE7) >; };	/* Mode 7, Pull-Down, RxActive */
P8_28_gpio_pin: pinmux_P8_28_gpio_pin { pinctrl-single,pins = <
	AM33XX_IOPAD(0x08e8, PIN_OUTPUT | INPUT_EN | MUX_MODE7) >; };	/* Mode 7, RxActive */
P8_28_gpio_pu_pin: pinmux_P8_28_gpio_pu_pin { pinctrl-single,pins = <
	AM33XX_IOPAD(0x08e8, PIN_OUTPUT_PULLUP | INPUT_EN | MUX_MODE7) >; };	/* Mode 7, Pull-Up, RxActive */
P8_28_gpio_pd_pin: pinmux_P8_28_gpio_pd_pin { pinctrl-single,pins = <
	AM33XX_IOPAD(0x08e8, PIN_OUTPUT_PULLDOWN | INPUT_EN | MUX_MODE7) >; };	/* Mode 7, Pull-Down, RxActive */
P8_28_pruout_pin: pinmux_P8_28_pruout_pin { pinctrl-single,pins = <
	AM33XX_IOPAD(0x08e8, PIN_OUTPUT_PULLDOWN | INPUT_EN | MUX_MODE5) >; };	/* Mode 5, Pull-Down, RxActive */
P8_28_pruin_pin: pinmux_P8_28_pruin_pin { pinctrl-single,pins = <
	AM33XX_IOPAD(0x08e8, PIN_OUTPUT_PULLDOWN | INPUT_EN | MUX_MODE6) >; };	/* Mode 6, Pull-Down, RxActive */

/* P8_29 (ZCZ ball R5) lcd_hsync */
P8_29_default_pin: pinmux_P8_29_default_pin { pinctrl-single,pins = <
	AM33XX_IOPAD(0x08e4, PIN_OUTPUT_PULLDOWN | INPUT_EN | MUX_MODE7) >; };	/* Mode 7, Pull-Down, RxActive */
P8_29_gpio_pin: pinmux_P8_29_gpio_pin { pinctrl-single,pins = <
	AM33XX_IOPAD(0x08e4, PIN_OUTPUT | INPUT_EN | MUX_MODE7) >; };	/* Mode 7, RxActive */
P8_29_gpio_pu_pin: pinmux_P8_29_gpio_pu_pin { pinctrl-single,pins = <
	AM33XX_IOPAD(0x08e4, PIN_OUTPUT_PULLUP | INPUT_EN | MUX_MODE7) >; };	/* Mode 7, Pull-Up, RxActive */
P8_29_gpio_pd_pin: pinmux_P8_29_gpio_pd_pin { pinctrl-single,pins = <
	AM33XX_IOPAD(0x08e4, PIN_OUTPUT_PULLDOWN | INPUT_EN | MUX_MODE7) >; };	/* Mode 7, Pull-Down, RxActive */
P8_29_pruout_pin: pinmux_P8_29_pruout_pin { pinctrl-single,pins = <
	AM33XX_IOPAD(0x08e4, PIN_OUTPUT_PULLDOWN | INPUT_EN | MUX_MODE5) >; };	/* Mode 5, Pull-Down, RxActive */
P8_29_pruin_pin: pinmux_P8_29_pruin_pin { pinctrl-single,pins = <
	AM33XX_IOPAD(0x08e4, PIN_OUTPUT_PULLDOWN | INPUT_EN | MUX_MODE6) >; };	/* Mode 6, Pull-Down, RxActive */

/* P8_30 (ZCZ ball R6) lcd_ac_bias_en */
P8_30_default_pin: pinmux_P8_30_default_pin { pinctrl-single,pins = <
	AM33XX_IOPAD(0x08ec, PIN_OUTPUT_PULLDOWN | INPUT_EN | MUX_MODE7) >; };	/* Mode 7, Pull-Down, RxActive */
P8_30_gpio_pin: pinmux_P8_30_gpio_pin { pinctrl-single,pins = <
	AM33XX_IOPAD(0x08ec, PIN_OUTPUT | INPUT_EN | MUX_MODE7) >; };	/* Mode 7, RxActive */
P8_30_gpio_pu_pin: pinmux_P8_30_gpio_pu_pin { pinctrl-single,pins = <
	AM33XX_IOPAD(0x08ec, PIN_OUTPUT_PULLUP | INPUT_EN | MUX_MODE7) >; };	/* Mode 7, Pull-Up, RxActive */
P8_30_gpio_pd_pin: pinmux_P8_30_gpio_pd_pin { pinctrl-single,pins = <
	AM33XX_IOPAD(0x08ec, PIN_OUTPUT_PULLDOWN | INPUT_EN | MUX_MODE7) >; };	/* Mode 7, Pull-Down, RxActive */
P8_30_pruout_pin: pinmux_P8_30_pruout_pin { pinctrl-single,pins = <
	AM33XX_IOPAD(0x08ec, PIN_OUTPUT_PULLDOWN | INPUT_EN | MUX_MODE5) >; };	/* Mode 5, Pull-Down, RxActive */
P8_30_pruin_pin: pinmux_P8_30_pruin_pin { pinctrl-single,pins = <
	AM33XX_IOPAD(0x08ec, PIN_OUTPUT_PULLDOWN | INPUT_EN | MUX_MODE6) >; };	/* Mode 6, Pull-Down, RxActive */

/* P8_31 (ZCZ ball V4) lcd_data14 */
P8_31_default_pin: pinmux_P8_31_default_pin { pinctrl-single,pins = <
	AM33XX_IOPAD(0x08d8, PIN_OUTPUT_PULLDOWN | INPUT_EN | MUX_MODE7) >; };	/* Mode 7, Pull-Down, RxActive */
P8_31_gpio_pin: pinmux_P8_31_gpio_pin { pinctrl-single,pins = <
	AM33XX_IOPAD(0x08d8, PIN_OUTPUT | INPUT_EN | MUX_MODE7) >; };	/* Mode 7, RxActive */
P8_31_gpio_pu_pin: pinmux_P8_31_gpio_pu_pin { pinctrl-single,pins = <
	AM33XX_IOPAD(0x08d8, PIN_OUTPUT_PULLUP | INPUT_EN | MUX_MODE7) >; };	/* Mode 7, Pull-Up, RxActive */
P8_31_gpio_pd_pin: pinmux_P8_31_gpio_pd_pin { pinctrl-single,pins = <
	AM33XX_IOPAD(0x08d8, PIN_OUTPUT_PULLDOWN | INPUT_EN | MUX_MODE7) >; };	/* Mode 7, Pull-Down, RxActive */
P8_31_uart_pin: pinmux_P8_31_uart_pin { pinctrl-single,pins = <
	AM33XX_IOPAD(0x08d8, PIN_OUTPUT_PULLDOWN | INPUT_EN | MUX_MODE4) >; };	/* Mode 4, Pull-Down, RxActive */
P8_31_qep_pin: pinmux_P8_31_qep_pin { pinctrl-single,pins = <
	AM33XX_IOPAD(0x08d8, PIN_OUTPUT_PULLDOWN | INPUT_EN | MUX_MODE2) >; };	/* Mode 2, Pull-Down, RxActive */

/* P8_32 (ZCZ ball T5) lcd_data15 */
P8_32_default_pin: pinmux_P8_32_default_pin { pinctrl-single,pins = <
	AM33XX_IOPAD(0x08dc, PIN_OUTPUT_PULLDOWN | INPUT_EN | MUX_MODE7) >; };	/* Mode 7, Pull-Down, RxActive */
P8_32_gpio_pin: pinmux_P8_32_gpio_pin { pinctrl-single,pins = <
	AM33XX_IOPAD(0x08dc, PIN_OUTPUT | INPUT_EN | MUX_MODE7) >; };	/* Mode 7, RxActive */
P8_32_gpio_pu_pin: pinmux_P8_32_gpio_pu_pin { pinctrl-single,pins = <
	AM33XX_IOPAD(0x08dc, PIN_OUTPUT_PULLUP | INPUT_EN | MUX_MODE7) >; };	/* Mode 7, Pull-Up, RxActive */
P8_32_gpio_pd_pin: pinmux_P8_32_gpio_pd_pin { pinctrl-single,pins = <
	AM33XX_IOPAD(0x08dc, PIN_OUTPUT_PULLDOWN | INPUT_EN | MUX_MODE7) >; };	/* Mode 7, Pull-Down, RxActive */
P8_32_qep_pin: pinmux_P8_32_qep_pin { pinctrl-single,pins = <
	AM33XX_IOPAD(0x08dc, PIN_OUTPUT_PULLDOWN | INPUT_EN | MUX_MODE2) >; };	/* Mode 2, Pull-Down, RxActive */

/* P8_33 (ZCZ ball V3) lcd_data13 */
P8_33_default_pin: pinmux_P8_33_default_pin { pinctrl-single,pins = <
	AM33XX_IOPAD(0x08d4, PIN_OUTPUT_PULLDOWN | INPUT_EN | MUX_MODE7) >; };	/* Mode 7, Pull-Down, RxActive */
P8_33_gpio_pin: pinmux_P8_33_gpio_pin { pinctrl-single,pins = <
	AM33XX_IOPAD(0x08d4, PIN_OUTPUT | INPUT_EN | MUX_MODE7) >; };	/* Mode 7, RxActive */
P8_33_gpio_pu_pin: pinmux_P8_33_gpio_pu_pin { pinctrl-single,pins = <
	AM33XX_IOPAD(0x08d4, PIN_OUTPUT_PULLUP | INPUT_EN | MUX_MODE7) >; };	/* Mode 7, Pull-Up, RxActive */
P8_33_gpio_pd_pin: pinmux_P8_33_gpio_pd_pin { pinctrl-single,pins = <
	AM33XX_IOPAD(0x08d4, PIN_OUTPUT_PULLDOWN | INPUT_EN | MUX_MODE7) >; };	/* Mode 7, Pull-Down, RxActive */
P8_33_qep_pin: pinmux_P8_33_qep_pin { pinctrl-single,pins = <
	AM33XX_IOPAD(0x08d4, PIN_OUTPUT_PULLDOWN | INPUT_EN | MUX_MODE2) >; };	/* Mode 2, Pull-Down, RxActive */

/* P8_34 (ZCZ ball U4) lcd_data11 */
P8_34_default_pin: pinmux_P8_34_default_pin { pinctrl-single,pins = <
	AM33XX_IOPAD(0x08cc, PIN_OUTPUT_PULLDOWN | INPUT_EN | MUX_MODE7) >; };	/* Mode 7, Pull-Down, RxActive */
P8_34_gpio_pin: pinmux_P8_34_gpio_pin { pinctrl-single,pins = <
	AM33XX_IOPAD(0x08cc, PIN_OUTPUT | INPUT_EN | MUX_MODE7) >; };	/* Mode 7, RxActive */
P8_34_gpio_pu_pin: pinmux_P8_34_gpio_pu_pin { pinctrl-single,pins = <
	AM33XX_IOPAD(0x08cc, PIN_OUTPUT_PULLUP | INPUT_EN | MUX_MODE7) >; };	/* Mode 7, Pull-Up, RxActive */
P8_34_gpio_pd_pin: pinmux_P8_34_gpio_pd_pin { pinctrl-single,pins = <
	AM33XX_IOPAD(0x08cc, PIN_OUTPUT_PULLDOWN | INPUT_EN | MUX_MODE7) >; };	/* Mode 7, Pull-Down, RxActive */
P8_34_pwm_pin: pinmux_P8_34_pwm_pin { pinctrl-single,pins = <
	AM33XX_IOPAD(0x08cc, PIN_OUTPUT_PULLDOWN | INPUT_EN | MUX_MODE2) >; };	/* Mode 2, Pull-Down, RxActive */

/* P8_35 (ZCZ ball V2) lcd_data12 */
P8_35_default_pin: pinmux_P8_35_default_pin { pinctrl-single,pins = <
	AM33XX_IOPAD(0x08d0, PIN_OUTPUT_PULLDOWN | INPUT_EN | MUX_MODE7) >; };	/* Mode 7, Pull-Down, RxActive */
P8_35_gpio_pin: pinmux_P8_35_gpio_pin { pinctrl-single,pins = <
	AM33XX_IOPAD(0x08d0, PIN_OUTPUT | INPUT_EN | MUX_MODE7) >; };	/* Mode 7, RxActive */
P8_35_gpio_pu_pin: pinmux_P8_35_gpio_pu_pin { pinctrl-single,pins = <
	AM33XX_IOPAD(0x08d0, PIN_OUTPUT_PULLUP | INPUT_EN | MUX_MODE7) >; };	/* Mode 7, Pull-Up, RxActive */
P8_35_gpio_pd_pin: pinmux_P8_35_gpio_pd_pin { pinctrl-single,pins = <
	AM33XX_IOPAD(0x08d0, PIN_OUTPUT_PULLDOWN | INPUT_EN | MUX_MODE7) >; };	/* Mode 7, Pull-Down, RxActive */
P8_35_qep_pin: pinmux_P8_35_qep_pin { pinctrl-single,pins = <
	AM33XX_IOPAD(0x08d0, PIN_OUTPUT_PULLDOWN | INPUT_EN | MUX_MODE2) >; };	/* Mode 2, Pull-Down, RxActive */

/* P8_36 (ZCZ ball U3) lcd_data10 */
P8_36_default_pin: pinmux_P8_36_default_pin { pinctrl-single,pins = <
	AM33XX_IOPAD(0x08c8, PIN_OUTPUT_PULLDOWN | INPUT_EN | MUX_MODE7) >; };	/* Mode 7, Pull-Down, RxActive */
P8_36_gpio_pin: pinmux_P8_36_gpio_pin { pinctrl-single,pins = <
	AM33XX_IOPAD(0x08c8, PIN_OUTPUT | INPUT_EN | MUX_MODE7) >; };	/* Mode 7, RxActive */
P8_36_gpio_pu_pin: pinmux_P8_36_gpio_pu_pin { pinctrl-single,pins = <
	AM33XX_IOPAD(0x08c8, PIN_OUTPUT_PULLUP | INPUT_EN | MUX_MODE7) >; };	/* Mode 7, Pull-Up, RxActive */
P8_36_gpio_pd_pin: pinmux_P8_36_gpio_pd_pin { pinctrl-single,pins = <
	AM33XX_IOPAD(0x08c8, PIN_OUTPUT_PULLDOWN | INPUT_EN | MUX_MODE7) >; };	/* Mode 7, Pull-Down, RxActive */
P8_36_pwm_pin: pinmux_P8_36_pwm_pin { pinctrl-single,pins = <
	AM33XX_IOPAD(0x08c8, PIN_OUTPUT_PULLDOWN | INPUT_EN | MUX_MODE2) >; };	/* Mode 2, Pull-Down, RxActive */

/* P8_37 (ZCZ ball U1) lcd_data8 */
P8_37_default_pin: pinmux_P8_37_default_pin { pinctrl-single,pins = <
	AM33XX_IOPAD(0x08c0, PIN_OUTPUT_PULLDOWN | INPUT_EN | MUX_MODE7) >; };	/* Mode 7, Pull-Down, RxActive */
P8_37_gpio_pin: pinmux_P8_37_gpio_pin { pinctrl-single,pins = <
	AM33XX_IOPAD(0x08c0, PIN_OUTPUT | INPUT_EN | MUX_MODE7) >; };	/* Mode 7, RxActive */
P8_37_gpio_pu_pin: pinmux_P8_37_gpio_pu_pin { pinctrl-single,pins = <
	AM33XX_IOPAD(0x08c0, PIN_OUTPUT_PULLUP | INPUT_EN | MUX_MODE7) >; };	/* Mode 7, Pull-Up, RxActive */
P8_37_gpio_pd_pin: pinmux_P8_37_gpio_pd_pin { pinctrl-single,pins = <
	AM33XX_IOPAD(0x08c0, PIN_OUTPUT_PULLDOWN | INPUT_EN | MUX_MODE7) >; };	/* Mode 7, Pull-Down, RxActive */
P8_37_uart_pin: pinmux_P8_37_uart_pin { pinctrl-single,pins = <
	AM33XX_IOPAD(0x08c0, PIN_OUTPUT_PULLDOWN | INPUT_EN | MUX_MODE4) >; };	/* Mode 4, Pull-Down, RxActive */
P8_37_pwm_pin: pinmux_P8_37_pwm_pin { pinctrl-single,pins = <
	AM33XX_IOPAD(0x08c0, PIN_OUTPUT_PULLDOWN | INPUT_EN | MUX_MODE2) >; };	/* Mode 2, Pull-Down, RxActive */

/* P8_38 (ZCZ ball U2) lcd_data9 */
P8_38_default_pin: pinmux_P8_38_default_pin { pinctrl-single,pins = <
	AM33XX_IOPAD(0x08c4, PIN_OUTPUT_PULLDOWN | INPUT_EN | MUX_MODE7) >; };	/* Mode 7, Pull-Down, RxActive */
P8_38_gpio_pin: pinmux_P8_38_gpio_pin { pinctrl-single,pins = <
	AM33XX_IOPAD(0x08c4, PIN_OUTPUT | INPUT_EN | MUX_MODE7) >; };	/* Mode 7, RxActive */
P8_38_gpio_pu_pin: pinmux_P8_38_gpio_pu_pin { pinctrl-single,pins = <
	AM33XX_IOPAD(0x08c4, PIN_OUTPUT_PULLUP | INPUT_EN | MUX_MODE7) >; };	/* Mode 7, Pull-Up, RxActive */
P8_38_gpio_pd_pin: pinmux_P8_38_gpio_pd_pin { pinctrl-single,pins = <
	AM33XX_IOPAD(0x08c4, PIN_OUTPUT_PULLDOWN | INPUT_EN | MUX_MODE7) >; };	/* Mode 7, Pull-Down, RxActive */
P8_38_uart_pin: pinmux_P8_38_uart_pin { pinctrl-single,pins = <
	AM33XX_IOPAD(0x08c4, PIN_OUTPUT_PULLDOWN | INPUT_EN | MUX_MODE4) >; };	/* Mode 4, Pull-Down, RxActive */
P8_38_pwm_pin: pinmux_P8_38_pwm_pin { pinctrl-single,pins = <
	AM33XX_IOPAD(0x08c4, PIN_OUTPUT_PULLDOWN | INPUT_EN | MUX_MODE2) >; };	/* Mode 2, Pull-Down, RxActive */

/* P8_39 (ZCZ ball T3) lcd_data6 */
P8_39_default_pin: pinmux_P8_39_default_pin { pinctrl-single,pins = <
	AM33XX_IOPAD(0x08b8, PIN_OUTPUT_PULLDOWN | INPUT_EN | MUX_MODE7) >; };	/* Mode 7, Pull-Down, RxActive */
P8_39_gpio_pin: pinmux_P8_39_gpio_pin { pinctrl-single,pins = <
	AM33XX_IOPAD(0x08b8, PIN_OUTPUT | INPUT_EN | MUX_MODE7) >; };	/* Mode 7, RxActive */
P8_39_gpio_pu_pin: pinmux_P8_39_gpio_pu_pin { pinctrl-single,pins = <
	AM33XX_IOPAD(0x08b8, PIN_OUTPUT_PULLUP | INPUT_EN | MUX_MODE7) >; };	/* Mode 7, Pull-Up, RxActive */
P8_39_gpio_pd_pin: pinmux_P8_39_gpio_pd_pin { pinctrl-single,pins = <
	AM33XX_IOPAD(0x08b8, PIN_OUTPUT_PULLDOWN | INPUT_EN | MUX_MODE7) >; };	/* Mode 7, Pull-Down, RxActive */
P8_39_pruout_pin: pinmux_P8_39_pruout_pin { pinctrl-single,pins = <
	AM33XX_IOPAD(0x08b8, PIN_OUTPUT_PULLDOWN | INPUT_EN | MUX_MODE5) >; };	/* Mode 5, Pull-Down, RxActive */
P8_39_pruin_pin: pinmux_P8_39_pruin_pin { pinctrl-single,pins = <
	AM33XX_IOPAD(0x08b8, PIN_OUTPUT_PULLDOWN | INPUT_EN | MUX_MODE6) >; };	/* Mode 6, Pull-Down, RxActive */
P8_39_qep_pin: pinmux_P8_39_qep_pin { pinctrl-single,pins = <
	AM33XX_IOPAD(0x08b8, PIN_OUTPUT_PULLDOWN | INPUT_EN | MUX_MODE3) >; };	/* Mode 3, Pull-Down, RxActive */

/* P8_40 (ZCZ ball T4) lcd_data7 */
P8_40_default_pin: pinmux_P8_40_default_pin { pinctrl-single,pins = <
	AM33XX_IOPAD(0x08bc, PIN_OUTPUT_PULLDOWN | INPUT_EN | MUX_MODE7) >; };	/* Mode 7, Pull-Down, RxActive */
P8_40_gpio_pin: pinmux_P8_40_gpio_pin { pinctrl-single,pins = <
	AM33XX_IOPAD(0x08bc, PIN_OUTPUT | INPUT_EN | MUX_MODE7) >; };	/* Mode 7, RxActive */
P8_40_gpio_pu_pin: pinmux_P8_40_gpio_pu_pin { pinctrl-single,pins = <
	AM33XX_IOPAD(0x08bc, PIN_OUTPUT_PULLUP | INPUT_EN | MUX_MODE7) >; };	/* Mode 7, Pull-Up, RxActive */
P8_40_gpio_pd_pin: pinmux_P8_40_gpio_pd_pin { pinctrl-single,pins = <
	AM33XX_IOPAD(0x08bc, PIN_OUTPUT_PULLDOWN | INPUT_EN | MUX_MODE7) >; };	/* Mode 7, Pull-Down, RxActive */
P8_40_pruout_pin: pinmux_P8_40_pruout_pin { pinctrl-single,pins = <
	AM33XX_IOPAD(0x08bc, PIN_OUTPUT_PULLDOWN | INPUT_EN | MUX_MODE5) >; };	/* Mode 5, Pull-Down, RxActive */
P8_40_pruin_pin: pinmux_P8_40_pruin_pin { pinctrl-single,pins = <
	AM33XX_IOPAD(0x08bc, PIN_OUTPUT_PULLDOWN | INPUT_EN | MUX_MODE6) >; };	/* Mode 6, Pull-Down, RxActive */
P8_40_qep_pin: pinmux_P8_40_qep_pin { pinctrl-single,pins = <
	AM33XX_IOPAD(0x08bc, PIN_OUTPUT_PULLDOWN | INPUT_EN | MUX_MODE3) >; };	/* Mode 3, Pull-Down, RxActive */

/* P8_41 (ZCZ ball T1) lcd_data4 */
P8_41_default_pin: pinmux_P8_41_default_pin { pinctrl-single,pins = <
	AM33XX_IOPAD(0x08b0, PIN_OUTPUT_PULLDOWN | INPUT_EN | MUX_MODE7) >; };	/* Mode 7, Pull-Down, RxActive */
P8_41_gpio_pin: pinmux_P8_41_gpio_pin { pinctrl-single,pins = <
	AM33XX_IOPAD(0x08b0, PIN_OUTPUT | INPUT_EN | MUX_MODE7) >; };	/* Mode 7, RxActive */
P8_41_gpio_pu_pin: pinmux_P8_41_gpio_pu_pin { pinctrl-single,pins = <
	AM33XX_IOPAD(0x08b0, PIN_OUTPUT_PULLUP | INPUT_EN | MUX_MODE7) >; };	/* Mode 7, Pull-Up, RxActive */
P8_41_gpio_pd_pin: pinmux_P8_41_gpio_pd_pin { pinctrl-single,pins = <
	AM33XX_IOPAD(0x08b0, PIN_OUTPUT_PULLDOWN | INPUT_EN | MUX_MODE7) >; };	/* Mode 7, Pull-Down, RxActive */
P8_41_pruout_pin: pinmux_P8_41_pruout_pin { pinctrl-single,pins = <
	AM33XX_IOPAD(0x08b0, PIN_OUTPUT_PULLDOWN | INPUT_EN | MUX_MODE5) >; };	/* Mode 5, Pull-Down, RxActive */
P8_41_pruin_pin: pinmux_P8_41_pruin_pin { pinctrl-single,pins = <
	AM33XX_IOPAD(0x08b0, PIN_OUTPUT_PULLDOWN | INPUT_EN | MUX_MODE6) >; };	/* Mode 6, Pull-Down, RxActive */
P8_41_qep_pin: pinmux_P8_41_qep_pin { pinctrl-single,pins = <
	AM33XX_IOPAD(0x08b0, PIN_OUTPUT_PULLDOWN | INPUT_EN | MUX_MODE3) >; };	/* Mode 3, Pull-Down, RxActive */

/* P8_42 (ZCZ ball T2) lcd_data5 */
P8_42_default_pin: pinmux_P8_42_default_pin { pinctrl-single,pins = <
	AM33XX_IOPAD(0x08b4, PIN_OUTPUT_PULLDOWN | INPUT_EN | MUX_MODE7) >; };	/* Mode 7, Pull-Down, RxActive */
P8_42_gpio_pin: pinmux_P8_42_gpio_pin { pinctrl-single,pins = <
	AM33XX_IOPAD(0x08b4, PIN_OUTPUT | INPUT_EN | MUX_MODE7) >; };	/* Mode 7, RxActive */
P8_42_gpio_pu_pin: pinmux_P8_42_gpio_pu_pin { pinctrl-single,pins = <
	AM33XX_IOPAD(0x08b4, PIN_OUTPUT_PULLUP | INPUT_EN | MUX_MODE7) >; };	/* Mode 7, Pull-Up, RxActive */
P8_42_gpio_pd_pin: pinmux_P8_42_gpio_pd_pin { pinctrl-single,pins = <
	AM33XX_IOPAD(0x08b4, PIN_OUTPUT_PULLDOWN | INPUT_EN | MUX_MODE7) >; };	/* Mode 7, Pull-Down, RxActive */
P8_42_pruout_pin: pinmux_P8_42_pruout_pin { pinctrl-single,pins = <
	AM33XX_IOPAD(0x08b4, PIN_OUTPUT_PULLDOWN | INPUT_EN | MUX_MODE5) >; };	/* Mode 5, Pull-Down, RxActive */
P8_42_pruin_pin: pinmux_P8_42_pruin_pin { pinctrl-single,pins = <
	AM33XX_IOPAD(0x08b4, PIN_OUTPUT_PULLDOWN | INPUT_EN | MUX_MODE6) >; };	/* Mode 6, Pull-Down, RxActive */
P8_42_qep_pin: pinmux_P8_42_qep_pin { pinctrl-single,pins = <
	AM33XX_IOPAD(0x08b4, PIN_OUTPUT_PULLDOWN | INPUT_EN | MUX_MODE3) >; };	/* Mode 3, Pull-Down, RxActive */

/* P8_43 (ZCZ ball R3) lcd_data2 */
P8_43_default_pin: pinmux_P8_43_default_pin { pinctrl-single,pins = <
	AM33XX_IOPAD(0x08a8, PIN_OUTPUT_PULLDOWN | INPUT_EN | MUX_MODE7) >; };	/* Mode 7, Pull-Down, RxActive */
P8_43_gpio_pin: pinmux_P8_43_gpio_pin { pinctrl-single,pins = <
	AM33XX_IOPAD(0x08a8, PIN_OUTPUT | INPUT_EN | MUX_MODE7) >; };	/* Mode 7, RxActive */
P8_43_gpio_pu_pin: pinmux_P8_43_gpio_pu_pin { pinctrl-single,pins = <
	AM33XX_IOPAD(0x08a8, PIN_OUTPUT_PULLUP | INPUT_EN | MUX_MODE7) >; };	/* Mode 7, Pull-Up, RxActive */
P8_43_gpio_pd_pin: pinmux_P8_43_gpio_pd_pin { pinctrl-single,pins = <
	AM33XX_IOPAD(0x08a8, PIN_OUTPUT_PULLDOWN | INPUT_EN | MUX_MODE7) >; };	/* Mode 7, Pull-Down, RxActive */
P8_43_pruout_pin: pinmux_P8_43_pruout_pin { pinctrl-single,pins = <
	AM33XX_IOPAD(0x08a8, PIN_OUTPUT_PULLDOWN | INPUT_EN | MUX_MODE5) >; };	/* Mode 5, Pull-Down, RxActive */
P8_43_pruin_pin: pinmux_P8_43_pruin_pin { pinctrl-single,pins = <
	AM33XX_IOPAD(0x08a8, PIN_OUTPUT_PULLDOWN | INPUT_EN | MUX_MODE6) >; };	/* Mode 6, Pull-Down, RxActive */
P8_43_pwm_pin: pinmux_P8_43_pwm_pin { pinctrl-single,pins = <
	AM33XX_IOPAD(0x08a8, PIN_OUTPUT_PULLDOWN | INPUT_EN | MUX_MODE3) >; };	/* Mode 3, Pull-Down, RxActive */

/* P8_44 (ZCZ ball R4) lcd_data3 */
P8_44_default_pin: pinmux_P8_44_default_pin { pinctrl-single,pins = <
	AM33XX_IOPAD(0x08ac, PIN_OUTPUT_PULLDOWN | INPUT_EN | MUX_MODE7) >; };	/* Mode 7, Pull-Down, RxActive */
P8_44_gpio_pin: pinmux_P8_44_gpio_pin { pinctrl-single,pins = <
	AM33XX_IOPAD(0x08ac, PIN_OUTPUT | INPUT_EN | MUX_MODE7) >; };	/* Mode 7, RxActive */
P8_44_gpio_pu_pin: pinmux_P8_44_gpio_pu_pin { pinctrl-single,pins = <
	AM33XX_IOPAD(0x08ac, PIN_OUTPUT_PULLUP | INPUT_EN | MUX_MODE7) >; };	/* Mode 7, Pull-Up, RxActive */
P8_44_gpio_pd_pin: pinmux_P8_44_gpio_pd_pin { pinctrl-single,pins = <
	AM33XX_IOPAD(0x08ac, PIN_OUTPUT_PULLDOWN | INPUT_EN | MUX_MODE7) >; };	/* Mode 7, Pull-Down, RxActive */
P8_44_pruout_pin: pinmux_P8_44_pruout_pin { pinctrl-single,pins = <
	AM33XX_IOPAD(0x08ac, PIN_OUTPUT_PULLDOWN | INPUT_EN | MUX_MODE5) >; };	/* Mode 5, Pull-Down, RxActive */
P8_44_pruin_pin: pinmux_P8_44_pruin_pin { pinctrl-single,pins = <
	AM33XX_IOPAD(0x08ac, PIN_OUTPUT_PULLDOWN | INPUT_EN | MUX_MODE6) >; };	/* Mode 6, Pull-Down, RxActive */
P8_44_pwm_pin: pinmux_P8_44_pwm_pin { pinctrl-single,pins = <
	AM33XX_IOPAD(0x08ac, PIN_OUTPUT_PULLDOWN | INPUT_EN | MUX_MODE3) >; };	/* Mode 3, Pull-Down, RxActive */

/* P8_45 (ZCZ ball R1) lcd_data0 */
P8_45_default_pin: pinmux_P8_45_default_pin { pinctrl-single,pins = <
	AM33XX_IOPAD(0x08a0, PIN_OUTPUT_PULLDOWN | INPUT_EN | MUX_MODE7) >; };	/* Mode 7, Pull-Down, RxActive */
P8_45_gpio_pin: pinmux_P8_45_gpio_pin { pinctrl-single,pins = <
	AM33XX_IOPAD(0x08a0, PIN_OUTPUT | INPUT_EN | MUX_MODE7) >; };	/* Mode 7, RxActive */
P8_45_gpio_pu_pin: pinmux_P8_45_gpio_pu_pin { pinctrl-single,pins = <
	AM33XX_IOPAD(0x08a0, PIN_OUTPUT_PULLUP | INPUT_EN | MUX_MODE7) >; };	/* Mode 7, Pull-Up, RxActive */
P8_45_gpio_pd_pin: pinmux_P8_45_gpio_pd_pin { pinctrl-single,pins = <
	AM33XX_IOPAD(0x08a0, PIN_OUTPUT_PULLDOWN | INPUT_EN | MUX_MODE7) >; };	/* Mode 7, Pull-Down, RxActive */
P8_45_pruout_pin: pinmux_P8_45_pruout_pin { pinctrl-single,pins = <
	AM33XX_IOPAD(0x08a0, PIN_OUTPUT_PULLDOWN | INPUT_EN | MUX_MODE5) >; };	/* Mode 5, Pull-Down, RxActive */
P8_45_pruin_pin: pinmux_P8_45_pruin_pin { pinctrl-single,pins = <
	AM33XX_IOPAD(0x08a0, PIN_OUTPUT_PULLDOWN | INPUT_EN | MUX_MODE6) >; };	/* Mode 6, Pull-Down, RxActive */
P8_45_pwm_pin: pinmux_P8_45_pwm_pin { pinctrl-single,pins = <
	AM33XX_IOPAD(0x08a0, PIN_OUTPUT_PULLDOWN | INPUT_EN | MUX_MODE3) >; };	/* Mode 3, Pull-Down, RxActive */

/* P8_46 (ZCZ ball R2) lcd_data1 */
P8_46_default_pin: pinmux_P8_46_default_pin { pinctrl-single,pins = <
	AM33XX_IOPAD(0x08a4, PIN_OUTPUT_PULLDOWN | INPUT_EN | MUX_MODE7) >; };	/* Mode 7, Pull-Down, RxActive */
P8_46_gpio_pin: pinmux_P8_46_gpio_pin { pinctrl-single,pins = <
	AM33XX_IOPAD(0x08a4, PIN_OUTPUT | INPUT_EN | MUX_MODE7) >; };	/* Mode 7, RxActive */
P8_46_gpio_pu_pin: pinmux_P8_46_gpio_pu_pin { pinctrl-single,pins = <
	AM33XX_IOPAD(0x08a4, PIN_OUTPUT_PULLUP | INPUT_EN | MUX_MODE7) >; };	/* Mode 7, Pull-Up, RxActive */
P8_46_gpio_pd_pin: pinmux_P8_46_gpio_pd_pin { pinctrl-single,pins = <
	AM33XX_IOPAD(0x08a4, PIN_OUTPUT_PULLDOWN | INPUT_EN | MUX_MODE7) >; };	/* Mode 7, Pull-Down, RxActive */
P8_46_pruout_pin: pinmux_P8_46_pruout_pin { pinctrl-single,pins = <
	AM33XX_IOPAD(0x08a4, PIN_OUTPUT_PULLDOWN | INPUT_EN | MUX_MODE5) >; };	/* Mode 5, Pull-Down, RxActive */
P8_46_pruin_pin: pinmux_P8_46_pruin_pin { pinctrl-single,pins = <
	AM33XX_IOPAD(0x08a4, PIN_OUTPUT_PULLDOWN | INPUT_EN | MUX_MODE6) >; };	/* Mode 6, Pull-Down, RxActive */
P8_46_pwm_pin: pinmux_P8_46_pwm_pin { pinctrl-single,pins = <
	AM33XX_IOPAD(0x08a4, PIN_OUTPUT_PULLDOWN | INPUT_EN | MUX_MODE3) >; };	/* Mode 3, Pull-Down, RxActive */


/* P9_11 (ZCZ ball T17) gpmc_wait0 */
P9_11_default_pin: pinmux_P9_11_default_pin { pinctrl-single,pins = <
	AM33XX_IOPAD(0x0870, PIN_OUTPUT_PULLDOWN | INPUT_EN | MUX_MODE7) >; };	/* Mode 7, Pull-Down, RxActive */
P9_11_gpio_pin: pinmux_P9_11_gpio_pin { pinctrl-single,pins = <
	AM33XX_IOPAD(0x0870, PIN_OUTPUT | INPUT_EN | MUX_MODE7) >; };	/* Mode 7, RxActive */
P9_11_gpio_pu_pin: pinmux_P9_11_gpio_pu_pin { pinctrl-single,pins = <
	AM33XX_IOPAD(0x0870, PIN_OUTPUT_PULLUP | INPUT_EN | MUX_MODE7) >; };	/* Mode 7, Pull-Up, RxActive */
P9_11_gpio_pd_pin: pinmux_P9_11_gpio_pd_pin { pinctrl-single,pins = <
	AM33XX_IOPAD(0x0870, PIN_OUTPUT_PULLDOWN | INPUT_EN | MUX_MODE7) >; };	/* Mode 7, Pull-Down, RxActive */
P9_11_uart_pin: pinmux_P9_11_uart_pin { pinctrl-single,pins = <
	AM33XX_IOPAD(0x0870, PIN_OUTPUT_PULLDOWN | INPUT_EN | MUX_MODE6) >; };	/* Mode 6, Pull-Down, RxActive */

/* P9_12 (ZCZ ball U18) gpmc_be1n */
P9_12_default_pin: pinmux_P9_12_default_pin { pinctrl-single,pins = <
	AM33XX_IOPAD(0x0878, PIN_OUTPUT_PULLDOWN | INPUT_EN | MUX_MODE7) >; };	/* Mode 7, Pull-Down, RxActive */
P9_12_gpio_pin: pinmux_P9_12_gpio_pin { pinctrl-single,pins = <
	AM33XX_IOPAD(0x0878, PIN_OUTPUT | INPUT_EN | MUX_MODE7) >; };	/* Mode 7, RxActive */
P9_12_gpio_pu_pin: pinmux_P9_12_gpio_pu_pin { pinctrl-single,pins = <
	AM33XX_IOPAD(0x0878, PIN_OUTPUT_PULLUP | INPUT_EN | MUX_MODE7) >; };	/* Mode 7, Pull-Up, RxActive */
P9_12_gpio_pd_pin: pinmux_P9_12_gpio_pd_pin { pinctrl-single,pins = <
	AM33XX_IOPAD(0x0878, PIN_OUTPUT_PULLDOWN | INPUT_EN | MUX_MODE7) >; };	/* Mode 7, Pull-Down, RxActive */

/* P9_13 (ZCZ ball U17) gpmc_wpn */
P9_13_default_pin: pinmux_P9_13_default_pin { pinctrl-single,pins = <
	AM33XX_IOPAD(0x0874, PIN_OUTPUT_PULLDOWN | INPUT_EN | MUX_MODE7) >; };	/* Mode 7, Pull-Down, RxActive */
P9_13_gpio_pin: pinmux_P9_13_gpio_pin { pinctrl-single,pins = <
	AM33XX_IOPAD(0x0874, PIN_OUTPUT | INPUT_EN | MUX_MODE7) >; };	/* Mode 7, RxActive */
P9_13_gpio_pu_pin: pinmux_P9_13_gpio_pu_pin { pinctrl-single,pins = <
	AM33XX_IOPAD(0x0874, PIN_OUTPUT_PULLUP | INPUT_EN | MUX_MODE7) >; };	/* Mode 7, Pull-Up, RxActive */
P9_13_gpio_pd_pin: pinmux_P9_13_gpio_pd_pin { pinctrl-single,pins = <
	AM33XX_IOPAD(0x0874, PIN_OUTPUT_PULLDOWN | INPUT_EN | MUX_MODE7) >; };	/* Mode 7, Pull-Down, RxActive */
P9_13_uart_pin: pinmux_P9_13_uart_pin { pinctrl-single,pins = <
	AM33XX_IOPAD(0x0874, PIN_OUTPUT_PULLDOWN | INPUT_EN | MUX_MODE6) >; };	/* Mode 6, Pull-Down, RxActive */

/* P9_14 (ZCZ ball U14) gpmc_a2 */
P9_14_default_pin: pinmux_P9_14_default_pin { pinctrl-single,pins = <
	AM33XX_IOPAD(0x0848, PIN_OUTPUT_PULLDOWN | INPUT_EN | MUX_MODE7) >; };	/* Mode 7, Pull-Down, RxActive */
P9_14_gpio_pin: pinmux_P9_14_gpio_pin { pinctrl-single,pins = <
	AM33XX_IOPAD(0x0848, PIN_OUTPUT | INPUT_EN | MUX_MODE7) >; };	/* Mode 7, RxActive */
P9_14_gpio_pu_pin: pinmux_P9_14_gpio_pu_pin { pinctrl-single,pins = <
	AM33XX_IOPAD(0x0848, PIN_OUTPUT_PULLUP | INPUT_EN | MUX_MODE7) >; };	/* Mode 7, Pull-Up, RxActive */
P9_14_gpio_pd_pin: pinmux_P9_14_gpio_pd_pin { pinctrl-single,pins = <
	AM33XX_IOPAD(0x0848, PIN_OUTPUT_PULLDOWN | INPUT_EN | MUX_MODE7) >; };	/* Mode 7, Pull-Down, RxActive */
P9_14_pwm_pin: pinmux_P9_14_pwm_pin { pinctrl-single,pins = <
	AM33XX_IOPAD(0x0848, PIN_OUTPUT_PULLDOWN | INPUT_EN | MUX_MODE6) >; };	/* Mode 6, Pull-Down, RxActive */

/* P9_15 (ZCZ ball R13) gpmc_a0 */
P9_15_default_pin: pinmux_P9_15_default_pin { pinctrl-single,pins = <
	AM33XX_IOPAD(0x0840, PIN_OUTPUT_PULLDOWN | INPUT_EN | MUX_MODE7) >; };	/* Mode 7, Pull-Down, RxActive */
P9_15_gpio_pin: pinmux_P9_15_gpio_pin { pinctrl-single,pins = <
	AM33XX_IOPAD(0x0840, PIN_OUTPUT | INPUT_EN | MUX_MODE7) >; };	/* Mode 7, RxActive */
P9_15_gpio_pu_pin: pinmux_P9_15_gpio_pu_pin { pinctrl-single,pins = <
	AM33XX_IOPAD(0x0840, PIN_OUTPUT_PULLUP | INPUT_EN | MUX_MODE7) >; };	/* Mode 7, Pull-Up, RxActive */
P9_15_gpio_pd_pin: pinmux_P9_15_gpio_pd_pin { pinctrl-single,pins = <
	AM33XX_IOPAD(0x0840, PIN_OUTPUT_PULLDOWN | INPUT_EN | MUX_MODE7) >; };	/* Mode 7, Pull-Down, RxActive */
P9_15_pwm_pin: pinmux_P9_15_pwm_pin { pinctrl-single,pins = <
	AM33XX_IOPAD(0x0840, PIN_OUTPUT_PULLDOWN | INPUT_EN | MUX_MODE6) >; };	/* Mode 6, Pull-Down, RxActive */

/* P9_16 (ZCZ ball T14) gpmc_a3 */
P9_16_default_pin: pinmux_P9_16_default_pin { pinctrl-single,pins = <
	AM33XX_IOPAD(0x084c, PIN_OUTPUT_PULLDOWN | INPUT_EN | MUX_MODE7) >; };	/* Mode 7, Pull-Down, RxActive */
P9_16_gpio_pin: pinmux_P9_16_gpio_pin { pinctrl-single,pins = <
	AM33XX_IOPAD(0x084c, PIN_OUTPUT | INPUT_EN | MUX_MODE7) >; };	/* Mode 7, RxActive */
P9_16_gpio_pu_pin: pinmux_P9_16_gpio_pu_pin { pinctrl-single,pins = <
	AM33XX_IOPAD(0x084c, PIN_OUTPUT_PULLUP | INPUT_EN | MUX_MODE7) >; };	/* Mode 7, Pull-Up, RxActive */
P9_16_gpio_pd_pin: pinmux_P9_16_gpio_pd_pin { pinctrl-single,pins = <
	AM33XX_IOPAD(0x084c, PIN_OUTPUT_PULLDOWN | INPUT_EN | MUX_MODE7) >; };	/* Mode 7, Pull-Down, RxActive */
P9_16_pwm_pin: pinmux_P9_16_pwm_pin { pinctrl-single,pins = <
	AM33XX_IOPAD(0x084c, PIN_OUTPUT_PULLDOWN | INPUT_EN | MUX_MODE6) >; };	/* Mode 6, Pull-Down, RxActive */

/* P9_17 (ZCZ ball A16) spi0_cs0 */
P9_17_default_pin: pinmux_P9_17_default_pin { pinctrl-single,pins = <
	AM33XX_IOPAD(0x095c, PIN_OUTPUT_PULLDOWN | INPUT_EN | MUX_MODE7) >; };	/* Mode 7, Pull-Down, RxActive */
P9_17_gpio_pin: pinmux_P9_17_gpio_pin { pinctrl-single,pins = <
	AM33XX_IOPAD(0x095c, PIN_OUTPUT | INPUT_EN | MUX_MODE7) >; };	/* Mode 7, RxActive */
P9_17_gpio_pu_pin: pinmux_P9_17_gpio_pu_pin { pinctrl-single,pins = <
	AM33XX_IOPAD(0x095c, PIN_OUTPUT_PULLUP | INPUT_EN | MUX_MODE7) >; };	/* Mode 7, Pull-Up, RxActive */
P9_17_gpio_pd_pin: pinmux_P9_17_gpio_pd_pin { pinctrl-single,pins = <
	AM33XX_IOPAD(0x095c, PIN_OUTPUT_PULLDOWN | INPUT_EN | MUX_MODE7) >; };	/* Mode 7, Pull-Down, RxActive */
P9_17_spi_pin: pinmux_P9_17_spi_pin { pinctrl-single,pins = <
	AM33XX_IOPAD(0x095c, PIN_OUTPUT_PULLUP | INPUT_EN | MUX_MODE0) >; };	/* Mode 0, Pull-Up, RxActive */
P9_17_i2c_pin: pinmux_P9_17_i2c_pin { pinctrl-single,pins = <
	AM33XX_IOPAD(0x095c, PIN_OUTPUT_PULLUP | INPUT_EN | MUX_MODE2) >; };	/* Mode 2, Pull-Up, RxActive */
P9_17_pru_uart_pin: pinmux_P9_17_pru_uart_pin { pinctrl-single,pins = <
	AM33XX_IOPAD(0x095c, PIN_OUTPUT_PULLUP | INPUT_EN | MUX_MODE4) >; };	/* Mode 4, Pull-Up, RxActive */
P9_17_pwm_pin: pinmux_P9_17_pwm_pin { pinctrl-single,pins = <
	AM33XX_IOPAD(0x095c, PIN_OUTPUT_PULLDOWN | INPUT_EN | MUX_MODE3) >; };	/* Mode 3, Pull-Down, RxActive */

/* P9_18 (ZCZ ball B16) spi0_d1 */
P9_18_default_pin: pinmux_P9_18_default_pin { pinctrl-single,pins = <
	AM33XX_IOPAD(0x0958, PIN_OUTPUT_PULLDOWN | INPUT_EN | MUX_MODE7) >; };	/* Mode 7, Pull-Down, RxActive */
P9_18_gpio_pin: pinmux_P9_18_gpio_pin { pinctrl-single,pins = <
	AM33XX_IOPAD(0x0958, PIN_OUTPUT | INPUT_EN | MUX_MODE7) >; };	/* Mode 7, RxActive */
P9_18_gpio_pu_pin: pinmux_P9_18_gpio_pu_pin { pinctrl-single,pins = <
	AM33XX_IOPAD(0x0958, PIN_OUTPUT_PULLUP | INPUT_EN | MUX_MODE7) >; };	/* Mode 7, Pull-Up, RxActive */
P9_18_gpio_pd_pin: pinmux_P9_18_gpio_pd_pin { pinctrl-single,pins = <
	AM33XX_IOPAD(0x0958, PIN_OUTPUT_PULLDOWN | INPUT_EN | MUX_MODE7) >; };	/* Mode 7, Pull-Down, RxActive */
P9_18_spi_pin: pinmux_P9_18_spi_pin { pinctrl-single,pins = <
	AM33XX_IOPAD(0x0958, PIN_OUTPUT_PULLUP | INPUT_EN | MUX_MODE0) >; };	/* Mode 0, Pull-Up, RxActive */
P9_18_i2c_pin: pinmux_P9_18_i2c_pin { pinctrl-single,pins = <
	AM33XX_IOPAD(0x0958, PIN_OUTPUT_PULLUP | INPUT_EN | MUX_MODE2) >; };	/* Mode 2, Pull-Up, RxActive */
P9_18_pru_uart_pin: pinmux_P9_18_pru_uart_pin { pinctrl-single,pins = <
	AM33XX_IOPAD(0x0958, PIN_OUTPUT_PULLUP | INPUT_EN | MUX_MODE4) >; };	/* Mode 4, Pull-Up, RxActive */
P9_18_pwm_pin: pinmux_P9_18_pwm_pin { pinctrl-single,pins = <
	AM33XX_IOPAD(0x0958, PIN_OUTPUT_PULLDOWN | INPUT_EN | MUX_MODE3) >; };	/* Mode 3, Pull-Down, RxActive */

/* P9_21 (ZCZ ball B17) spi0_d0 */
P9_21_default_pin: pinmux_P9_21_default_pin { pinctrl-single,pins = <
	AM33XX_IOPAD(0x0954, PIN_OUTPUT_PULLDOWN | INPUT_EN | MUX_MODE7) >; };	/* Mode 7, Pull-Down, RxActive */
P9_21_gpio_pin: pinmux_P9_21_gpio_pin { pinctrl-single,pins = <
	AM33XX_IOPAD(0x0954, PIN_OUTPUT | INPUT_EN | MUX_MODE7) >; };	/* Mode 7, RxActive */
P9_21_gpio_pu_pin: pinmux_P9_21_gpio_pu_pin { pinctrl-single,pins = <
	AM33XX_IOPAD(0x0954, PIN_OUTPUT_PULLUP | INPUT_EN | MUX_MODE7) >; };	/* Mode 7, Pull-Up, RxActive */
P9_21_gpio_pd_pin: pinmux_P9_21_gpio_pd_pin { pinctrl-single,pins = <
	AM33XX_IOPAD(0x0954, PIN_OUTPUT_PULLDOWN | INPUT_EN | MUX_MODE7) >; };	/* Mode 7, Pull-Down, RxActive */
P9_21_spi_pin: pinmux_P9_21_spi_pin { pinctrl-single,pins = <
	AM33XX_IOPAD(0x0954, PIN_OUTPUT_PULLUP | INPUT_EN | MUX_MODE0) >; };	/* Mode 0, Pull-Up, RxActive */
P9_21_i2c_pin: pinmux_P9_21_i2c_pin { pinctrl-single,pins = <
	AM33XX_IOPAD(0x0954, PIN_OUTPUT_PULLUP | INPUT_EN | MUX_MODE2) >; };	/* Mode 2, Pull-Up, RxActive */
P9_21_uart_pin: pinmux_P9_21_uart_pin { pinctrl-single,pins = <
	AM33XX_IOPAD(0x0954, PIN_OUTPUT_PULLDOWN | INPUT_EN | MUX_MODE1) >; };	/* Mode 1, Pull-Down, RxActive */
P9_21_pru_uart_pin: pinmux_P9_21_pru_uart_pin { pinctrl-single,pins = <
	AM33XX_IOPAD(0x0954, PIN_OUTPUT_PULLUP | INPUT_EN | MUX_MODE4) >; };	/* Mode 4, Pull-Up, RxActive */
P9_21_pwm_pin: pinmux_P9_21_pwm_pin { pinctrl-single,pins = <
	AM33XX_IOPAD(0x0954, PIN_OUTPUT_PULLDOWN | INPUT_EN | MUX_MODE3) >; };	/* Mode 3, Pull-Down, RxActive */

/* P9_22 (ZCZ ball A17) spi0_sclk */
P9_22_default_pin: pinmux_P9_22_default_pin { pinctrl-single,pins = <
	AM33XX_IOPAD(0x0950, PIN_OUTPUT_PULLDOWN | INPUT_EN | MUX_MODE7) >; };	/* Mode 7, Pull-Down, RxActive */
P9_22_gpio_pin: pinmux_P9_22_gpio_pin { pinctrl-single,pins = <
	AM33XX_IOPAD(0x0950, PIN_OUTPUT | INPUT_EN | MUX_MODE7) >; };	/* Mode 7, RxActive */
P9_22_gpio_pu_pin: pinmux_P9_22_gpio_pu_pin { pinctrl-single,pins = <
	AM33XX_IOPAD(0x0950, PIN_OUTPUT_PULLUP | INPUT_EN | MUX_MODE7) >; };	/* Mode 7, Pull-Up, RxActive */
P9_22_gpio_pd_pin: pinmux_P9_22_gpio_pd_pin { pinctrl-single,pins = <
	AM33XX_IOPAD(0x0950, PIN_OUTPUT_PULLDOWN | INPUT_EN | MUX_MODE7) >; };	/* Mode 7, Pull-Down, RxActive */
P9_22_spi_pin: pinmux_P9_22_spi_pin { pinctrl-single,pins = <
	AM33XX_IOPAD(0x0950, PIN_OUTPUT_PULLUP | INPUT_EN | MUX_MODE0) >; };	/* Mode 0, Pull-Up, RxActive */
P9_22_i2c_pin: pinmux_P9_22_i2c_pin { pinctrl-single,pins = <
	AM33XX_IOPAD(0x0950, PIN_OUTPUT_PULLUP | INPUT_EN | MUX_MODE2) >; };	/* Mode 2, Pull-Up, RxActive */
P9_22_uart_pin: pinmux_P9_22_uart_pin { pinctrl-single,pins = <
	AM33XX_IOPAD(0x0950, PIN_OUTPUT_PULLDOWN | INPUT_EN | MUX_MODE1) >; };	/* Mode 1, Pull-Down, RxActive */
P9_22_pru_uart_pin: pinmux_P9_22_pru_uart_pin { pinctrl-single,pins = <
	AM33XX_IOPAD(0x0950, PIN_OUTPUT_PULLUP | INPUT_EN | MUX_MODE4) >; };	/* Mode 4, Pull-Up, RxActive */
P9_22_pwm_pin: pinmux_P9_22_pwm_pin { pinctrl-single,pins = <
	AM33XX_IOPAD(0x0950, PIN_OUTPUT_PULLDOWN | INPUT_EN | MUX_MODE3) >; };	/* Mode 3, Pull-Down, RxActive */

/* P9_23 (ZCZ ball V14) gpmc_a1 */
P9_23_default_pin: pinmux_P9_23_default_pin { pinctrl-single,pins = <
	AM33XX_IOPAD(0x0844, PIN_OUTPUT_PULLDOWN | INPUT_EN | MUX_MODE7) >; };	/* Mode 7, Pull-Down, RxActive */
P9_23_gpio_pin: pinmux_P9_23_gpio_pin { pinctrl-single,pins = <
	AM33XX_IOPAD(0x0844, PIN_OUTPUT | INPUT_EN | MUX_MODE7) >; };	/* Mode 7, RxActive */
P9_23_gpio_pu_pin: pinmux_P9_23_gpio_pu_pin { pinctrl-single,pins = <
	AM33XX_IOPAD(0x0844, PIN_OUTPUT_PULLUP | INPUT_EN | MUX_MODE7) >; };	/* Mode 7, Pull-Up, RxActive */
P9_23_gpio_pd_pin: pinmux_P9_23_gpio_pd_pin { pinctrl-single,pins = <
	AM33XX_IOPAD(0x0844, PIN_OUTPUT_PULLDOWN | INPUT_EN | MUX_MODE7) >; };	/* Mode 7, Pull-Down, RxActive */
P9_23_pwm_pin: pinmux_P9_23_pwm_pin { pinctrl-single,pins = <
	AM33XX_IOPAD(0x0844, PIN_OUTPUT_PULLDOWN | INPUT_EN | MUX_MODE6) >; };	/* Mode 6, Pull-Down, RxActive */

/* P9_24 (ZCZ ball D15) uart1_txd */
P9_24_default_pin: pinmux_P9_24_default_pin { pinctrl-single,pins = <
	AM33XX_IOPAD(0x0984, PIN_OUTPUT_PULLDOWN | INPUT_EN | MUX_MODE7) >; };	/* Mode 7, Pull-Down, RxActive */
P9_24_gpio_pin: pinmux_P9_24_gpio_pin { pinctrl-single,pins = <
	AM33XX_IOPAD(0x0984, PIN_OUTPUT | INPUT_EN | MUX_MODE7) >; };	/* Mode 7, RxActive */
P9_24_gpio_pu_pin: pinmux_P9_24_gpio_pu_pin { pinctrl-single,pins = <
	AM33XX_IOPAD(0x0984, PIN_OUTPUT_PULLUP | INPUT_EN | MUX_MODE7) >; };	/* Mode 7, Pull-Up, RxActive */
P9_24_gpio_pd_pin: pinmux_P9_24_gpio_pd_pin { pinctrl-single,pins = <
	AM33XX_IOPAD(0x0984, PIN_OUTPUT_PULLDOWN | INPUT_EN | MUX_MODE7) >; };	/* Mode 7, Pull-Down, RxActive */
P9_24_i2c_pin: pinmux_P9_24_i2c_pin { pinctrl-single,pins = <
	AM33XX_IOPAD(0x0984, PIN_OUTPUT_PULLUP | INPUT_EN | MUX_MODE3) >; };	/* Mode 3, Pull-Up, RxActive */
P9_24_uart_pin: pinmux_P9_24_uart_pin { pinctrl-single,pins = <
	AM33XX_IOPAD(0x0984, PIN_OUTPUT_PULLDOWN | INPUT_EN | MUX_MODE0) >; };	/* Mode 0, Pull-Down, RxActive */
P9_24_can_pin: pinmux_P9_24_can_pin { pinctrl-single,pins = <
	AM33XX_IOPAD(0x0984, PIN_OUTPUT_PULLUP | INPUT_EN | MUX_MODE2) >; };	/* Mode 2, Pull-Up, RxActive */
P9_24_pru_uart_pin: pinmux_P9_24_pru_uart_pin { pinctrl-single,pins = <
	AM33XX_IOPAD(0x0984, PIN_OUTPUT_PULLUP | INPUT_EN | MUX_MODE5) >; };	/* Mode 5, Pull-Up, RxActive */
P9_24_pruin_pin: pinmux_P9_24_pruin_pin { pinctrl-single,pins = <
	AM33XX_IOPAD(0x0984, PIN_OUTPUT_PULLDOWN | INPUT_EN | MUX_MODE6) >; };	/* Mode 6, Pull-Down, RxActive */

/* P9_25 (ZCZ ball A14) mcasp0_ahclkx */
P9_25_default_pin: pinmux_P9_25_default_pin { pinctrl-single,pins = <
	AM33XX_IOPAD(0x09ac, PIN_OUTPUT_PULLDOWN | INPUT_EN | MUX_MODE7) >; };	/* Mode 7, Pull-Down, RxActive */
P9_25_gpio_pin: pinmux_P9_25_gpio_pin { pinctrl-single,pins = <
	AM33XX_IOPAD(0x09ac, PIN_OUTPUT | INPUT_EN | MUX_MODE7) >; };	/* Mode 7, RxActive */
P9_25_gpio_pu_pin: pinmux_P9_25_gpio_pu_pin { pinctrl-single,pins = <
	AM33XX_IOPAD(0x09ac, PIN_OUTPUT_PULLUP | INPUT_EN | MUX_MODE7) >; };	/* Mode 7, Pull-Up, RxActive */
P9_25_gpio_pd_pin: pinmux_P9_25_gpio_pd_pin { pinctrl-single,pins = <
	AM33XX_IOPAD(0x09ac, PIN_OUTPUT_PULLDOWN | INPUT_EN | MUX_MODE7) >; };	/* Mode 7, Pull-Down, RxActive */
P9_25_pruout_pin: pinmux_P9_25_pruout_pin { pinctrl-single,pins = <
	AM33XX_IOPAD(0x09ac, PIN_OUTPUT_PULLDOWN | INPUT_EN | MUX_MODE5) >; };	/* Mode 5, Pull-Down, RxActive */
P9_25_pruin_pin: pinmux_P9_25_pruin_pin { pinctrl-single,pins = <
	AM33XX_IOPAD(0x09ac, PIN_OUTPUT_PULLDOWN | INPUT_EN | MUX_MODE6) >; };	/* Mode 6, Pull-Down, RxActive */
P9_25_qep_pin: pinmux_P9_25_qep_pin { pinctrl-single,pins = <
	AM33XX_IOPAD(0x09ac, PIN_OUTPUT_PULLDOWN | INPUT_EN | MUX_MODE1) >; };	/* Mode 1, Pull-Down, RxActive */

/* P9_26 (ZCZ ball D16) uart1_rxd */
P9_26_default_pin: pinmux_P9_26_default_pin { pinctrl-single,pins = <
	AM33XX_IOPAD(0x0980, PIN_OUTPUT_PULLDOWN | INPUT_EN | MUX_MODE7) >; };	/* Mode 7, Pull-Down, RxActive */
P9_26_gpio_pin: pinmux_P9_26_gpio_pin { pinctrl-single,pins = <
	AM33XX_IOPAD(0x0980, PIN_OUTPUT | INPUT_EN | MUX_MODE7) >; };	/* Mode 7, RxActive */
P9_26_gpio_pu_pin: pinmux_P9_26_gpio_pu_pin { pinctrl-single,pins = <
	AM33XX_IOPAD(0x0980, PIN_OUTPUT_PULLUP | INPUT_EN | MUX_MODE7) >; };	/* Mode 7, Pull-Up, RxActive */
P9_26_gpio_pd_pin: pinmux_P9_26_gpio_pd_pin { pinctrl-single,pins = <
	AM33XX_IOPAD(0x0980, PIN_OUTPUT_PULLDOWN | INPUT_EN | MUX_MODE7) >; };	/* Mode 7, Pull-Down, RxActive */
P9_26_i2c_pin: pinmux_P9_26_i2c_pin { pinctrl-single,pins = <
	AM33XX_IOPAD(0x0980, PIN_OUTPUT_PULLUP | INPUT_EN | MUX_MODE3) >; };	/* Mode 3, Pull-Up, RxActive */
P9_26_uart_pin: pinmux_P9_26_uart_pin { pinctrl-single,pins = <
	AM33XX_IOPAD(0x0980, PIN_OUTPUT_PULLDOWN | INPUT_EN | MUX_MODE0) >; };	/* Mode 0, Pull-Down, RxActive */
P9_26_can_pin: pinmux_P9_26_can_pin { pinctrl-single,pins = <
	AM33XX_IOPAD(0x0980, PIN_OUTPUT_PULLUP | INPUT_EN | MUX_MODE2) >; };	/* Mode 2, Pull-Up, RxActive */
P9_26_pru_uart_pin: pinmux_P9_26_pru_uart_pin { pinctrl-single,pins = <
	AM33XX_IOPAD(0x0980, PIN_OUTPUT_PULLUP | INPUT_EN | MUX_MODE5) >; };	/* Mode 5, Pull-Up, RxActive */
P9_26_pruin_pin: pinmux_P9_26_pruin_pin { pinctrl-single,pins = <
	AM33XX_IOPAD(0x0980, PIN_OUTPUT_PULLDOWN | INPUT_EN | MUX_MODE6) >; };	/* Mode 6, Pull-Down, RxActive */

/* P9_27 (ZCZ ball C13) mcasp0_fsr */
P9_27_default_pin: pinmux_P9_27_default_pin { pinctrl-single,pins = <
	AM33XX_IOPAD(0x09a4, PIN_OUTPUT_PULLDOWN | INPUT_EN | MUX_MODE7) >; };	/* Mode 7, Pull-Down, RxActive */
P9_27_gpio_pin: pinmux_P9_27_gpio_pin { pinctrl-single,pins = <
	AM33XX_IOPAD(0x09a4, PIN_OUTPUT | INPUT_EN | MUX_MODE7) >; };	/* Mode 7, RxActive */
P9_27_gpio_pu_pin: pinmux_P9_27_gpio_pu_pin { pinctrl-single,pins = <
	AM33XX_IOPAD(0x09a4, PIN_OUTPUT_PULLUP | INPUT_EN | MUX_MODE7) >; };	/* Mode 7, Pull-Up, RxActive */
P9_27_gpio_pd_pin: pinmux_P9_27_gpio_pd_pin { pinctrl-single,pins = <
	AM33XX_IOPAD(0x09a4, PIN_OUTPUT_PULLDOWN | INPUT_EN | MUX_MODE7) >; };	/* Mode 7, Pull-Down, RxActive */
P9_27_pruout_pin: pinmux_P9_27_pruout_pin { pinctrl-single,pins = <
	AM33XX_IOPAD(0x09a4, PIN_OUTPUT_PULLDOWN | INPUT_EN | MUX_MODE5) >; };	/* Mode 5, Pull-Down, RxActive */
P9_27_pruin_pin: pinmux_P9_27_pruin_pin { pinctrl-single,pins = <
	AM33XX_IOPAD(0x09a4, PIN_OUTPUT_PULLDOWN | INPUT_EN | MUX_MODE6) >; };	/* Mode 6, Pull-Down, RxActive */
P9_27_qep_pin: pinmux_P9_27_qep_pin { pinctrl-single,pins = <
	AM33XX_IOPAD(0x09a4, PIN_OUTPUT_PULLDOWN | INPUT_EN | MUX_MODE1) >; };	/* Mode 1, Pull-Down, RxActive */

/* P9_28 (ZCZ ball C12) mcasp0_ahclkr */
P9_28_default_pin: pinmux_P9_28_default_pin { pinctrl-single,pins = <
	AM33XX_IOPAD(0x099c, PIN_OUTPUT_PULLDOWN | INPUT_EN | MUX_MODE7) >; };	/* Mode 7, Pull-Down, RxActive */
P9_28_gpio_pin: pinmux_P9_28_gpio_pin { pinctrl-single,pins = <
	AM33XX_IOPAD(0x099c, PIN_OUTPUT | INPUT_EN | MUX_MODE7) >; };	/* Mode 7, RxActive */
P9_28_gpio_pu_pin: pinmux_P9_28_gpio_pu_pin { pinctrl-single,pins = <
	AM33XX_IOPAD(0x099c, PIN_OUTPUT_PULLUP | INPUT_EN | MUX_MODE7) >; };	/* Mode 7, Pull-Up, RxActive */
P9_28_gpio_pd_pin: pinmux_P9_28_gpio_pd_pin { pinctrl-single,pins = <
	AM33XX_IOPAD(0x099c, PIN_OUTPUT_PULLDOWN | INPUT_EN | MUX_MODE7) >; };	/* Mode 7, Pull-Down, RxActive */
P9_28_spi_pin: pinmux_P9_28_spi_pin { pinctrl-single,pins = <
	AM33XX_IOPAD(0x099c, PIN_OUTPUT_PULLUP | INPUT_EN | MUX_MODE3) >; };	/* Mode 3, Pull-Up, RxActive */
P9_28_pruout_pin: pinmux_P9_28_pruout_pin { pinctrl-single,pins = <
	AM33XX_IOPAD(0x099c, PIN_OUTPUT_PULLDOWN | INPUT_EN | MUX_MODE5) >; };	/* Mode 5, Pull-Down, RxActive */
P9_28_pruin_pin: pinmux_P9_28_pruin_pin { pinctrl-single,pins = <
	AM33XX_IOPAD(0x099c, PIN_OUTPUT_PULLDOWN | INPUT_EN | MUX_MODE6) >; };	/* Mode 6, Pull-Down, RxActive */
P9_28_pwm_pin: pinmux_P9_28_pwm_pin { pinctrl-single,pins = <
	AM33XX_IOPAD(0x099c, PIN_OUTPUT_PULLDOWN | INPUT_EN | MUX_MODE1) >; };	/* Mode 1, Pull-Down, RxActive */

/* P9_29 (ZCZ ball B13) mcasp0_fsx */
P9_29_default_pin: pinmux_P9_29_default_pin { pinctrl-single,pins = <
	AM33XX_IOPAD(0x0994, PIN_OUTPUT_PULLDOWN | INPUT_EN | MUX_MODE7) >; };	/* Mode 7, Pull-Down, RxActive */
P9_29_gpio_pin: pinmux_P9_29_gpio_pin { pinctrl-single,pins = <
	AM33XX_IOPAD(0x0994, PIN_OUTPUT | INPUT_EN | MUX_MODE7) >; };	/* Mode 7, RxActive */
P9_29_gpio_pu_pin: pinmux_P9_29_gpio_pu_pin { pinctrl-single,pins = <
	AM33XX_IOPAD(0x0994, PIN_OUTPUT_PULLUP | INPUT_EN | MUX_MODE7) >; };	/* Mode 7, Pull-Up, RxActive */
P9_29_gpio_pd_pin: pinmux_P9_29_gpio_pd_pin { pinctrl-single,pins = <
	AM33XX_IOPAD(0x0994, PIN_OUTPUT_PULLDOWN | INPUT_EN | MUX_MODE7) >; };	/* Mode 7, Pull-Down, RxActive */
P9_29_spi_pin: pinmux_P9_29_spi_pin { pinctrl-single,pins = <
	AM33XX_IOPAD(0x0994, PIN_OUTPUT_PULLUP | INPUT_EN | MUX_MODE3) >; };	/* Mode 3, Pull-Up, RxActive */
P9_29_pruout_pin: pinmux_P9_29_pruout_pin { pinctrl-single,pins = <
	AM33XX_IOPAD(0x0994, PIN_OUTPUT_PULLDOWN | INPUT_EN | MUX_MODE5) >; };	/* Mode 5, Pull-Down, RxActive */
P9_29_pruin_pin: pinmux_P9_29_pruin_pin { pinctrl-single,pins = <
	AM33XX_IOPAD(0x0994, PIN_OUTPUT_PULLDOWN | INPUT_EN | MUX_MODE6) >; };	/* Mode 6, Pull-Down, RxActive */
P9_29_pwm_pin: pinmux_P9_29_pwm_pin { pinctrl-single,pins = <
	AM33XX_IOPAD(0x0994, PIN_OUTPUT_PULLDOWN | INPUT_EN | MUX_MODE1) >; };	/* Mode 1, Pull-Down, RxActive */

/* P9_30 (ZCZ ball D12) mcasp0_axr0 */
P9_30_default_pin: pinmux_P9_30_default_pin { pinctrl-single,pins = <
	AM33XX_IOPAD(0x0998, PIN_OUTPUT_PULLDOWN | INPUT_EN | MUX_MODE7) >; };	/* Mode 7, Pull-Down, RxActive */
P9_30_gpio_pin: pinmux_P9_30_gpio_pin { pinctrl-single,pins = <
	AM33XX_IOPAD(0x0998, PIN_OUTPUT | INPUT_EN | MUX_MODE7) >; };	/* Mode 7, RxActive */
P9_30_gpio_pu_pin: pinmux_P9_30_gpio_pu_pin { pinctrl-single,pins = <
	AM33XX_IOPAD(0x0998, PIN_OUTPUT_PULLUP | INPUT_EN | MUX_MODE7) >; };	/* Mode 7, Pull-Up, RxActive */
P9_30_gpio_pd_pin: pinmux_P9_30_gpio_pd_pin { pinctrl-single,pins = <
	AM33XX_IOPAD(0x0998, PIN_OUTPUT_PULLDOWN | INPUT_EN | MUX_MODE7) >; };	/* Mode 7, Pull-Down, RxActive */
P9_30_spi_pin: pinmux_P9_30_spi_pin { pinctrl-single,pins = <
	AM33XX_IOPAD(0x0998, PIN_OUTPUT_PULLUP | INPUT_EN | MUX_MODE3) >; };	/* Mode 3, Pull-Up, RxActive */
P9_30_pruout_pin: pinmux_P9_30_pruout_pin { pinctrl-single,pins = <
	AM33XX_IOPAD(0x0998, PIN_OUTPUT_PULLDOWN | INPUT_EN | MUX_MODE5) >; };	/* Mode 5, Pull-Down, RxActive */
P9_30_pruin_pin: pinmux_P9_30_pruin_pin { pinctrl-single,pins = <
	AM33XX_IOPAD(0x0998, PIN_OUTPUT_PULLDOWN | INPUT_EN | MUX_MODE6) >; };	/* Mode 6, Pull-Down, RxActive */
P9_30_pwm_pin: pinmux_P9_30_pwm_pin { pinctrl-single,pins = <
	AM33XX_IOPAD(0x0998, PIN_OUTPUT_PULLDOWN | INPUT_EN | MUX_MODE1) >; };	/* Mode 1, Pull-Down, RxActive */

/* P9_31 (ZCZ ball A13) mcasp0_aclkx */
P9_31_default_pin: pinmux_P9_31_default_pin { pinctrl-single,pins = <
	AM33XX_IOPAD(0x0990, PIN_OUTPUT_PULLDOWN | INPUT_EN | MUX_MODE7) >; };	/* Mode 7, Pull-Down, RxActive */
P9_31_gpio_pin: pinmux_P9_31_gpio_pin { pinctrl-single,pins = <
	AM33XX_IOPAD(0x0990, PIN_OUTPUT | INPUT_EN | MUX_MODE7) >; };	/* Mode 7, RxActive */
P9_31_gpio_pu_pin: pinmux_P9_31_gpio_pu_pin { pinctrl-single,pins = <
	AM33XX_IOPAD(0x0990, PIN_OUTPUT_PULLUP | INPUT_EN | MUX_MODE7) >; };	/* Mode 7, Pull-Up, RxActive */
P9_31_gpio_pd_pin: pinmux_P9_31_gpio_pd_pin { pinctrl-single,pins = <
	AM33XX_IOPAD(0x0990, PIN_OUTPUT_PULLDOWN | INPUT_EN | MUX_MODE7) >; };	/* Mode 7, Pull-Down, RxActive */
P9_31_spi_pin: pinmux_P9_31_spi_pin { pinctrl-single,pins = <
	AM33XX_IOPAD(0x0990, PIN_OUTPUT_PULLUP | INPUT_EN | MUX_MODE3) >; };	/* Mode 3, Pull-Up, RxActive */
P9_31_pruout_pin: pinmux_P9_31_pruout_pin { pinctrl-single,pins = <
	AM33XX_IOPAD(0x0990, PIN_OUTPUT_PULLDOWN | INPUT_EN | MUX_MODE5) >; };	/* Mode 5, Pull-Down, RxActive */
P9_31_pruin_pin: pinmux_P9_31_pruin_pin { pinctrl-single,pins = <
	AM33XX_IOPAD(0x0990, PIN_OUTPUT_PULLDOWN | INPUT_EN | MUX_MODE6) >; };	/* Mode 6, Pull-Down, RxActive */
P9_31_pwm_pin: pinmux_P9_31_pwm_pin { pinctrl-single,pins = <
	AM33XX_IOPAD(0x0990, PIN_OUTPUT_PULLDOWN | INPUT_EN | MUX_MODE1) >; };	/* Mode 1, Pull-Down, RxActive */

/* P9_41 (ZCZ ball D14) xdma_event_intr1 */
P9_41_default_pin: pinmux_P9_41_default_pin { pinctrl-single,pins = <
	AM33XX_IOPAD(0x09b4, PIN_OUTPUT_PULLDOWN | INPUT_EN | MUX_MODE7) >; };	/* Mode 7, Pull-Down, RxActive */
P9_41_gpio_pin: pinmux_P9_41_gpio_pin { pinctrl-single,pins = <
	AM33XX_IOPAD(0x09b4, PIN_OUTPUT | INPUT_EN | MUX_MODE7) >; };	/* Mode 7, RxActive */
P9_41_gpio_pu_pin: pinmux_P9_41_gpio_pu_pin { pinctrl-single,pins = <
	AM33XX_IOPAD(0x09b4, PIN_OUTPUT_PULLUP | INPUT_EN | MUX_MODE7) >; };	/* Mode 7, Pull-Up, RxActive */
P9_41_gpio_pd_pin: pinmux_P9_41_gpio_pd_pin { pinctrl-single,pins = <
	AM33XX_IOPAD(0x09b4, PIN_OUTPUT_PULLDOWN | INPUT_EN | MUX_MODE7) >; };	/* Mode 7, Pull-Down, RxActive */
P9_41_timer_pin: pinmux_P9_41_timer_pin { pinctrl-single,pins = <
	AM33XX_IOPAD(0x09b4, PIN_OUTPUT_PULLUP | INPUT_EN | MUX_MODE4) >; };	/* Mode 4, Pull-Up, RxActive */
P9_41_pruin_pin: pinmux_P9_41_pruin_pin { pinctrl-single,pins = <
	AM33XX_IOPAD(0x09b4, PIN_OUTPUT_PULLDOWN | INPUT_EN | MUX_MODE5) >; };	/* Mode 5, Pull-Down, RxActive */

/* P9_91 (ZCZ ball D13) mcasp0_axr1 */
P9_91_default_pin: pinmux_P9_91_default_pin { pinctrl-single,pins = <
	AM33XX_IOPAD(0x09a8, PIN_OUTPUT_PULLDOWN | INPUT_EN | MUX_MODE7) >; };	/* Mode 7, Pull-Down, RxActive */
P9_91_gpio_pin: pinmux_P9_91_gpio_pin { pinctrl-single,pins = <
	AM33XX_IOPAD(0x09a8, PIN_OUTPUT | INPUT_EN | MUX_MODE7) >; };	/* Mode 7, RxActive */
P9_91_gpio_pu_pin: pinmux_P9_91_gpio_pu_pin { pinctrl-single,pins = <
	AM33XX_IOPAD(0x09a8, PIN_OUTPUT_PULLUP | INPUT_EN | MUX_MODE7) >; };	/* Mode 7, Pull-Up, RxActive */
P9_91_gpio_pd_pin: pinmux_P9_91_gpio_pd_pin { pinctrl-single,pins = <
	AM33XX_IOPAD(0x09a8, PIN_OUTPUT_PULLDOWN | INPUT_EN | MUX_MODE7) >; };	/* Mode 7, Pull-Down, RxActive */
P9_91_pruout_pin: pinmux_P9_91_pruout_pin { pinctrl-single,pins = <
	AM33XX_IOPAD(0x09a8, PIN_OUTPUT_PULLDOWN | INPUT_EN | MUX_MODE5) >; };	/* Mode 5, Pull-Down, RxActive */
P9_91_pruin_pin: pinmux_P9_91_pruin_pin { pinctrl-single,pins = <
	AM33XX_IOPAD(0x09a8, PIN_OUTPUT_PULLDOWN | INPUT_EN | MUX_MODE6) >; };	/* Mode 6, Pull-Down, RxActive */
P9_91_qep_pin: pinmux_P9_91_qep_pin { pinctrl-single,pins = <
	AM33XX_IOPAD(0x09a8, PIN_OUTPUT_PULLDOWN | INPUT_EN | MUX_MODE1) >; };	/* Mode 1, Pull-Down, RxActive */

/* P9_42 (ZCZ ball C18) eCAP0_in_PWM0_out */
P9_42_default_pin: pinmux_P9_42_default_pin { pinctrl-single,pins = <
	AM33XX_IOPAD(0x0964, PIN_OUTPUT_PULLDOWN | INPUT_EN | MUX_MODE7) >; };	/* Mode 7, Pull-Down, RxActive */
P9_42_gpio_pin: pinmux_P9_42_gpio_pin { pinctrl-single,pins = <
	AM33XX_IOPAD(0x0964, PIN_OUTPUT | INPUT_EN | MUX_MODE7) >; };	/* Mode 7, RxActive */
P9_42_gpio_pu_pin: pinmux_P9_42_gpio_pu_pin { pinctrl-single,pins = <
	AM33XX_IOPAD(0x0964, PIN_OUTPUT_PULLUP | INPUT_EN | MUX_MODE7) >; };	/* Mode 7, Pull-Up, RxActive */
P9_42_gpio_pd_pin: pinmux_P9_42_gpio_pd_pin { pinctrl-single,pins = <
	AM33XX_IOPAD(0x0964, PIN_OUTPUT_PULLDOWN | INPUT_EN | MUX_MODE7) >; };	/* Mode 7, Pull-Down, RxActive */
P9_42_spi_pin: pinmux_P9_42_spi_pin { pinctrl-single,pins = <
	AM33XX_IOPAD(0x0964, PIN_OUTPUT_PULLUP | INPUT_EN | MUX_MODE4) >; };	/* Mode 4, Pull-Up, RxActive */
P9_42_uart_pin: pinmux_P9_42_uart_pin { pinctrl-single,pins = <
	AM33XX_IOPAD(0x0964, PIN_OUTPUT_PULLDOWN | INPUT_EN | MUX_MODE1) >; };	/* Mode 1, Pull-Down, RxActive */
P9_42_pwm_pin: pinmux_P9_42_pwm_pin { pinctrl-single,pins = <
	AM33XX_IOPAD(0x0964, PIN_OUTPUT_PULLDOWN | INPUT_EN | MUX_MODE0) >; };	/* Mode 0, Pull-Down, RxActive */
P9_42_pru_ecap_pin: pinmux_P9_42_pru_ecap_pin { pinctrl-single,pins = <
	AM33XX_IOPAD(0x0964, PIN_OUTPUT_PULLDOWN | INPUT_EN | MUX_MODE3) >; };	/* Mode 3, Pull-Down, RxActive */

/* P9_92 (ZCZ ball B12) mcasp0_aclkr */
P9_92_default_pin: pinmux_P9_92_default_pin { pinctrl-single,pins = <
	AM33XX_IOPAD(0x09a0, PIN_OUTPUT_PULLDOWN | INPUT_EN | MUX_MODE7) >; };	/* Mode 7, Pull-Down, RxActive */
P9_92_gpio_pin: pinmux_P9_92_gpio_pin { pinctrl-single,pins = <
	AM33XX_IOPAD(0x09a0, PIN_OUTPUT | INPUT_EN | MUX_MODE7) >; };	/* Mode 7, RxActive */
P9_92_gpio_pu_pin: pinmux_P9_92_gpio_pu_pin { pinctrl-single,pins = <
	AM33XX_IOPAD(0x09a0, PIN_OUTPUT_PULLUP | INPUT_EN | MUX_MODE7) >; };	/* Mode 7, Pull-Up, RxActive */
P9_92_gpio_pd_pin: pinmux_P9_92_gpio_pd_pin { pinctrl-single,pins = <
	AM33XX_IOPAD(0x09a0, PIN_OUTPUT_PULLDOWN | INPUT_EN | MUX_MODE7) >; };	/* Mode 7, Pull-Down, RxActive */
P9_92_pruout_pin: pinmux_P9_92_pruout_pin { pinctrl-single,pins = <
	AM33XX_IOPAD(0x09a0, PIN_OUTPUT_PULLDOWN | INPUT_EN | MUX_MODE5) >; };	/* Mode 5, Pull-Down, RxActive */
P9_92_pruin_pin: pinmux_P9_92_pruin_pin { pinctrl-single,pins = <
	AM33XX_IOPAD(0x09a0, PIN_OUTPUT_PULLDOWN | INPUT_EN | MUX_MODE6) >; };	/* Mode 6, Pull-Down, RxActive */
P9_92_qep_pin: pinmux_P9_92_qep_pin { pinctrl-single,pins = <
	AM33XX_IOPAD(0x09a0, PIN_OUTPUT_PULLDOWN | INPUT_EN | MUX_MODE1) >; };	/* Mode 1, Pull-Down, RxActive */


P8_03_pinmux {
	compatible = "bone-pinmux-helper";
	status = "okay";
	pinctrl-names = "default", "gpio", "gpio_pu", "gpio_pd";
	pinctrl-0 = <&P8_03_default_pin>;
	pinctrl-1 = <&P8_03_gpio_pin>;
	pinctrl-2 = <&P8_03_gpio_pu_pin>;
	pinctrl-3 = <&P8_03_gpio_pd_pin>;
};

P8_04_pinmux {
	compatible = "bone-pinmux-helper";
	status = "okay";
	pinctrl-names = "default", "gpio", "gpio_pu", "gpio_pd";
	pinctrl-0 = <&P8_04_default_pin>;
	pinctrl-1 = <&P8_04_gpio_pin>;
	pinctrl-2 = <&P8_04_gpio_pu_pin>;
	pinctrl-3 = <&P8_04_gpio_pd_pin>;
};

P8_05_pinmux {
	compatible = "bone-pinmux-helper";
	status = "okay";
	pinctrl-names = "default", "gpio", "gpio_pu", "gpio_pd";
	pinctrl-0 = <&P8_05_default_pin>;
	pinctrl-1 = <&P8_05_gpio_pin>;
	pinctrl-2 = <&P8_05_gpio_pu_pin>;
	pinctrl-3 = <&P8_05_gpio_pd_pin>;
};

P8_06_pinmux {
	compatible = "bone-pinmux-helper";
	status = "okay";
	pinctrl-names = "default", "gpio", "gpio_pu", "gpio_pd";
	pinctrl-0 = <&P8_06_default_pin>;
	pinctrl-1 = <&P8_06_gpio_pin>;
	pinctrl-2 = <&P8_06_gpio_pu_pin>;
	pinctrl-3 = <&P8_06_gpio_pd_pin>;
};

P8_07_pinmux {
	compatible = "bone-pinmux-helper";
	status = "okay";
	pinctrl-names = "default", "gpio", "gpio_pu", "gpio_pd", "timer";
	pinctrl-0 = <&P8_07_default_pin>;
	pinctrl-1 = <&P8_07_gpio_pin>;
	pinctrl-2 = <&P8_07_gpio_pu_pin>;
	pinctrl-3 = <&P8_07_gpio_pd_pin>;
	pinctrl-4 = <&P8_07_timer_pin>;
};

P8_08_pinmux {
	compatible = "bone-pinmux-helper";
	status = "okay";
	pinctrl-names = "default", "gpio", "gpio_pu", "gpio_pd", "timer";
	pinctrl-0 = <&P8_08_default_pin>;
	pinctrl-1 = <&P8_08_gpio_pin>;
	pinctrl-2 = <&P8_08_gpio_pu_pin>;
	pinctrl-3 = <&P8_08_gpio_pd_pin>;
	pinctrl-4 = <&P8_08_timer_pin>;
};

P8_09_pinmux {
	compatible = "bone-pinmux-helper";
	status = "okay";
	pinctrl-names = "default", "gpio", "gpio_pu", "gpio_pd", "timer";
	pinctrl-0 = <&P8_09_default_pin>;
	pinctrl-1 = <&P8_09_gpio_pin>;
	pinctrl-2 = <&P8_09_gpio_pu_pin>;
	pinctrl-3 = <&P8_09_gpio_pd_pin>;
	pinctrl-4 = <&P8_09_timer_pin>;
};

P8_10_pinmux {
	compatible = "bone-pinmux-helper";
	status = "okay";
	pinctrl-names = "default", "gpio", "gpio_pu", "gpio_pd", "timer";
	pinctrl-0 = <&P8_10_default_pin>;
	pinctrl-1 = <&P8_10_gpio_pin>;
	pinctrl-2 = <&P8_10_gpio_pu_pin>;
	pinctrl-3 = <&P8_10_gpio_pd_pin>;
	pinctrl-4 = <&P8_10_timer_pin>;
};

P8_11_pinmux {
	compatible = "bone-pinmux-helper";
	status = "okay";
	pinctrl-names = "default", "gpio", "gpio_pu", "gpio_pd", "qep", "pruout";
	pinctrl-0 = <&P8_11_default_pin>;
	pinctrl-1 = <&P8_11_gpio_pin>;
	pinctrl-2 = <&P8_11_gpio_pu_pin>;
	pinctrl-3 = <&P8_11_gpio_pd_pin>;
	pinctrl-4 = <&P8_11_qep_pin>;
	pinctrl-5 = <&P8_11_pruout_pin>;
};

P8_12_pinmux {
	compatible = "bone-pinmux-helper";
	status = "okay";
	pinctrl-names = "default", "gpio", "gpio_pu", "gpio_pd", "qep", "pruout";
	pinctrl-0 = <&P8_12_default_pin>;
	pinctrl-1 = <&P8_12_gpio_pin>;
	pinctrl-2 = <&P8_12_gpio_pu_pin>;
	pinctrl-3 = <&P8_12_gpio_pd_pin>;
	pinctrl-4 = <&P8_12_qep_pin>;
	pinctrl-5 = <&P8_12_pruout_pin>;
};

P8_13_pinmux {
	compatible = "bone-pinmux-helper";
	status = "okay";
	pinctrl-names = "default", "gpio", "gpio_pu", "gpio_pd", "pwm";
	pinctrl-0 = <&P8_13_default_pin>;
	pinctrl-1 = <&P8_13_gpio_pin>;
	pinctrl-2 = <&P8_13_gpio_pu_pin>;
	pinctrl-3 = <&P8_13_gpio_pd_pin>;
	pinctrl-4 = <&P8_13_pwm_pin>;
};

P8_14_pinmux {
	compatible = "bone-pinmux-helper";
	status = "okay";
	pinctrl-names = "default", "gpio", "gpio_pu", "gpio_pd", "pwm";
	pinctrl-0 = <&P8_14_default_pin>;
	pinctrl-1 = <&P8_14_gpio_pin>;
	pinctrl-2 = <&P8_14_gpio_pu_pin>;
	pinctrl-3 = <&P8_14_gpio_pd_pin>;
	pinctrl-4 = <&P8_14_pwm_pin>;
};

P8_15_pinmux {
	compatible = "bone-pinmux-helper";
	status = "okay";
	pinctrl-names = "default", "gpio", "gpio_pu", "gpio_pd", "qep", "pruin";
	pinctrl-0 = <&P8_15_default_pin>;
	pinctrl-1 = <&P8_15_gpio_pin>;
	pinctrl-2 = <&P8_15_gpio_pu_pin>;
	pinctrl-3 = <&P8_15_gpio_pd_pin>;
	pinctrl-4 = <&P8_15_qep_pin>;
	pinctrl-5 = <&P8_15_pruin_pin>;
};

P8_16_pinmux {
	compatible = "bone-pinmux-helper";
	status = "okay";
	pinctrl-names = "default", "gpio", "gpio_pu", "gpio_pd", "qep", "pruin";
	pinctrl-0 = <&P8_16_default_pin>;
	pinctrl-1 = <&P8_16_gpio_pin>;
	pinctrl-2 = <&P8_16_gpio_pu_pin>;
	pinctrl-3 = <&P8_16_gpio_pd_pin>;
	pinctrl-4 = <&P8_16_qep_pin>;
	pinctrl-5 = <&P8_16_pruin_pin>;
};

P8_17_pinmux {
	compatible = "bone-pinmux-helper";
	status = "okay";
	pinctrl-names = "default", "gpio", "gpio_pu", "gpio_pd", "pwm";
	pinctrl-0 = <&P8_17_default_pin>;
	pinctrl-1 = <&P8_17_gpio_pin>;
	pinctrl-2 = <&P8_17_gpio_pu_pin>;
	pinctrl-3 = <&P8_17_gpio_pd_pin>;
	pinctrl-4 = <&P8_17_pwm_pin>;
};

P8_18_pinmux {
	compatible = "bone-pinmux-helper";
	status = "okay";
	pinctrl-names = "default", "gpio", "gpio_pu", "gpio_pd";
	pinctrl-0 = <&P8_18_default_pin>;
	pinctrl-1 = <&P8_18_gpio_pin>;
	pinctrl-2 = <&P8_18_gpio_pu_pin>;
	pinctrl-3 = <&P8_18_gpio_pd_pin>;
};

P8_19_pinmux {
	compatible = "bone-pinmux-helper";
	status = "okay";
	pinctrl-names = "default", "gpio", "gpio_pu", "gpio_pd", "pwm";
	pinctrl-0 = <&P8_19_default_pin>;
	pinctrl-1 = <&P8_19_gpio_pin>;
	pinctrl-2 = <&P8_19_gpio_pu_pin>;
	pinctrl-3 = <&P8_19_gpio_pd_pin>;
	pinctrl-4 = <&P8_19_pwm_pin>;
};

P8_20_pinmux {
	compatible = "bone-pinmux-helper";
	status = "okay";
	pinctrl-names = "default", "gpio", "gpio_pu", "gpio_pd", "pruout", "pruin";
	pinctrl-0 = <&P8_20_default_pin>;
	pinctrl-1 = <&P8_20_gpio_pin>;
	pinctrl-2 = <&P8_20_gpio_pu_pin>;
	pinctrl-3 = <&P8_20_gpio_pd_pin>;
	pinctrl-4 = <&P8_20_pruout_pin>;
	pinctrl-5 = <&P8_20_pruin_pin>;
};

P8_21_pinmux {
	compatible = "bone-pinmux-helper";
	status = "okay";
	pinctrl-names = "default", "gpio", "gpio_pu", "gpio_pd", "pruout", "pruin";
	pinctrl-0 = <&P8_21_default_pin>;
	pinctrl-1 = <&P8_21_gpio_pin>;
	pinctrl-2 = <&P8_21_gpio_pu_pin>;
	pinctrl-3 = <&P8_21_gpio_pd_pin>;
	pinctrl-4 = <&P8_21_pruout_pin>;
	pinctrl-5 = <&P8_21_pruin_pin>;
};

P8_22_pinmux {
	compatible = "bone-pinmux-helper";
	status = "okay";
	pinctrl-names = "default", "gpio", "gpio_pu", "gpio_pd";
	pinctrl-0 = <&P8_22_default_pin>;
	pinctrl-1 = <&P8_22_gpio_pin>;
	pinctrl-2 = <&P8_22_gpio_pu_pin>;
	pinctrl-3 = <&P8_22_gpio_pd_pin>;
};

P8_23_pinmux {
	compatible = "bone-pinmux-helper";
	status = "okay";
	pinctrl-names = "default", "gpio", "gpio_pu", "gpio_pd";
	pinctrl-0 = <&P8_23_default_pin>;
	pinctrl-1 = <&P8_23_gpio_pin>;
	pinctrl-2 = <&P8_23_gpio_pu_pin>;
	pinctrl-3 = <&P8_23_gpio_pd_pin>;
};

P8_24_pinmux {
	compatible = "bone-pinmux-helper";
	status = "okay";
	pinctrl-names = "default", "gpio", "gpio_pu", "gpio_pd";
	pinctrl-0 = <&P8_24_default_pin>;
	pinctrl-1 = <&P8_24_gpio_pin>;
	pinctrl-2 = <&P8_24_gpio_pu_pin>;
	pinctrl-3 = <&P8_24_gpio_pd_pin>;
};

P8_25_pinmux {
	compatible = "bone-pinmux-helper";
	status = "okay";
	pinctrl-names = "default", "gpio", "gpio_pu", "gpio_pd";
	pinctrl-0 = <&P8_25_default_pin>;
	pinctrl-1 = <&P8_25_gpio_pin>;
	pinctrl-2 = <&P8_25_gpio_pu_pin>;
	pinctrl-3 = <&P8_25_gpio_pd_pin>;
};

P8_26_pinmux {
	compatible = "bone-pinmux-helper";
	status = "okay";
	pinctrl-names = "default", "gpio", "gpio_pu", "gpio_pd";
	pinctrl-0 = <&P8_26_default_pin>;
	pinctrl-1 = <&P8_26_gpio_pin>;
	pinctrl-2 = <&P8_26_gpio_pu_pin>;
	pinctrl-3 = <&P8_26_gpio_pd_pin>;
};

P8_27_pinmux {
	compatible = "bone-pinmux-helper";
	status = "okay";
	pinctrl-names = "default", "gpio", "gpio_pu", "gpio_pd", "pruout", "pruin";
	pinctrl-0 = <&P8_27_default_pin>;
	pinctrl-1 = <&P8_27_gpio_pin>;
	pinctrl-2 = <&P8_27_gpio_pu_pin>;
	pinctrl-3 = <&P8_27_gpio_pd_pin>;
	pinctrl-4 = <&P8_27_pruout_pin>;
	pinctrl-5 = <&P8_27_pruin_pin>;
};

P8_28_pinmux {
	compatible = "bone-pinmux-helper";
	status = "okay";
	pinctrl-names = "default", "gpio", "gpio_pu", "gpio_pd", "pruout", "pruin";
	pinctrl-0 = <&P8_28_default_pin>;
	pinctrl-1 = <&P8_28_gpio_pin>;
	pinctrl-2 = <&P8_28_gpio_pu_pin>;
	pinctrl-3 = <&P8_28_gpio_pd_pin>;
	pinctrl-4 = <&P8_28_pruout_pin>;
	pinctrl-5 = <&P8_28_pruin_pin>;
};

P8_29_pinmux {
	compatible = "bone-pinmux-helper";
	status = "okay";
	pinctrl-names = "default", "gpio", "gpio_pu", "gpio_pd", "pruout", "pruin";
	pinctrl-0 = <&P8_29_default_pin>;
	pinctrl-1 = <&P8_29_gpio_pin>;
	pinctrl-2 = <&P8_29_gpio_pu_pin>;
	pinctrl-3 = <&P8_29_gpio_pd_pin>;
	pinctrl-4 = <&P8_29_pruout_pin>;
	pinctrl-5 = <&P8_29_pruin_pin>;
};

P8_30_pinmux {
	compatible = "bone-pinmux-helper";
	status = "okay";
	pinctrl-names = "default", "gpio", "gpio_pu", "gpio_pd", "pruout", "pruin";
	pinctrl-0 = <&P8_30_default_pin>;
	pinctrl-1 = <&P8_30_gpio_pin>;
	pinctrl-2 = <&P8_30_gpio_pu_pin>;
	pinctrl-3 = <&P8_30_gpio_pd_pin>;
	pinctrl-4 = <&P8_30_pruout_pin>;
	pinctrl-5 = <&P8_30_pruin_pin>;
};

P8_31_pinmux {
	compatible = "bone-pinmux-helper";
	status = "okay";
	pinctrl-names = "default", "gpio", "gpio_pu", "gpio_pd", "uart", "qep";
	pinctrl-0 = <&P8_31_default_pin>;
	pinctrl-1 = <&P8_31_gpio_pin>;
	pinctrl-2 = <&P8_31_gpio_pu_pin>;
	pinctrl-3 = <&P8_31_gpio_pd_pin>;
	pinctrl-4 = <&P8_31_uart_pin>;
	pinctrl-5 = <&P8_31_qep_pin>;
};

P8_32_pinmux {
	compatible = "bone-pinmux-helper";
	status = "okay";
	pinctrl-names = "default", "gpio", "gpio_pu", "gpio_pd", "qep";
	pinctrl-0 = <&P8_32_default_pin>;
	pinctrl-1 = <&P8_32_gpio_pin>;
	pinctrl-2 = <&P8_32_gpio_pu_pin>;
	pinctrl-3 = <&P8_32_gpio_pd_pin>;
	pinctrl-4 = <&P8_32_qep_pin>;
};

P8_33_pinmux {
	compatible = "bone-pinmux-helper";
	status = "okay";
	pinctrl-names = "default", "gpio", "gpio_pu", "gpio_pd", "qep";
	pinctrl-0 = <&P8_33_default_pin>;
	pinctrl-1 = <&P8_33_gpio_pin>;
	pinctrl-2 = <&P8_33_gpio_pu_pin>;
	pinctrl-3 = <&P8_33_gpio_pd_pin>;
	pinctrl-4 = <&P8_33_qep_pin>;
};

P8_34_pinmux {
	compatible = "bone-pinmux-helper";
	status = "okay";
	pinctrl-names = "default", "gpio", "gpio_pu", "gpio_pd", "pwm";
	pinctrl-0 = <&P8_34_default_pin>;
	pinctrl-1 = <&P8_34_gpio_pin>;
	pinctrl-2 = <&P8_34_gpio_pu_pin>;
	pinctrl-3 = <&P8_34_gpio_pd_pin>;
	pinctrl-4 = <&P8_34_pwm_pin>;
};

P8_35_pinmux {
	compatible = "bone-pinmux-helper";
	status = "okay";
	pinctrl-names = "default", "gpio", "gpio_pu", "gpio_pd", "qep";
	pinctrl-0 = <&P8_35_default_pin>;
	pinctrl-1 = <&P8_35_gpio_pin>;
	pinctrl-2 = <&P8_35_gpio_pu_pin>;
	pinctrl-3 = <&P8_35_gpio_pd_pin>;
	pinctrl-4 = <&P8_35_qep_pin>;
};

P8_36_pinmux {
	compatible = "bone-pinmux-helper";
	status = "okay";
	pinctrl-names = "default", "gpio", "gpio_pu", "gpio_pd", "pwm";
	pinctrl-0 = <&P8_36_default_pin>;
	pinctrl-1 = <&P8_36_gpio_pin>;
	pinctrl-2 = <&P8_36_gpio_pu_pin>;
	pinctrl-3 = <&P8_36_gpio_pd_pin>;
	pinctrl-4 = <&P8_36_pwm_pin>;
};

P8_37_pinmux {
	compatible = "bone-pinmux-helper";
	status = "okay";
	pinctrl-names = "default", "gpio", "gpio_pu", "gpio_pd", "uart", "pwm";
	pinctrl-0 = <&P8_37_default_pin>;
	pinctrl-1 = <&P8_37_gpio_pin>;
	pinctrl-2 = <&P8_37_gpio_pu_pin>;
	pinctrl-3 = <&P8_37_gpio_pd_pin>;
	pinctrl-4 = <&P8_37_uart_pin>;
	pinctrl-5 = <&P8_37_pwm_pin>;
};

P8_38_pinmux {
	compatible = "bone-pinmux-helper";
	status = "okay";
	pinctrl-names = "default", "gpio", "gpio_pu", "gpio_pd", "uart", "pwm";
	pinctrl-0 = <&P8_38_default_pin>;
	pinctrl-1 = <&P8_38_gpio_pin>;
	pinctrl-2 = <&P8_38_gpio_pu_pin>;
	pinctrl-3 = <&P8_38_gpio_pd_pin>;
	pinctrl-4 = <&P8_38_uart_pin>;
	pinctrl-5 = <&P8_38_pwm_pin>;
};

P8_39_pinmux {
	compatible = "bone-pinmux-helper";
	status = "okay";
	pinctrl-names = "default", "gpio", "gpio_pu", "gpio_pd", "qep", "pruout", "pruin";
	pinctrl-0 = <&P8_39_default_pin>;
	pinctrl-1 = <&P8_39_gpio_pin>;
	pinctrl-2 = <&P8_39_gpio_pu_pin>;
	pinctrl-3 = <&P8_39_gpio_pd_pin>;
	pinctrl-4 = <&P8_39_qep_pin>;
	pinctrl-5 = <&P8_39_pruout_pin>;
	pinctrl-6 = <&P8_39_pruin_pin>;
};

P8_40_pinmux {
	compatible = "bone-pinmux-helper";
	status = "okay";
	pinctrl-names = "default", "gpio", "gpio_pu", "gpio_pd", "qep", "pruout", "pruin";
	pinctrl-0 = <&P8_40_default_pin>;
	pinctrl-1 = <&P8_40_gpio_pin>;
	pinctrl-2 = <&P8_40_gpio_pu_pin>;
	pinctrl-3 = <&P8_40_gpio_pd_pin>;
	pinctrl-4 = <&P8_40_qep_pin>;
	pinctrl-5 = <&P8_40_pruout_pin>;
	pinctrl-6 = <&P8_40_pruin_pin>;
};

P8_41_pinmux {
	compatible = "bone-pinmux-helper";
	status = "okay";
	pinctrl-names = "default", "gpio", "gpio_pu", "gpio_pd", "qep", "pruout", "pruin";
	pinctrl-0 = <&P8_41_default_pin>;
	pinctrl-1 = <&P8_41_gpio_pin>;
	pinctrl-2 = <&P8_41_gpio_pu_pin>;
	pinctrl-3 = <&P8_41_gpio_pd_pin>;
	pinctrl-4 = <&P8_41_qep_pin>;
	pinctrl-5 = <&P8_41_pruout_pin>;
	pinctrl-6 = <&P8_41_pruin_pin>;
};

P8_42_pinmux {
	compatible = "bone-pinmux-helper";
	status = "okay";
	pinctrl-names = "default", "gpio", "gpio_pu", "gpio_pd", "qep", "pruout", "pruin";
	pinctrl-0 = <&P8_42_default_pin>;
	pinctrl-1 = <&P8_42_gpio_pin>;
	pinctrl-2 = <&P8_42_gpio_pu_pin>;
	pinctrl-3 = <&P8_42_gpio_pd_pin>;
	pinctrl-4 = <&P8_42_qep_pin>;
	pinctrl-5 = <&P8_42_pruout_pin>;
	pinctrl-6 = <&P8_42_pruin_pin>;
};

P8_43_pinmux {
	compatible = "bone-pinmux-helper";
	status = "okay";
	pinctrl-names = "default", "gpio", "gpio_pu", "gpio_pd", "pwm", "pruout", "pruin";
	pinctrl-0 = <&P8_43_default_pin>;
	pinctrl-1 = <&P8_43_gpio_pin>;
	pinctrl-2 = <&P8_43_gpio_pu_pin>;
	pinctrl-3 = <&P8_43_gpio_pd_pin>;
	pinctrl-4 = <&P8_43_pwm_pin>;
	pinctrl-5 = <&P8_43_pruout_pin>;
	pinctrl-6 = <&P8_43_pruin_pin>;
};

P8_44_pinmux {
	compatible = "bone-pinmux-helper";
	status = "okay";
	pinctrl-names = "default", "gpio", "gpio_pu", "gpio_pd", "pwm", "pruout", "pruin";
	pinctrl-0 = <&P8_44_default_pin>;
	pinctrl-1 = <&P8_44_gpio_pin>;
	pinctrl-2 = <&P8_44_gpio_pu_pin>;
	pinctrl-3 = <&P8_44_gpio_pd_pin>;
	pinctrl-4 = <&P8_44_pwm_pin>;
	pinctrl-5 = <&P8_44_pruout_pin>;
	pinctrl-6 = <&P8_44_pruin_pin>;
};

P8_45_pinmux {
	compatible = "bone-pinmux-helper";
	status = "okay";
	pinctrl-names = "default", "gpio", "gpio_pu", "gpio_pd", "pwm", "pruout", "pruin";
	pinctrl-0 = <&P8_45_default_pin>;
	pinctrl-1 = <&P8_45_gpio_pin>;
	pinctrl-2 = <&P8_45_gpio_pu_pin>;
	pinctrl-3 = <&P8_45_gpio_pd_pin>;
	pinctrl-4 = <&P8_45_pwm_pin>;
	pinctrl-5 = <&P8_45_pruout_pin>;
	pinctrl-6 = <&P8_45_pruin_pin>;
};

P8_46_pinmux {
	compatible = "bone-pinmux-helper";
	status = "okay";
	pinctrl-names = "default", "gpio", "gpio_pu", "gpio_pd", "pwm", "pruout", "pruin";
	pinctrl-0 = <&P8_46_default_pin>;
	pinctrl-1 = <&P8_46_gpio_pin>;
	pinctrl-2 = <&P8_46_gpio_pu_pin>;
	pinctrl-3 = <&P8_46_gpio_pd_pin>;
	pinctrl-4 = <&P8_46_pwm_pin>;
	pinctrl-5 = <&P8_46_pruout_pin>;
	pinctrl-6 = <&P8_46_pruin_pin>;
};

P9_11_pinmux {
	compatible = "bone-pinmux-helper";
	status = "okay";
	pinctrl-names = "default", "gpio", "gpio_pu", "gpio_pd", "uart";
	pinctrl-0 = <&P9_11_default_pin>;
	pinctrl-1 = <&P9_11_gpio_pin>;
	pinctrl-2 = <&P9_11_gpio_pu_pin>;
	pinctrl-3 = <&P9_11_gpio_pd_pin>;
	pinctrl-4 = <&P9_11_uart_pin>;
};

P9_12_pinmux {
	compatible = "bone-pinmux-helper";
	status = "okay";
	pinctrl-names = "default", "gpio", "gpio_pu", "gpio_pd";
	pinctrl-0 = <&P9_12_default_pin>;
	pinctrl-1 = <&P9_12_gpio_pin>;
	pinctrl-2 = <&P9_12_gpio_pu_pin>;
	pinctrl-3 = <&P9_12_gpio_pd_pin>;
};

P9_13_pinmux {
	compatible = "bone-pinmux-helper";
	status = "okay";
	pinctrl-names = "default", "gpio", "gpio_pu", "gpio_pd", "uart";
	pinctrl-0 = <&P9_13_default_pin>;
	pinctrl-1 = <&P9_13_gpio_pin>;
	pinctrl-2 = <&P9_13_gpio_pu_pin>;
	pinctrl-3 = <&P9_13_gpio_pd_pin>;
	pinctrl-4 = <&P9_13_uart_pin>;
};

P9_14_pinmux {
	compatible = "bone-pinmux-helper";
	status = "okay";
	pinctrl-names = "default", "gpio", "gpio_pu", "gpio_pd", "pwm";
	pinctrl-0 = <&P9_14_default_pin>;
	pinctrl-1 = <&P9_14_gpio_pin>;
	pinctrl-2 = <&P9_14_gpio_pu_pin>;
	pinctrl-3 = <&P9_14_gpio_pd_pin>;
	pinctrl-4 = <&P9_14_pwm_pin>;
};

P9_15_pinmux {
	compatible = "bone-pinmux-helper";
	status = "okay";
	pinctrl-names = "default", "gpio", "gpio_pu", "gpio_pd", "pwm";
	pinctrl-0 = <&P9_15_default_pin>;
	pinctrl-1 = <&P9_15_gpio_pin>;
	pinctrl-2 = <&P9_15_gpio_pu_pin>;
	pinctrl-3 = <&P9_15_gpio_pd_pin>;
	pinctrl-4 = <&P9_15_pwm_pin>;
};

P9_16_pinmux {
	compatible = "bone-pinmux-helper";
	status = "okay";
	pinctrl-names = "default", "gpio", "gpio_pu", "gpio_pd", "pwm";
	pinctrl-0 = <&P9_16_default_pin>;
	pinctrl-1 = <&P9_16_gpio_pin>;
	pinctrl-2 = <&P9_16_gpio_pu_pin>;
	pinctrl-3 = <&P9_16_gpio_pd_pin>;
	pinctrl-4 = <&P9_16_pwm_pin>;
};

P9_17_pinmux {
	compatible = "bone-pinmux-helper";
	status = "okay";
	pinctrl-names = "default", "gpio", "gpio_pu", "gpio_pd", "spi", "i2c", "pwm", "pru_uart";
	pinctrl-0 = <&P9_17_default_pin>;
	pinctrl-1 = <&P9_17_gpio_pin>;
	pinctrl-2 = <&P9_17_gpio_pu_pin>;
	pinctrl-3 = <&P9_17_gpio_pd_pin>;
	pinctrl-4 = <&P9_17_spi_pin>;
	pinctrl-5 = <&P9_17_i2c_pin>;
	pinctrl-6 = <&P9_17_pwm_pin>;
	pinctrl-7 = <&P9_17_pru_uart_pin>;
};

P9_18_pinmux {
	compatible = "bone-pinmux-helper";
	status = "okay";
	pinctrl-names = "default", "gpio", "gpio_pu", "gpio_pd", "spi", "i2c", "pwm", "pru_uart";
	pinctrl-0 = <&P9_18_default_pin>;
	pinctrl-1 = <&P9_18_gpio_pin>;
	pinctrl-2 = <&P9_18_gpio_pu_pin>;
	pinctrl-3 = <&P9_18_gpio_pd_pin>;
	pinctrl-4 = <&P9_18_spi_pin>;
	pinctrl-5 = <&P9_18_i2c_pin>;
	pinctrl-6 = <&P9_18_pwm_pin>;
	pinctrl-7 = <&P9_18_pru_uart_pin>;
};

P9_21_pinmux {
	compatible = "bone-pinmux-helper";
	status = "okay";
	pinctrl-names = "default", "gpio", "gpio_pu", "gpio_pd", "spi", "uart", "i2c", "pwm", "pru_uart";
	pinctrl-0 = <&P9_21_default_pin>;
	pinctrl-1 = <&P9_21_gpio_pin>;
	pinctrl-2 = <&P9_21_gpio_pu_pin>;
	pinctrl-3 = <&P9_21_gpio_pd_pin>;
	pinctrl-4 = <&P9_21_spi_pin>;
	pinctrl-5 = <&P9_21_uart_pin>;
	pinctrl-6 = <&P9_21_i2c_pin>;
	pinctrl-7 = <&P9_21_pwm_pin>;
	pinctrl-8 = <&P9_21_pru_uart_pin>;
};

P9_22_pinmux {
	compatible = "bone-pinmux-helper";
	status = "okay";
	pinctrl-names = "default", "gpio", "gpio_pu", "gpio_pd", "spi", "uart", "i2c", "pwm", "pru_uart";
	pinctrl-0 = <&P9_22_default_pin>;
	pinctrl-1 = <&P9_22_gpio_pin>;
	pinctrl-2 = <&P9_22_gpio_pu_pin>;
	pinctrl-3 = <&P9_22_gpio_pd_pin>;
	pinctrl-4 = <&P9_22_spi_pin>;
	pinctrl-5 = <&P9_22_uart_pin>;
	pinctrl-6 = <&P9_22_i2c_pin>;
	pinctrl-7 = <&P9_22_pwm_pin>;
	pinctrl-8 = <&P9_22_pru_uart_pin>;
};

P9_23_pinmux {
	compatible = "bone-pinmux-helper";
	status = "okay";
	pinctrl-names = "default", "gpio", "gpio_pu", "gpio_pd", "pwm";
	pinctrl-0 = <&P9_23_default_pin>;
	pinctrl-1 = <&P9_23_gpio_pin>;
	pinctrl-2 = <&P9_23_gpio_pu_pin>;
	pinctrl-3 = <&P9_23_gpio_pd_pin>;
	pinctrl-4 = <&P9_23_pwm_pin>;
};

P9_24_pinmux {
	compatible = "bone-pinmux-helper";
	status = "okay";
	pinctrl-names = "default", "gpio", "gpio_pu", "gpio_pd", "uart", "can", "i2c", "pru_uart", "pruin";
	pinctrl-0 = <&P9_24_default_pin>;
	pinctrl-1 = <&P9_24_gpio_pin>;
	pinctrl-2 = <&P9_24_gpio_pu_pin>;
	pinctrl-3 = <&P9_24_gpio_pd_pin>;
	pinctrl-4 = <&P9_24_uart_pin>;
	pinctrl-5 = <&P9_24_can_pin>;
	pinctrl-6 = <&P9_24_i2c_pin>;
	pinctrl-7 = <&P9_24_pru_uart_pin>;
	pinctrl-8 = <&P9_24_pruin_pin>;
};

P9_25_pinmux {
	compatible = "bone-pinmux-helper";
	status = "okay";
	pinctrl-names = "default", "gpio", "gpio_pu", "gpio_pd", "qep", "pruout", "pruin";
	pinctrl-0 = <&P9_25_default_pin>;
	pinctrl-1 = <&P9_25_gpio_pin>;
	pinctrl-2 = <&P9_25_gpio_pu_pin>;
	pinctrl-3 = <&P9_25_gpio_pd_pin>;
	pinctrl-4 = <&P9_25_qep_pin>;
	pinctrl-5 = <&P9_25_pruout_pin>;
	pinctrl-6 = <&P9_25_pruin_pin>;
};

P9_26_pinmux {
	compatible = "bone-pinmux-helper";
	status = "okay";
	pinctrl-names = "default", "gpio", "gpio_pu", "gpio_pd", "uart", "can", "i2c", "pru_uart", "pruin";
	pinctrl-0 = <&P9_26_default_pin>;
	pinctrl-1 = <&P9_26_gpio_pin>;
	pinctrl-2 = <&P9_26_gpio_pu_pin>;
	pinctrl-3 = <&P9_26_gpio_pd_pin>;
	pinctrl-4 = <&P9_26_uart_pin>;
	pinctrl-5 = <&P9_26_can_pin>;
	pinctrl-6 = <&P9_26_i2c_pin>;
	pinctrl-7 = <&P9_26_pru_uart_pin>;
	pinctrl-8 = <&P9_26_pruin_pin>;
};

P9_27_pinmux {
	compatible = "bone-pinmux-helper";
	status = "okay";
	pinctrl-names = "default", "gpio", "gpio_pu", "gpio_pd", "qep", "pruout", "pruin";
	pinctrl-0 = <&P9_27_default_pin>;
	pinctrl-1 = <&P9_27_gpio_pin>;
	pinctrl-2 = <&P9_27_gpio_pu_pin>;
	pinctrl-3 = <&P9_27_gpio_pd_pin>;
	pinctrl-4 = <&P9_27_qep_pin>;
	pinctrl-5 = <&P9_27_pruout_pin>;
	pinctrl-6 = <&P9_27_pruin_pin>;
};

P9_28_pinmux {
	compatible = "bone-pinmux-helper";
	status = "okay";
	pinctrl-names = "default", "gpio", "gpio_pu", "gpio_pd", "spi", "pwm", "pruout", "pruin";
	pinctrl-0 = <&P9_28_default_pin>;
	pinctrl-1 = <&P9_28_gpio_pin>;
	pinctrl-2 = <&P9_28_gpio_pu_pin>;
	pinctrl-3 = <&P9_28_gpio_pd_pin>;
	pinctrl-4 = <&P9_28_spi_pin>;
	pinctrl-5 = <&P9_28_pwm_pin>;
	pinctrl-6 = <&P9_28_pruout_pin>;
	pinctrl-7 = <&P9_28_pruin_pin>;
};

P9_29_pinmux {
	compatible = "bone-pinmux-helper";
	status = "okay";
	pinctrl-names = "default", "gpio", "gpio_pu", "gpio_pd", "spi", "pwm", "pruout", "pruin";
	pinctrl-0 = <&P9_29_default_pin>;
	pinctrl-1 = <&P9_29_gpio_pin>;
	pinctrl-2 = <&P9_29_gpio_pu_pin>;
	pinctrl-3 = <&P9_29_gpio_pd_pin>;
	pinctrl-4 = <&P9_29_spi_pin>;
	pinctrl-5 = <&P9_29_pwm_pin>;
	pinctrl-6 = <&P9_29_pruout_pin>;
	pinctrl-7 = <&P9_29_pruin_pin>;
};

P9_30_pinmux {
	compatible = "bone-pinmux-helper";
	status = "okay";
	pinctrl-names = "default", "gpio", "gpio_pu", "gpio_pd", "spi", "pwm", "pruout", "pruin";
	pinctrl-0 = <&P9_30_default_pin>;
	pinctrl-1 = <&P9_30_gpio_pin>;
	pinctrl-2 = <&P9_30_gpio_pu_pin>;
	pinctrl-3 = <&P9_30_gpio_pd_pin>;
	pinctrl-4 = <&P9_30_spi_pin>;
	pinctrl-5 = <&P9_30_pwm_pin>;
	pinctrl-6 = <&P9_30_pruout_pin>;
	pinctrl-7 = <&P9_30_pruin_pin>;
};

P9_31_pinmux {
	compatible = "bone-pinmux-helper";
	status = "okay";
	pinctrl-names = "default", "gpio", "gpio_pu", "gpio_pd", "spi", "pwm", "pruout", "pruin";
	pinctrl-0 = <&P9_31_default_pin>;
	pinctrl-1 = <&P9_31_gpio_pin>;
	pinctrl-2 = <&P9_31_gpio_pu_pin>;
	pinctrl-3 = <&P9_31_gpio_pd_pin>;
	pinctrl-4 = <&P9_31_spi_pin>;
	pinctrl-5 = <&P9_31_pwm_pin>;
	pinctrl-6 = <&P9_31_pruout_pin>;
	pinctrl-7 = <&P9_31_pruin_pin>;
};

P9_41_pinmux {
	compatible = "bone-pinmux-helper";
	status = "okay";
	pinctrl-names = "default", "gpio", "gpio_pu", "gpio_pd", "timer", "pruin";
	pinctrl-0 = <&P9_41_default_pin>;
	pinctrl-1 = <&P9_41_gpio_pin>;
	pinctrl-2 = <&P9_41_gpio_pu_pin>;
	pinctrl-3 = <&P9_41_gpio_pd_pin>;
	pinctrl-4 = <&P9_41_timer_pin>;
	pinctrl-5 = <&P9_41_pruin_pin>;
};

P9_91_pinmux {
	compatible = "bone-pinmux-helper";
	status = "okay";
	pinctrl-names = "default", "gpio", "gpio_pu", "gpio_pd", "qep", "pruout", "pruin";
	pinctrl-0 = <&P9_91_default_pin>;
	pinctrl-1 = <&P9_91_gpio_pin>;
	pinctrl-2 = <&P9_91_gpio_pu_pin>;
	pinctrl-3 = <&P9_91_gpio_pd_pin>;
	pinctrl-4 = <&P9_91_qep_pin>;
	pinctrl-5 = <&P9_91_pruout_pin>;
	pinctrl-6 = <&P9_91_pruin_pin>;
};

P9_42_pinmux {
	compatible = "bone-pinmux-helper";
	status = "okay";
	pinctrl-names = "default", "gpio", "gpio_pu", "gpio_pd", "spi", "uart", "pwm";
	pinctrl-0 = <&P9_42_default_pin>;
	pinctrl-1 = <&P9_42_gpio_pin>;
	pinctrl-2 = <&P9_42_gpio_pu_pin>;
	pinctrl-3 = <&P9_42_gpio_pd_pin>;
	pinctrl-4 = <&P9_42_spi_pin>;
	pinctrl-5 = <&P9_42_uart_pin>;
	pinctrl-6 = <&P9_42_pwm_pin>;
};

P9_92_pinmux {
	compatible = "bone-pinmux-helper";
	status = "okay";
	pinctrl-names = "default", "gpio", "gpio_pu", "gpio_pd", "qep", "pruout", "pruin";
	pinctrl-0 = <&P9_92_default_pin>;
	pinctrl-1 = <&P9_92_gpio_pin>;
	pinctrl-2 = <&P9_92_gpio_pu_pin>;
	pinctrl-3 = <&P9_92_gpio_pd_pin>;
	pinctrl-4 = <&P9_92_qep_pin>;
	pinctrl-5 = <&P9_92_pruout_pin>;
	pinctrl-6 = <&P9_92_pruin_pin>;
};


	P8_03 {
		gpio-name = "P8_03";
		gpio = <&gpio1 6 0>;
		input;
		dir-changeable;
	};

	P8_04 {
		gpio-name = "P8_04";
		gpio = <&gpio1 7 0>;
		input;
		dir-changeable;
	};

	P8_05 {
		gpio-name = "P8_05";
		gpio = <&gpio1 2 0>;
		input;
		dir-changeable;
	};

	P8_06 {
		gpio-name = "P8_06";
		gpio = <&gpio1 3 0>;
		input;
		dir-changeable;
	};

	P8_07 {
		gpio-name = "P8_07";
		gpio = <&gpio2 2 0>;
		input;
		dir-changeable;
	};

	P8_08 {
		gpio-name = "P8_08";
		gpio = <&gpio2 3 0>;
		input;
		dir-changeable;
	};

	P8_09 {
		gpio-name = "P8_09";
		gpio = <&gpio2 5 0>;
		input;
		dir-changeable;
	};

	P8_10 {
		gpio-name = "P8_10";
		gpio = <&gpio2 4 0>;
		input;
		dir-changeable;
	};

	P8_11 {
		gpio-name = "P8_11";
		gpio = <&gpio1 13 0>;
		input;
		dir-changeable;
	};

	P8_12 {
		gpio-name = "P8_12";
		gpio = <&gpio1 12 0>;
		input;
		dir-changeable;
	};

	P8_13 {
		gpio-name = "P8_13";
		gpio = <&gpio0 23 0>;
		input;
		dir-changeable;
	};

	P8_14 {
		gpio-name = "P8_14";
		gpio = <&gpio0 26 0>;
		input;
		dir-changeable;
	};

	P8_15 {
		gpio-name = "P8_15";
		gpio = <&gpio1 15 0>;
		input;
		dir-changeable;
	};

	P8_16 {
		gpio-name = "P8_16";
		gpio = <&gpio1 14 0>;
		input;
		dir-changeable;
	};

	P8_17 {
		gpio-name = "P8_17";
		gpio = <&gpio0 27 0>;
		input;
		dir-changeable;
	};

	P8_18 {
		gpio-name = "P8_18";
		gpio = <&gpio2 1 0>;
		input;
		dir-changeable;
	};

	P8_19 {
		gpio-name = "P8_19";
		gpio = <&gpio0 22 0>;
		input;
		dir-changeable;
	};

	P8_20 {
		gpio-name = "P8_20";
		gpio = <&gpio1 31 0>;
		input;
		dir-changeable;
	};

	P8_21 {
		gpio-name = "P8_21";
		gpio = <&gpio1 30 0>;
		input;
		dir-changeable;
	};

	P8_22 {
		gpio-name = "P8_22";
		gpio = <&gpio1 5 0>;
		input;
		dir-changeable;
	};

	P8_23 {
		gpio-name = "P8_23";
		gpio = <&gpio1 4 0>;
		input;
		dir-changeable;
	};

	P8_24 {
		gpio-name = "P8_24";
		gpio = <&gpio1 1 0>;
		input;
		dir-changeable;
	};

	P8_25 {
		gpio-name = "P8_25";
		gpio = <&gpio1 0 0>;
		input;
		dir-changeable;
	};

	P8_26 {
		gpio-name = "P8_26";
		gpio = <&gpio1 29 0>;
		input;
		dir-changeable;
	};

	P8_27 {
		gpio-name = "P8_27";
		gpio = <&gpio2 22 0>;
		input;
		dir-changeable;
	};

	P8_28 {
		gpio-name = "P8_28";
		gpio = <&gpio2 24 0>;
		input;
		dir-changeable;
	};

	P8_29 {
		gpio-name = "P8_29";
		gpio = <&gpio2 23 0>;
		input;
		dir-changeable;
	};

	P8_30 {
		gpio-name = "P8_30";
		gpio = <&gpio2 25 0>;
		input;
		dir-changeable;
	};

	P8_31 {
		gpio-name = "P8_31";
		gpio = <&gpio0 10 0>;
		input;
		dir-changeable;
	};

	P8_32 {
		gpio-name = "P8_32";
		gpio = <&gpio0 11 0>;
		input;
		dir-changeable;
	};

	P8_33 {
		gpio-name = "P8_33";
		gpio = <&gpio0 9 0>;
		input;
		dir-changeable;
	};

	P8_34 {
		gpio-name = "P8_34";
		gpio = <&gpio2 17 0>;
		input;
		dir-changeable;
	};

	P8_35 {
		gpio-name = "P8_35";
		gpio = <&gpio0 8 0>;
		input;
		dir-changeable;
	};

	P8_36 {
		gpio-name = "P8_36";
		gpio = <&gpio2 16 0>;
		input;
		dir-changeable;
	};

	P8_37 {
		gpio-name = "P8_37";
		gpio = <&gpio2 14 0>;
		input;
		dir-changeable;
	};

	P8_38 {
		gpio-name = "P8_38";
		gpio = <&gpio2 15 0>;
		input;
		dir-changeable;
	};

	P8_39 {
		gpio-name = "P8_39";
		gpio = <&gpio2 12 0>;
		input;
		dir-changeable;
	};

	P8_40 {
		gpio-name = "P8_40";
		gpio = <&gpio2 13 0>;
		input;
		dir-changeable;
	};

	P8_41 {
		gpio-name = "P8_41";
		gpio = <&gpio2 10 0>;
		input;
		dir-changeable;
	};

	P8_42 {
		gpio-name = "P8_42";
		gpio = <&gpio2 11 0>;
		input;
		dir-changeable;
	};

	P8_43 {
		gpio-name = "P8_43";
		gpio = <&gpio2 8 0>;
		input;
		dir-changeable;
	};

	P8_44 {
		gpio-name = "P8_44";
		gpio = <&gpio2 9 0>;
		input;
		dir-changeable;
	};

	P8_45 {
		gpio-name = "P8_45";
		gpio = <&gpio2 6 0>;
		input;
		dir-changeable;
	};

	P8_46 {
		gpio-name = "P8_46";
		gpio = <&gpio2 7 0>;
		input;
		dir-changeable;
	};

	P9_11 {
		gpio-name = "P9_11";
		gpio = <&gpio0 30 0>;
		input;
		dir-changeable;
	};

	P9_12 {
		gpio-name = "P9_12";
		gpio = <&gpio1 28 0>;
		input;
		dir-changeable;
	};

	P9_13 {
		gpio-name = "P9_13";
		gpio = <&gpio0 31 0>;
		input;
		dir-changeable;
	};

	P9_14 {
		gpio-name = "P9_14";
		gpio = <&gpio1 18 0>;
		input;
		dir-changeable;
	};

	P9_15 {
		gpio-name = "P9_15";
		gpio = <&gpio1 16 0>;
		input;
		dir-changeable;
	};

	P9_16 {
		gpio-name = "P9_16";
		gpio = <&gpio1 19 0>;
		input;
		dir-changeable;
	};

	P9_17 {
		gpio-name = "P9_17";
		gpio = <&gpio0 5 0>;
		input;
		dir-changeable;
	};

	P9_18 {
		gpio-name = "P9_18";
		gpio = <&gpio0 4 0>;
		input;
		dir-changeable;
	};

	P9_21 {
		gpio-name = "P9_21";
		gpio = <&gpio0 3 0>;
		input;
		dir-changeable;
	};

	P9_22 {
		gpio-name = "P9_22";
		gpio = <&gpio0 2 0>;
		input;
		dir-changeable;
	};

	P9_23 {
		gpio-name = "P9_23";
		gpio = <&gpio1 17 0>;
		input;
		dir-changeable;
	};

	P9_24 {
		gpio-name = "P9_24";
		gpio = <&gpio0 15 0>;
		input;
		dir-changeable;
	};

	P9_25 {
		gpio-name = "P9_25";
		gpio = <&gpio3 21 0>;
		input;
		dir-changeable;
	};

	P9_26 {
		gpio-name = "P9_26";
		gpio = <&gpio0 14 0>;
		input;
		dir-changeable;
	};

	P9_27 {
		gpio-name = "P9_27";
		gpio = <&gpio3 19 0>;
		input;
		dir-changeable;
	};

	P9_28 {
		gpio-name = "P9_28";
		gpio = <&gpio3 17 0>;
		input;
		dir-changeable;
	};

	P9_29 {
		gpio-name = "P9_29";
		gpio = <&gpio3 15 0>;
		input;
		dir-changeable;
	};

	P9_30 {
		gpio-name = "P9_30";
		gpio = <&gpio3 16 0>;
		input;
		dir-changeable;
	};

	P9_31 {
		gpio-name = "P9_31";
		gpio = <&gpio3 14 0>;
		input;
		dir-changeable;
	};

	P9_41 {
		gpio-name = "P9_41";
		gpio = <&gpio0 20 0>;
		input;
		dir-changeable;
	};

	P9_91 {
		gpio-name = "P9_91";
		gpio = <&gpio3 20 0>;
		input;
		dir-changeable;
	};

	P9_42 {
		gpio-name = "P9_42";
		gpio = <&gpio0 7 0>;
		input;
		dir-changeable;
	};

	P9_92 {
		gpio-name = "P9_92";
		gpio = <&gpio3 18 0>;
		input;
		dir-changeable;
	};

